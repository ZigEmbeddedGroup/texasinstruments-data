# f29h85x_c29_rtint_stack_regs register map
Vendor: Texas Instruments
Peripheral module from a debugger description file (folder C29).
Registers are 32-bit, read-write, no defined reset value unless marked. A register's access mark holds for its fields unless they carry their own. Offsets are as the file gives them; lines under a group give offsets from that group; [hi:lo] are bit positions; {n}, {i} and the like mark numbered series; 'fields as' and 'values as' point back to an identical list; <NAME> marks a mode.

## C29_RTINT_STACK — C29 RTINT STACK Registers
{0x0+0x40*i} C29_RTINT_STACK_RegisterFile0[{i}] (i=0..127) group
  {0x0+4j} RTINT_STACK_DATA{j} (j=0..8)
  {0x24+4j} RTINT_STACK_ECC{j} (j=0..3)
    [7:0] RTINT_STACK_ECC{j}
