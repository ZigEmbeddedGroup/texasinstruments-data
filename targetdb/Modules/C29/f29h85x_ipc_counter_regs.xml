# f29h85x_ipc_counter_regs register map
Vendor: Texas Instruments
Peripheral module from a debugger description file (folder C29).
Registers are 32-bit, read-only, no defined reset value unless marked. A register's access mark holds for its fields unless they carry their own. Offsets are as the file gives them; lines under a group give offsets from that group; [hi:lo] are bit positions; {n}, {i} and the like mark numbered series; 'fields as' and 'values as' point back to an identical list; <NAME> marks a mode.

## IPC_COUNTER_REGS — IPC COUNTER Registers
0x00 IPCCOUNTERL
  [31:0] COUNT — IPC Counter's lower 32-bit
0x04 IPCCOUNTERH
  [31:0] COUNT — IPC Counter's upper 32-bit
