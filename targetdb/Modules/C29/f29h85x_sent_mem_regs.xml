# f29h85x_sent_mem_regs register map
Vendor: Texas Instruments
Peripheral module from a debugger description file (folder C29).
Registers are 32-bit, read-only, no defined reset value unless marked. A register's access mark holds for its fields unless they carry their own. Offsets are as the file gives them; lines under a group give offsets from that group; [hi:lo] are bit positions; {n}, {i} and the like mark numbered series; 'fields as' and 'values as' point back to an identical list; <NAME> marks a mode.

## SENT_MEM — SENT MEM Registers
{0x0+4i} MDATA[{i}] (i=0..15) — Data word 'N' in TPRAM memory. The SENT TPRAM contains fast channel SENT frames whether in FIFO or Direct Map mode. In Direct Map mode, the user must read the SENT frame data out from this memory (refer to the section regarding Receive Modes for more details)
  [31:0] DAT
