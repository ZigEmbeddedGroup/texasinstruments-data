# f29h85x_c29_seccall_stack_regs register map
Vendor: Texas Instruments
Peripheral module from a debugger description file (folder C29).
Registers are 32-bit, read-write, no defined reset value unless marked. A register's access mark holds for its fields unless they carry their own. Offsets are as the file gives them; lines under a group give offsets from that group; [hi:lo] are bit positions; {n}, {i} and the like mark numbered series; 'fields as' and 'values as' point back to an identical list; <NAME> marks a mode.

## C29_SECCALL_STACK — C29 SECCALL STACK Registers
{0x0+0x10*i} C29_SECCALL_STACK_RegisterFile0[{i}] (i=0..16) group
  0x00 SECCALL_STACK_DATA0
    [31:0] SECCALL_STACK_DATA0 — Secure call stack Data0
  0x04 SECCALL_STACK_DATA1
    [31:0] SECCALL_STACK_DATA1 — Secure call stack Data1
  0x08 SECCALL_STACK_DATA2
    [3:0] SECCALL_STACK_DATA2 — Secure call stack Data2
