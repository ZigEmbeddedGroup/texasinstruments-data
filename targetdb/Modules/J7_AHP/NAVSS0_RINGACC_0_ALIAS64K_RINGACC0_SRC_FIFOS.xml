# NAVSS0_RINGACC_0_ALIAS64K_RINGACC0_SRC_FIFOS register map
Vendor: Texas Instruments
Peripheral module from a debugger description file (folder J7_AHP).
Registers are 32-bit, read-write, reset 0x0 unless marked. A register's access mark holds for its fields unless they carry their own. Offsets are as the file gives them; lines under a group give offsets from that group; [hi:lo] are bit positions; {n}, {i} and the like mark numbered series; 'fields as' and 'values as' point back to an identical list; <NAME> marks a mode.

## NAVSS0_RINGACC_0_ALIAS64K_RINGACC0_SRC_FIFOS
0x00 ALIAS64K_RINGACC0__SRC__FIFOS_RING_HEAD_DATA
  [31:0] DATA — Block of ring head or tail element data
0x200 ALIAS64K_RINGACC0__SRC__FIFOS_RING_TAIL_DATA
  [31:0] DATA — Block of ring head or tail element data
0x400 ALIAS64K_RINGACC0__SRC__FIFOS_PEEK_HEAD_DATA
  [31:0] DATA — Block of ring head or tail element data. Reserved for rings in ring mode.
0x600 ALIAS64K_RINGACC0__SRC__FIFOS_PEEK_TAIL_DATA
  fields as ALIAS64K_RINGACC0__SRC__FIFOS_PEEK_HEAD_DATA
