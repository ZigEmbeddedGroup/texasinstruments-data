# PCIE0_DAT0 register map
Vendor: Texas Instruments
Peripheral module from a debugger description file (folder J7_AHP).
Registers are 32-bit, read-write, reset 0x0 unless marked. A register's access mark holds for its fields unless they carry their own. Offsets are as the file gives them; lines under a group give offsets from that group; [hi:lo] are bit positions; {n}, {i} and the like mark numbered series; 'fields as' and 'values as' point back to an identical list; <NAME> marks a mode.

## PCIE0_DAT0
0x00 CORE__CORE_DAT_SLV__PCIE_DAT0_pcie_data_mem
  [31:0] PCIE_DATA — PCIE data region0
