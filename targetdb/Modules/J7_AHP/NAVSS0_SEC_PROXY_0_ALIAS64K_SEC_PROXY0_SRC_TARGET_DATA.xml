# NAVSS0_SEC_PROXY_0_ALIAS64K_SEC_PROXY0_SRC_TARGET_DATA register map
Vendor: Texas Instruments
Peripheral module from a debugger description file (folder J7_AHP).
Registers are 32-bit, read-only, reset 0x0 unless marked. A register's access mark holds for its fields unless they carry their own. Offsets are as the file gives them; lines under a group give offsets from that group; [hi:lo] are bit positions; {n}, {i} and the like mark numbered series; 'fields as' and 'values as' point back to an identical list; <NAME> marks a mode.

## NAVSS0_SEC_PROXY_0_ALIAS64K_SEC_PROXY0_SRC_TARGET_DATA
0x00 ALIAS64K_SEC_PROXY0__SRC__TARGET_DATA_private
  [9:0] SRC_THR — Proxy source thread of message.
0x04 ALIAS64K_SEC_PROXY0__SRC__TARGET_DATA_message rw
  [31:0] DATA — Proxy Message Data
