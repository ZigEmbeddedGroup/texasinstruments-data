# cslr_icache5501_001 register map
Vendor: Texas Instruments
Peripheral module from a debugger description file.
Registers are 16-bit, access per field, reset 0x0 unless marked. A register's access mark holds for its fields unless they carry their own. Offsets are as the file gives them; lines under a group give offsets from that group; [hi:lo] are bit positions; {n}, {i} and the like mark numbered series; 'fields as' and 'values as' point back to an identical list; <NAME> marks a mode.

## ICACHE — Instruction Cache
0x00 ICGC — Global Control Register
  [12] FLUSHLINE rw — Flush the cache line specified by the flush line address registers (ICFARH and ICFARL).
0x01 ICFARL rw — I-Cache Flush Line Low Address Register
  [15:0] LAL — Least-significant 16 bits of the program address associated with the line to be flushed.
0x02 ICFARH — I-Cache Flush Line High Address Register
  [7:0] LAH rw — Most-significant 8 bits of the program address associated with the line to be flushed.
0x03 ICWMC rw — Way Miss Counter Register
  [15:0] MISSCNT — A counter to count the number of mis-compares for the 2-way cache.
