# CKGEN_PRM register map
Vendor: Texas Instruments
Peripheral module from a debugger description file (folder TDA3x).
Registers are 32-bit, access per field, reset 0x0 unless marked. A register's access mark holds for its fields unless they carry their own. Offsets are as the file gives them; lines under a group give offsets from that group; [hi:lo] are bit positions; {n}, {i} and the like mark numbered series; 'fields as' and 'values as' point back to an identical list; <NAME> marks a mode.

## CKGEN_PRM
0x00 CM_CLKSEL_SYSCLK1 — Select the SYS CLK for SYSCLK1_32K_CLK. [warm reset insensitive]
  [0] CLKSEL rw — Selects the divider value
    0=SYSCLK_DIV_6 (Select SYS_CLK divided by 6); 1=SYSCLK_DIV_10 (Select SYS_CLK divided by 10)
0x08 CM_CLKSEL_WKUPAON — Control the functional clock source of WKUPAON, PRM and Smart Reflex functional clock.
  [0] CLKSEL rw — Select the clock source for WKUPAON_ICLK clock
    0=SEL_SYS_CLK (Selects SYS_CLK for WKUPAON_ICLK); 1=SEL_ABE_X1_LP_CLK (Selects ABE_LP_CLK for WKUPAON_ICLK)
0x0C CM_CLKSEL_ABE_PLL_REF — Control the source of the reference clock for DPLL_ABE
  [0] CLKSEL rw — Select the source for the DPLL_ABE reference clock.
    0=SEL_SYS_CLK (Selects SYS_CLK); 1=SEL_SYS_32K (Selects SYS_CLK1_32K_CLK)
0x10 CM_CLKSEL_SYS — Software (ROM Code) sets the SYS_CLK configuration corresponding to the frequency of SYS_CLK. [warm reset insensitive]
  [2:0] SYS_CLKSEL rw — System clock input selection.
    0=UNSET (Uninitialized); 1=_12_MHZ (Input clock is 12 MHz); 2=RESERVED (Input clock is 20 MHz); 3=_16_8_MHZ (Input clock is 16.8 MHz); 4=_19_2_MHZ (Input clock is 19.2 MHz); 5=_26_MHZ (Input clock is 26 MHz); 6=RESERVED1 (Input clock is 27 MHz); 7=_38_4_MHZ (Input clock is 38.4 MHz)
0x14 CM_CLKSEL_ABE_PLL_BYPAS — Control the source of the bypass clock for DPLL_ABE
  [0] CLKSEL rw
    0=SEL_SYS_CLK (Selects SYS_CLK for ABE_DPLL_BYPASS_CLK); 1=SEL_ABE_X1_LP_CLK (Selects SYS_CLK1_32K_CLK for ABE_DPLL_BYPASS_CLK)
0x18 CM_CLKSEL_ABE_PLL_SYS — Control the source of the SYS clock for DPLL_ABE
  [0] CLKSEL rw — Select the SYS clock for the DPLL_ABE reference and bypass clock.
    0=SEL_SYS_CLK1 (Selects SYS_CLK1); 1=SEL_SYS_CLK2 (Selects SYS_CLK2)
0x1C CM_CLKSEL_ABE_24M — Select the ABE_24M_FCLK for TIMERS subsystems. [warm reset insensitive]
  [0] CLKSEL rw — Selects the divider value
    0=SYSCLK_DIV_8 (Select SYS_CLK divided by 8); 1=SYSCLK_DIV_16 (Select SYS_CLK divided by 16)
0x20 CM_CLKSEL_ABE_SYS — Select the ABE_SYS_CLK. [warm reset insensitive]
  [0] CLKSEL rw — Selects the divider value
    0=SYSCLK_DIV_1 (Select SYS_CLK1 divided by 1); 1=SYSCLK_DIV_2 (Select SYS_CLK1 divided by 2)
0x24 CM_CLKSEL_HDMI_MCASP_AUX — Select the SYS_CLK1 for MCASP modules. [warm reset insensitive]
  [2:0] CLKSEL rw — Selects the divider value
    0=CLK_DIV_1 (Select SYS_CLK1 divided by 1); 1=CLK_DIV_2 (Select SYS_CLK1 divided by 2); 2=CLK_DIV_4 (Select SYS_CLK1 divided by 4); 3=CLK_DIV_8 (Select SYS_CLK1 divided by 8); 4=CLK_DIV_16 (Select SYS_CLK1 divided by 16); 6=RESEREVD1 (RESERVED)
0x28 CM_CLKSEL_HDMI_TIMER — Select the SYS_CLK1 for TIMER subsystems. [warm reset insensitive]
  [2:0] CLKSEL rw — Selects the divider value
    0=CLK_DIV_1 (Select SYS_CLK1 divided by 1); 1=CLK_DIV_2 (Select SYS_CLK1 divided by 2); 2=CLK_DIV_4 (Select SYS_CLK1 divided by 4); 3=CLK_DIV_8 (Select SYS_CLK1 divided by 8); 4=CLK_DIV_16 (Select SYS_CLK1 divided by 16); 5=CLK_DIV_22 (Select SYS_CLK1 divided by 22); 6=CLK_DIV_32 (Select SYS_CLK1 divided by 32)
0x2C CM_CLKSEL_MCASP_SYS — Select the SYS CLK for ABE_24M_FCLK. [warm reset insensitive]
  fields as CM_CLKSEL_ABE_24M
0x30 CM_CLKSEL_MLBP_MCASP — Select the MLBP_CLK for MCASP subsystems. [warm reset insensitive]
  fields as CM_CLKSEL_HDMI_MCASP_AUX
0x34 CM_CLKSEL_MLB_MCASP — Select the SYS_CLK1 for MCASP. [warm reset insensitive]
  fields as CM_CLKSEL_HDMI_MCASP_AUX
0x38 CM_CLKSEL_PER_ABE_X1_GFCLK_MCASP_AUX — Select the L4_ICLK (SR2.0) for MCASP modules. [warm reset insensitive]
  [2:0] CLKSEL rw — Selects the divider value
    0=CLK_DIV_1 (Select L4_ICLK divided by 1); 1=CLK_DIV_2 (Select L4_ICLK divided by 2); 2=CLK_DIV_4 (Select L4_ICLK divided by 4); 3=CLK_DIV_8 (Select L4_ICLK divided by 8); 4=CLK_DIV_16 (Select L4_ICLK divided by 16); 6=RESEREVD1 (RESERVED)
0x40 CM_CLKSEL_SYS_CLK1_32K — Control the source of the FUNC_32K_CLK clock for GPIO, WD_TIMER, KBD, etc.
  [0] CLKSEL rw — Select the FUNC_32K_CLK clock
    0=SEL_SYS_CLK1 (Selects SYS_CLK1 divided by 610); 1=SEL_SYS_CLK32K (RESERVED)
0x44 CM_CLKSEL_TIMER_SYS — Select the TIMER_SYS_CLK for TIMER modules. [warm reset insensitive]
  fields as CM_CLKSEL_ABE_SYS
0x48 CM_CLKSEL_VIDEO1_MCASP_AUX — Select the SYS_CLK1 for MCASP modules. [warm reset insensitive]
  fields as CM_CLKSEL_HDMI_MCASP_AUX
0x4C CM_CLKSEL_VIDEO1_TIMER — Select the SYS_CLK1 for TIMER subsystems. [warm reset insensitive]
  fields as CM_CLKSEL_HDMI_TIMER
0x50 CM_CLKSEL_VIDEO2_MCASP_AUX — Select the SYS_CLK1 for MCASP modules. [warm reset insensitive]
  fields as CM_CLKSEL_HDMI_MCASP_AUX
0x54 CM_CLKSEL_VIDEO2_TIMER — Select the SYS_CLK1 for TIMER subsystems. [warm reset insensitive]
  fields as CM_CLKSEL_HDMI_TIMER
0x58 CM_CLKSEL_CLKOUTMUX0 — Control the source of the CLKOUTMUX0
  [4:0] CLKSEL rw — Select the source of the CLKOUTMUX0.0x15-0x1F: RESERVED enum=RESERVED .
    0=SEL_SYS_CLK1 (Selects divided version of SYS_CLK1. See); 1=SEL_SYS_CLK2 (Selects divided version of EVE_GFCLK. See); 2=SEL_DPLL_ABE_CLKOUT (Selects divided version of SYS_CLK1. See); 3=SEL_DPLL_MPU_CLKOUT (Selects divided version of SYS_CLK1. See); 4=SEL_DPLL_DSP_CLKOUT (Selects divided version of DSP_GCLK. See); 5=SEL_DPLL_IVA_CLKOUT (Selects divided version of SYS_CLK1. See); 6=SEL_DPLL_GPU_CLKOUT (Selects divided version of SYS_CLK1. See); 7=SEL_DPLL_CORE_CLKOUT (Selects divided version of CORE_DPLL_OUT_CLK. See); 8=SEL_DPLL_DDR_CLKOUT (Selects divided version of EMIF_PHY_GCLK. See); 9=SEL_DPLL_GMAC_CLKOUT (Selects divided version of GMAC_250M_CLK. See); 10=SEL_VIDEO2_CLKOUT (Selects divided version of SYS_CLK1. See); 11=SEL_VIDEO1_CLKOUT (Selects divided version of SYS_CLK1. See); 12=SEL_HDMI_CLKOUT (Selects divided version of SYS_CLK1. See); 13=SEL_DPLL_PER_CLKOUT (Selects divided version of FUNC_96M_AON_CLK. See); 14=SEL_DPLL_USB_CLKOUT (Selects divided version of SYS_CLK1. See); 15=SEL_DPLL_USB_OTG_CLKOUT (Selects divided version of SYS_CLK1. See); 16=SEL_DPLL_SATA_CLKOUT (Selects divided version of SYS_CLK1. See); 17=SEL_DPLL_PCIE2_CLKOUT (Selects divided version of SYS_CLK1. See); 18=SEL_DPLL_PCIE1_CLKOUT (Selects divided version of SYS_CLK1. See); 19=SEL_DPLL_DEBUG_CLKOUT (Selects divided version of EMU_GCLK. See); 20=SEL_RCOSC_32K_GCLK (Selects divided version of RCOSC_32K_GCLK. See)
0x5C CM_CLKSEL_CLKOUTMUX1 — Control the source of the CLKOUTMUX1
  [4:0] CLKSEL rw — Select the source of the CLKOUTMUX10x16-0x1F: RESERVED enum=RESERVED .
    0=SEL_SYS_CLK1 (Selects divided version of SYS_CLK1. See); 1=SEL_SYS_CLK2 (Selects divided version of SYS_CLK2. See); 2=SEL_DPLL_ABE_CLKOUT (Selects divided version of SYS_CLK1. See); 3=SEL_DPLL_MPU_CLKOUT (Selects divided version of SYS_CLK1. See); 4=SEL_DPLL_DSP_CLKOUT (Selects divided version of DSP_GCLK. See); 5=SEL_DPLL_IVA_CLKOUT (Selects divided version of SYS_CLK1. See); 6=SEL_DPLL_GPU_CLKOUT (Selects divided version of SYS_CLK1. See); 7=SEL_DPLL_CORE_CLKOUT (Selects divided version of CORE_DPLL_OUT_CLK. See); 8=SEL_DPLL_DDR_CLKOUT (Selects divided version of EMIF_PHY_GCLK. See); 9=SEL_DPLL_GMAC_CLKOUT (Selects divided version of GMAC_250M_CLK. See); 10=SEL_VIDEO2_CLKOUT (Selects divided version of SYS_CLK1. See); 11=SEL_VIDEO1_CLKOUT (Selects divided version of SYS_CLK1. See); 12=SEL_HDMI_CLKOUT (Selects divided version of SYS_CLK1. See); 13=SEL_DPLL_PER_CLKOUT (Selects divided version of FUNC_96M_AON_CLK. See); 14=SEL_DPLL_USB_CLKOUT (Selects divided version of SYS_CLK1. See); 15=SEL_DPLL_USB_OTG_CLKOUT (Selects divided version of SYS_CLK1. See); 16=SEL_DPLL_SATA_CLKOUT (Selects divided version of SYS_CLK1. See); 17=SEL_DPLL_PCIE2_CLKOUT (Selects divided version of SYS_CLK1. See); 18=SEL_DPLL_PCIE1_CLKOUT (Selects divided version of SYS_CLK1. See); 19=SEL_DPLL_DEBUG_CLKOUT (Selects divided version of EMU_GCLK. See); 20=RESERVED (Selects divided version of RCOSC_32K_GCLK. See); 21=SEL_DPLL_EVE_CLKOUT (Selects EVE_GFCLK. See)
0x60 CM_CLKSEL_CLKOUTMUX2 — Control the source of the CLKOUTMUX2
  [4:0] CLKSEL rw — Select the source of the CLKOUTMUX20x16-0x1F: RESERVED enum=RESERVED .
    values as CM_CLKSEL_CLKOUTMUX1.CLKSEL
0x64 CM_CLKSEL_HDMI_PLL_SYS — Control the source of the SYS clock for DPLL_HDMI
  [0] CLKSEL rw — Select the SYS clock for the DPLL_HDMI
    values as CM_CLKSEL_ABE_PLL_SYS.CLKSEL
0x68 CM_CLKSEL_VIDEO1_PLL_SYS — Control the source of the SYS clock for DPLL_VIDEO1
  [0] CLKSEL rw — Select the SYS clock for the DPLL_VIDEO1.
    values as CM_CLKSEL_ABE_PLL_SYS.CLKSEL
0x6C CM_CLKSEL_VIDEO2_PLL_SYS — Control the source of the SYS clock for DPLL_VIDEO1
  [0] CLKSEL rw — Select the SYS clock for the DPLL_VIDEO2.
    values as CM_CLKSEL_ABE_PLL_SYS.CLKSEL
0x70 CM_CLKSEL_ABE_CLK_DIV — Select the ABE_CLK. [warm reset insensitive]
  [2:0] CLKSEL rw — Selects the divider value
    0=CLK_DIV_1 (Select CLK divided by 1); 1=CLK_DIV_2 (Select CLK divided by 2); 2=CLK_DIV_4 (Select CLK divided by 4); 3=CLK_DIV_8 (Select CLK divided by 8); 4=CLK_DIV_16 (Select CLK divided by 16)
0x74 CM_CLKSEL_ABE_GICLK_DIV — Select the ABE_GICLK. [warm reset insensitive]
  [0] CLKSEL rw — Selects the divider value
    0=CLK_DIV_1 (Select CLK divided by 1); 1=CLK_DIV_2 (Select CLK divided by 2)
0x78 CM_CLKSEL_AESS_FCLK_DIV — Select the AESS_FCLK. [warm reset insensitive]
  fields as CM_CLKSEL_ABE_GICLK_DIV
0x80 CM_CLKSEL_EVE_CLK — Controls the source of the EVE_CLK for EVE
  [0] CLKSEL rw — Selects the EVE_CLK for EVE
    0=SEL_EVE_GFCLK (Selects clock from DPLL_EVE_VID_DSP); 1=SEL_EVE_GCLK (Selects clock from DPLL_CORE or DPLL_GMAC_DSP (selected in the control module).)
0x84 CM_CLKSEL_USB_OTG_CLK_CLKOUTMUX — Select the USB_OTG_CLK. [warm reset insensitive]
  [2:0] CLKSEL rw — Selects the divider value
    0=CLK_DIV_1 (Select CLK divided by 1); 1=CLK_DIV_2 (Select CLK divided by 2); 2=CLK_DIV_4 (Select CLK divided by 4); 3=CLK_DIV_8 (Select CLK divided by 8); 4=CLK_DIV_16 (Select CLK divided by 16); 5=CLK_DIV_32 (SELECT CLK divided by 32)
0x88 CM_CLKSEL_CORE_DPLL_OUT_CLK_CLKOUTMUX — Select the CORE_DPLL_OUT_CLK. [warm reset insensitive]
  [2:0] CLKSEL rw — Selects the divider value
    0=CLK_DIV_1 (Select CLK divided by 1); 1=CLK_DIV_2 (Select CLK divided by 2); 2=CLK_DIV_4 (Select CLK divided by 4); 3=CLK_DIV_8 (Select CLK divided by 8); 4=CLK_DIV_16 (Select CLK divided by 16); 5=CLK_DIV_32 (Select CLK divided by 32)
0x8C CM_CLKSEL_DSP_GFCLK_CLKOUTMUX — Select the DSP_GFCLK. [warm reset insensitive]
  fields as CM_CLKSEL_USB_OTG_CLK_CLKOUTMUX
0x90 CM_CLKSEL_EMIF_PHY_GCLK_CLKOUTMUX — Select the EMIF_PHY_GCLK. [warm reset insensitive]
  fields as CM_CLKSEL_USB_OTG_CLK_CLKOUTMUX
0x94 CM_CLKSEL_EMU_CLK_CLKOUTMUX — Select the EMU_CLK. [warm reset insensitive]
  fields as CM_CLKSEL_CORE_DPLL_OUT_CLK_CLKOUTMUX
0x98 CM_CLKSEL_FUNC_96M_AON_CLK_CLKOUTMUX — Select the FUNC_96M_AON_CLK. [warm reset insensitive]
  fields as CM_CLKSEL_USB_OTG_CLK_CLKOUTMUX
0x9C CM_CLKSEL_GMAC_250M_CLK_CLKOUTMUX — Select the GMAC_250M_CLK. [warm reset insensitive]
  fields as CM_CLKSEL_USB_OTG_CLK_CLKOUTMUX
0xA0 CM_CLKSEL_GPU_GCLK_CLKOUTMUX — Select the GPU_GCLK. [warm reset insensitive]
  fields as CM_CLKSEL_CORE_DPLL_OUT_CLK_CLKOUTMUX
0xA4 CM_CLKSEL_HDMI_CLK_CLKOUTMUX — Select the HDMI_CLK. [warm reset insensitive]
  fields as CM_CLKSEL_CORE_DPLL_OUT_CLK_CLKOUTMUX
0xA8 CM_CLKSEL_IVA_GCLK_CLKOUTMUX — Select the IVA_GCLK. [warm reset insensitive]
  fields as CM_CLKSEL_CORE_DPLL_OUT_CLK_CLKOUTMUX
0xAC CM_CLKSEL_L3INIT_480M_GFCLK_CLKOUTMUX — Select the L3INIT_480M_GFCLK. [warm reset insensitive]
  fields as CM_CLKSEL_CORE_DPLL_OUT_CLK_CLKOUTMUX
0xB0 CM_CLKSEL_MPU_GCLK_CLKOUTMUX — Select the MPU_GCLK. [warm reset insensitive]
  fields as CM_CLKSEL_CORE_DPLL_OUT_CLK_CLKOUTMUX
0xB4 CM_CLKSEL_PCIE1_CLK_CLKOUTMUX — Select the PCIE1_CLK. [warm reset insensitive]
  fields as CM_CLKSEL_CORE_DPLL_OUT_CLK_CLKOUTMUX
0xB8 CM_CLKSEL_PCIE2_CLK_CLKOUTMUX — Select the PCIE2_CLK. [warm reset insensitive]
  fields as CM_CLKSEL_CORE_DPLL_OUT_CLK_CLKOUTMUX
0xBC CM_CLKSEL_PER_ABE_X1_CLK_CLKOUTMUX — Select the PER_ABE_X1_CLK. [warm reset insensitive]
  fields as CM_CLKSEL_CORE_DPLL_OUT_CLK_CLKOUTMUX
0xC0 CM_CLKSEL_SATA_CLK_CLKOUTMUX — Select the SATA_CLK. [warm reset insensitive]
  fields as CM_CLKSEL_CORE_DPLL_OUT_CLK_CLKOUTMUX
0xC4 CM_CLKSEL_SECURE_32K_CLK_CLKOUTMUX — Select the RCOSC_32K_CLK. [warm reset insensitive]
  fields as CM_CLKSEL_CORE_DPLL_OUT_CLK_CLKOUTMUX
0xC8 CM_CLKSEL_SYS_CLK1_CLKOUTMUX — Select the SYS_CLK1. [warm reset insensitive]
  fields as CM_CLKSEL_USB_OTG_CLK_CLKOUTMUX
0xCC CM_CLKSEL_SYS_CLK2_CLKOUTMUX — Select the SYS_CLK2. [warm reset insensitive]
  fields as CM_CLKSEL_USB_OTG_CLK_CLKOUTMUX
0xD0 CM_CLKSEL_VIDEO1_CLK_CLKOUTMUX — Select the VIDEO1_CLK. [warm reset insensitive]
  fields as CM_CLKSEL_CORE_DPLL_OUT_CLK_CLKOUTMUX
0xD4 CM_CLKSEL_VIDEO2_CLK_CLKOUTMUX — Select the VIDEO2_CLK. [warm reset insensitive]
  fields as CM_CLKSEL_CORE_DPLL_OUT_CLK_CLKOUTMUX
0xD8 CM_CLKSEL_ABE_LP_CLK — Select the ABE_LP_CLK. [warm reset insensitive]
  [0] CLKSEL rw — Selects the divider value
    0=CLK_DIV_16 (Select CLK divided by 16); 1=CLK_DIV_32 (Select CLK divided by 32)
0xDC CM_CLKSEL_ADC_GFCLK — Control the source of the ADC_GFCLK clock for
  [1:0] CLKSEL rw — Select the SYS clock for the DPLL_ABE reference and bypass clock.
    0=SEL_SYS_CLK1 (Selects SYS_CLK1); 1=SEL_SYS_CLK2 (Selects SYS_CLK2); 2=SEL_SYS_CLK1_32K_CLK (Selects SYS_CLK1_32K_CLK)
0xE0 CM_CLKSEL_EVE_GFCLK_CLKOUTMUX — Select the EVE_GFCLK. [warm reset insensitive]
  fields as CM_CLKSEL_USB_OTG_CLK_CLKOUTMUX
