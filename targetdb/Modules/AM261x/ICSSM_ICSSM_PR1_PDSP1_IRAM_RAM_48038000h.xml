# ICSSM_ICSSM_PR1_PDSP1_IRAM_RAM_48038000h register map
Vendor: Texas Instruments
Peripheral module from a debugger description file (folder AM261x).
Registers are 32-bit, read-write, reset 0x0 unless marked. A register's access mark holds for its fields unless they carry their own. Offsets are as the file gives them; lines under a group give offsets from that group; [hi:lo] are bit positions; {n}, {i} and the like mark numbered series; 'fields as' and 'values as' point back to an identical list; <NAME> marks a mode.

## ICSSM_PR1_PDSP1_IRAM_RAM
0x00 ICSSM_PR1_PDSP1_IRAM_RAM_IRAM — PDSP instruction RAM.
  [31:0] VALUE — PDSP IRAM
