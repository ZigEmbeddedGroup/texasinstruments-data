# USB_USB_RAM0_53908000h register map
Vendor: Texas Instruments
Peripheral module from a debugger description file (folder AM261x).
Registers are 32-bit, read-write, reset 0x0 unless marked. A register's access mark holds for its fields unless they carry their own. Offsets are as the file gives them; lines under a group give offsets from that group; [hi:lo] are bit positions; {n}, {i} and the like mark numbered series; 'fields as' and 'values as' point back to an identical list; <NAME> marks a mode.

## USB_RAM0
0x00 USB_RAM0_START
  [31:0] START — USB RAM0 start address
0x7FFC USB_RAM0_END
  [31:0] END — USB RAM0 end address
