# f28004x_dcsm_bank0_z2_otp_regs register map
Vendor: Texas Instruments
Peripheral module from a debugger description file (folder C2000).
Address unit: 16 bits
Registers are 32-bit, read-only, no defined reset value unless marked. A register's access mark holds for its fields unless they carry their own. Offsets are as the file gives them; lines under a group give offsets from that group; [hi:lo] are bit positions; {n}, {i} and the like mark numbered series; 'fields as' and 'values as' point back to an identical list; <NAME> marks a mode.

## DCSM_BANK0_Z2_OTP — DCSM BANK0 Z2 OTP Registers
0x00 B0_Z2OTP_LINKPOINTER1 — Zone 2Link Pointer1 in Z2 OTP for flash BANK0
  [31:0] B0_Z2OTP_LINKPOINTER1 — Zone2 Link Pointer 1 location in USER OTP of Flash BANK0.
0x04 B0_Z2OTP_LINKPOINTER2 — Zone 2 Link Pointer2 in Z2 OTP for flash BANK0
  [31:0] B0_Z2OTP_LINKPOINTER2 — Zone2 Link Pointer 2 location in USER OTP of Flash BANK0.
0x08 B0_Z2OTP_LINKPOINTER3 — Zone 12Link Pointer3 in Z2 OTP for flash BANK0
  [31:0] B0_Z2OTP_LINKPOINTER3 — Zone2 Link Pointer 3 location in USER OTP of Flash BANK0.
0x10 Z2OTP_PSWDLOCK — Secure Password Lock in Z2 OTP
  [31:0] Z2OTP_PSWDLOCK — Zone2 Password lock location in USER OTP.
0x14 Z2OTP_CRCLOCK — Secure CRC Lock in Z2 OTP
  [31:0] Z2OTP_CRCLOCK — Zone2 CRC lock location in USER OTP.
0x18 Z2OTP_JTAGLOCK access not given — Secure JTAG Lock in Z2 OTP
