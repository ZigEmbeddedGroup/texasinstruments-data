# f2838x_cm_emac_regs register map
Vendor: Texas Instruments
Peripheral module from a debugger description file (folder C2000).
Address unit: 16 bits
Registers are 32-bit, access not given, no defined reset value unless marked. A register's access mark holds for its fields unless they carry their own. Offsets are as the file gives them; lines under a group give offsets from that group; [hi:lo] are bit positions; {n}, {i} and the like mark numbered series; 'fields as' and 'values as' point back to an identical list; <NAME> marks a mode.

## EMAC_REGS — EMAC Registers
0x00 MAC_Configuration
0x00 MTL_Operation_Mode
0x00 MTL_TxQ0_Operation_Mode
0x00 MTL_TxQ1_Operation_Mode
0x00 DMA_Mode
0x00 DMA_CH0_Control
0x00 DMA_CH1_Control
0x04 MAC_Ext_Configuration
0x04 MTL_TxQ0_Underflow
0x04 MTL_TxQ1_Underflow
0x04 DMA_SysBus_Mode
0x04 DMA_CH0_Tx_Control
0x04 DMA_CH1_Tx_Control
0x08 MAC_Packet_Filter
0x08 MTL_DBG_CTL
0x08 MTL_TxQ0_Debug
0x08 MTL_TxQ1_Debug
0x08 DMA_Interrupt_Status
0x08 DMA_CH0_Rx_Control
0x08 DMA_CH1_Rx_Control
0x0C MAC_Watchdog_Timeout
0x0C MTL_DBG_STS
0x0C DMA_Debug_Status0
0x10 MAC_Hash_Table_Reg0
0x10 MTL_FIFO_Debug_Data
0x14 MAC_Hash_Table_Reg1
0x14 MTL_TxQ0_ETS_Status
0x14 MTL_TxQ1_ETS_Status
0x14 DMA_CH0_TxDesc_List_Address
0x14 DMA_CH1_TxDesc_List_Address
0x18 MTL_TxQ0_Quantum_Weight
0x18 MTL_TxQ1_Quantum_Weight
0x1C DMA_CH0_RxDesc_List_Address
0x1C DMA_CH1_RxDesc_List_Address
0x20 MTL_Interrupt_Status
0x20 DMA_CH0_TxDesc_Tail_Pointer
0x20 DMA_CH1_TxDesc_Tail_Pointer
0x28 DMA_CH0_RxDesc_Tail_Pointer
0x28 DMA_CH1_RxDesc_Tail_Pointer
0x2C MTL_Q0_Interrupt_Control_Status
0x2C MTL_Q1_Interrupt_Control_Status
0x2C DMA_CH0_TxDesc_Ring_Length
0x2C DMA_CH1_TxDesc_Ring_Length
0x30 MTL_RxQ_DMA_Map0
0x30 MTL_RxQ0_Operation_Mode
0x30 MTL_RxQ1_Operation_Mode
0x30 DMA_CH0_RxDesc_Ring_Length
0x30 DMA_CH1_RxDesc_Ring_Length
0x34 MTL_RxQ0_Missed_Packet_Overflow_Cnt
0x34 MTL_RxQ1_Missed_Packet_Overflow_Cnt
0x34 DMA_CH0_Interrupt_Enable
0x34 DMA_CH1_Interrupt_Enable
0x38 MTL_RxQ0_Debug
0x38 MTL_RxQ1_Debug
0x38 DMA_CH0_Rx_Interrupt_Watchdog_Timer
0x38 DMA_CH1_Rx_Interrupt_Watchdog_Timer
0x3C MTL_RxQ0_Control
0x3C MTL_RxQ1_Control
0x44 DMA_CH0_Current_App_TxDesc
0x44 DMA_CH1_Current_App_TxDesc
0x4C DMA_CH0_Current_App_RxDesc
0x4C DMA_CH1_Current_App_RxDesc
0x50 MAC_VLAN_Tag_Ctrl
0x54 MAC_VLAN_Tag_Data
0x54 DMA_CH0_Current_App_TxBuffer
0x54 DMA_CH1_Current_App_TxBuffer
0x58 MAC_VLAN_Hash_Table
0x5C DMA_CH0_Current_App_RxBuffer
0x5C DMA_CH1_Current_App_RxBuffer
0x60 MAC_VLAN_Incl
0x60 DMA_CH0_Status
0x60 DMA_CH1_Status
0x64 MAC_Inner_VLAN_Incl
0x64 DMA_CH0_Miss_Frame_Cnt
0x64 DMA_CH1_Miss_Frame_Cnt
0x6C DMA_CH0_RX_ERI_Cnt
0x6C DMA_CH1_RX_ERI_Cnt
0x70 MAC_Q0_Tx_Flow_Ctrl
0x90 MAC_Rx_Flow_Ctrl
0x94 MAC_RxQ_Ctrl4
{0xA0+4i} MAC_RxQ_Ctrl{i} (i=0..2)
0xB0 MAC_Interrupt_Status
0xB4 MAC_Interrupt_Enable
0xB8 MAC_Rx_Tx_Status
0xC0 MAC_PMT_Control_Status
0xC4 MAC_RWK_Packet_Filter
0xD0 MAC_LPI_Control_Status
0xD4 MAC_LPI_Timers_Control
0xD8 MAC_LPI_Entry_Timer
0xDC MAC_1US_Tic_Counter
0x110 MAC_Version
0x114 MAC_Debug
{0x11C+4i} MAC_HW_Feature{i} (i=0..3)
0x200 MAC_MDIO_Address
0x204 MAC_MDIO_Data
0x210 MAC_ARP_Address
0x230 MAC_CSR_SW_Ctrl
0x238 MAC_Ext_Cfg1
{0x300+8i} MAC_Address{i}_High (i=0..7)
{0x304+8i} MAC_Address{i}_Low (i=0..7)
0x700 MMC_Control
0x704 MMC_Rx_Interrupt
0x708 MMC_Tx_Interrupt
0x70C MMC_Rx_Interrupt_Mask
0x710 MMC_Tx_Interrupt_Mask
0x714 Tx_Octet_Count_Good_Bad
0x718 Tx_Packet_Count_Good_Bad
0x71C Tx_Broadcast_Packets_Good
0x720 Tx_Multicast_Packets_Good
0x724 Tx_64Octets_Packets_Good_Bad
0x728 Tx_65To127Octets_Packets_Good_Bad
0x72C Tx_128To255Octets_Packets_Good_Bad
0x730 Tx_256To511Octets_Packets_Good_Bad
0x734 Tx_512To1023Octets_Packets_Good_Bad
0x738 Tx_1024ToMaxOctets_Packets_Good_Bad
0x73C Tx_Unicast_Packets_Good_Bad
0x740 Tx_Multicast_Packets_Good_Bad
0x744 Tx_Broadcast_Packets_Good_Bad
0x748 Tx_Underflow_Error_Packets
0x74C Tx_Single_Collision_Good_Packets
0x750 Tx_Multiple_Collision_Good_Packets
0x754 Tx_Deferred_Packets
0x758 Tx_Late_Collision_Packets
0x75C Tx_Excessive_Collision_Packets
0x760 Tx_Carrier_Error_Packets
0x764 Tx_Octet_Count_Good
0x768 Tx_Packet_Count_Good
0x76C Tx_Excessive_Deferral_Error
0x770 Tx_Pause_Packets
0x774 Tx_VLAN_Packets_Good
0x778 Tx_OSize_Packets_Good
0x780 Rx_Packets_Count_Good_Bad
0x784 Rx_Octet_Count_Good_Bad
0x788 Rx_Octet_Count_Good
0x78C Rx_Broadcast_Packets_Good
0x790 Rx_Multicast_Packets_Good
0x794 Rx_CRC_Error_Packets
0x798 Rx_Alignment_Error_Packets
0x79C Rx_Runt_Error_Packets
0x7A0 Rx_Jabber_Error_Packets
0x7A4 Rx_Undersize_Packets_Good
0x7A8 Rx_Oversize_Packets_Good
0x7AC Rx_64Octets_Packets_Good_Bad
0x7B0 Rx_65To127Octets_Packets_Good_Bad
0x7B4 Rx_128To255Octets_Packets_Good_Bad
0x7B8 Rx_256To511Octets_Packets_Good_Bad
0x7BC Rx_512To1023Octets_Packets_Good_Bad
0x7C0 Rx_1024ToMaxOctets_Packets_Good_Bad
0x7C4 Rx_Unicast_Packets_Good
0x7C8 Rx_Length_Error_Packets
0x7CC Rx_Out_Of_Range_Type_Packets
0x7D0 Rx_Pause_Packets
0x7D4 Rx_FIFO_Overflow_Packets
0x7D8 Rx_VLAN_Packets_Good_Bad
0x7DC Rx_Watchdog_Error_Packets
0x7E0 Rx_Receive_Error_Packets
0x7E4 Rx_Control_Packets_Good
0x7EC Tx_LPI_USEC_Cntr
0x7F0 Tx_LPI_Tran_Cntr
0x7F4 Rx_LPI_USEC_Cntr
0x7F8 Rx_LPI_Tran_Cntr
0x800 MMC_IPC_Rx_Interrupt_Mask
0x808 MMC_IPC_Rx_Interrupt
0x810 RxIPv4_Good_Packets
0x814 RxIPv4_Header_Error_Packets
0x818 RxIPv4_No_Payload_Packets
0x81C RxIPv4_Fragmented_Packets
0x820 RxIPv4_UDP_Checksum_Disabled_Packets
0x824 RxIPv6_Good_Packets
0x828 RxIPv6_Header_Error_Packets
0x82C RxIPv6_No_Payload_Packets
0x830 RxUDP_Good_Packets
0x834 RxUDP_Error_Packets
0x838 RxTCP_Good_Packets
0x83C RxTCP_Error_Packets
0x840 RxICMP_Good_Packets
0x844 RxICMP_Error_Packets
0x850 RxIPv4_Good_Octets
0x854 RxIPv4_Header_Error_Octets
0x858 RxIPv4_No_Payload_Octets
0x85C RxIPv4_Fragmented_Octets
0x860 RxIPv4_UDP_Checksum_Disable_Octets
0x864 RxIPv6_Good_Octets
0x868 RxIPv6_Header_Error_Octets
0x86C RxIPv6_No_Payload_Octets
0x870 RxUDP_Good_Octets
0x874 RxUDP_Error_Octets
0x878 RxTCP_Good_Octets
0x87C RxTCP_Error_Octets
0x880 RxICMP_Good_Octets
0x884 RxICMP_Error_Octets
{0x900+0x30*i} MAC_L3_L4_Control{i} (i=0..3)
{0x904+0x30*i} MAC_Layer4_Address{i} (i=0..3)
{0x910+4i} MAC_Layer3_Addr{i}_Reg0 (i=0..3)
{0x940+4i} MAC_Layer3_Addr{i}_Reg1 (i=0..3)
{0x970+4i} MAC_Layer3_Addr{i}_Reg2 (i=0..3)
{0x9A0+4i} MAC_Layer3_Addr{i}_Reg3 (i=0..3)
0xB00 MAC_Timestamp_Control
0xB04 MAC_Sub_Second_Increment
0xB08 MAC_System_Time_Seconds
0xB0C MAC_System_Time_Nanoseconds
0xB10 MAC_System_Time_Seconds_Update
0xB14 MAC_System_Time_Nanoseconds_Update
0xB18 MAC_Timestamp_Addend
0xB1C MAC_System_Time_Higher_Word_Seconds
0xB20 MAC_Timestamp_Status
0xB30 MAC_Tx_Timestamp_Status_Nanoseconds
0xB34 MAC_Tx_Timestamp_Status_Seconds
0xB40 MAC_Auxiliary_Control
0xB48 MAC_Auxiliary_Timestamp_Nanoseconds
0xB4C MAC_Auxiliary_Timestamp_Seconds
0xB50 MAC_Timestamp_Ingress_Asym_Corr
0xB54 MAC_Timestamp_Egress_Asym_Corr
0xB58 MAC_Timestamp_Ingress_Corr_Nanosecond
0xB5C MAC_Timestamp_Egress_Corr_Nanosecond
0xB60 MAC_Timestamp_Ingress_Corr_Subnanosec
0xB64 MAC_Timestamp_Egress_Corr_Subnanosec
0xB70 MAC_PPS_Control
0xB80 MAC_PPS0_Target_Time_Seconds
0xB84 MAC_PPS0_Target_Time_Nanoseconds
0xB88 MAC_PPS0_Interval
0xB8C MAC_PPS0_Width
0xB90 MAC_PPS1_Target_Time_Seconds
0xB94 MAC_PPS1_Target_Time_Nanoseconds
0xB98 MAC_PPS1_Interval
0xB9C MAC_PPS1_Width
0xBC0 MAC_PTO_Control
{0xBC4+4i} MAC_Source_Port_Identity{i} (i=0..2)
0xBD0 MAC_Log_Message_Interval
