# MCAN_MSG_RAM_52600000h register map
Vendor: Texas Instruments
Peripheral module from a debugger description file (folder AM263X).
Registers are 32-bit, read-write, reset 0x0 unless marked. A register's access mark holds for its fields unless they carry their own. Offsets are as the file gives them; lines under a group give offsets from that group; [hi:lo] are bit positions; {n}, {i} and the like mark numbered series; 'fields as' and 'values as' point back to an identical list; <NAME> marks a mode.

## msg_ram
0x00 MSG_RAM_START — START.
  [31:0] START — MCAN message mem Start address
0x10FFC MSG_RAM_END — END.
  [31:0] END — MCAN message mem End address
