# EXT_FLASH_EXT_FLASH_60000000h register map
Vendor: Texas Instruments
Peripheral module from a debugger description file (folder AM263X).
Registers are 32-bit, read-write, reset 0x0 unless marked. A register's access mark holds for its fields unless they carry their own. Offsets are as the file gives them; lines under a group give offsets from that group; [hi:lo] are bit positions; {n}, {i} and the like mark numbered series; 'fields as' and 'values as' point back to an identical list; <NAME> marks a mode.

## EXT_FLASH
0x00 EXT_FLASH_START
  [31:0] MEM_START — External flash start Address
0x1FFFFFC EXT_FLASH_END
  [31:0] MEM_END — External flash end address
