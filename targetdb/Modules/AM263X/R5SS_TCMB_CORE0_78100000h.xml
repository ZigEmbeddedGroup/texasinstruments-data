# R5SS_TCMB_CORE0_78100000h register map
Vendor: Texas Instruments
Peripheral module from a debugger description file (folder AM263X).
Registers are 32-bit, read-write, reset 0x0 unless marked. A register's access mark holds for its fields unless they carry their own. Offsets are as the file gives them; lines under a group give offsets from that group; [hi:lo] are bit positions; {n}, {i} and the like mark numbered series; 'fields as' and 'values as' point back to an identical list; <NAME> marks a mode.

## TCMB_CORE0
0x00 TCMB_CORE0_START
  [31:0] START — TCMB start address
0x2FFFC TCMB_CORE0_END
  [31:0] END — TCMB end address
