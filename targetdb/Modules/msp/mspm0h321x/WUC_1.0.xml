# WUC_1.0 register map
Vendor: Texas Instruments
Peripheral module from a debugger description file (folder mspm0h321x).
Registers are 32-bit, read-write, no defined reset value unless marked. A register's access mark holds for its fields unless they carry their own. Offsets are as the file gives them; lines under a group give offsets from that group; [hi:lo] are bit positions; {n}, {i} and the like mark numbered series; 'fields as' and 'values as' point back to an identical list; <NAME> marks a mode.

## WUC
0x400 WUC_FSUB_0 — Subscriber Port 0
  [2:0] CHANID — 0 = disconnected. 1-15 = connected to channelID = CHANID.
0x404 WUC_FSUB_1 — Subscriber Port 1
  fields as WUC_FSUB_0
