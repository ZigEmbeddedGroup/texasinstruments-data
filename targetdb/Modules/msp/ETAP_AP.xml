# ETAP_AP register map
Vendor: Texas Instruments
Peripheral module from a debugger description file (folder msp).
Registers are 32-bit, access not given, no defined reset value unless marked. A register's access mark holds for its fields unless they carry their own. Offsets are as the file gives them; lines under a group give offsets from that group; [hi:lo] are bit positions; {n}, {i} and the like mark numbered series; 'fields as' and 'values as' point back to an identical list; <NAME> marks a mode.

## Hidden
0x00 ETAP_REGSEL
0x04 ETAP_CAPCTRL
0x08 ETAP_STATREAD
0x0C ETAP_DMNCTRL
0xFC ETAP_IDR
