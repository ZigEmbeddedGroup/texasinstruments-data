# CFGAP register map
Vendor: Texas Instruments
Peripheral module from a debugger description file (folder msp).
Registers are 32-bit, access not given, no defined reset value unless marked. A register's access mark holds for its fields unless they carry their own. Offsets are as the file gives them; lines under a group give offsets from that group; [hi:lo] are bit positions; {n}, {i} and the like mark numbered series; 'fields as' and 'values as' point back to an identical list; <NAME> marks a mode.

## Hidden
0x00 CFGAP_IDCODE
0x04 CFGAP_USERCODE
0x08 CFGAP_DBGVER
0x0C CFGAP_SYSCTLSTAT
0x10 CFGAP_BOOTDIAG
0x14 CFGAP_LIFECYCLE
0xFC CFGAP_IDR
