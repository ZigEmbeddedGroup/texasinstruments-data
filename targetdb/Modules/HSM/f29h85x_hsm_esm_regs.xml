# f29h85x_hsm_esm_regs register map
Vendor: Texas Instruments
Peripheral module from a debugger description file (folder HSM).
Registers are 32-bit, read-write, no defined reset value unless marked. A register's access mark holds for its fields unless they carry their own. Offsets are as the file gives them; lines under a group give offsets from that group; [hi:lo] are bit positions; {n}, {i} and the like mark numbered series; 'fields as' and 'values as' point back to an identical list; <NAME> marks a mode.

## HSM_ESM — HSM ESM Registers
0x00 ESMIEPSR1
  [31:0] IEPSET
0x04 ESMIEPCR1
  [31:0] IEPCLR
0x08 ESMIESR1
  [31:0] INTENSET
0x0C ESMIECR1
  [31:0] INTENCLR
0x10 ESMILSR1
  [31:0] INTLVLSET
0x14 ESMILCR1
  [31:0] INTLVLCLR
{0x14+4i} ESMSR{i} (i=1..3)
  [31:0] ESF
0x24 ESMEPSR ro
  [0] EPSF
0x28 ESMIOFFHR ro
  [8:0] INTOFFH
0x2C ESMIOFFLR ro
  [7:0] INTOFFL
0x30 ESMLTCR ro
  [15:0] LTCP
0x34 ESMLTCPR
  [15:0] LTCP
0x38 ESMEKR
  [3:0] EKEY
0x3C ESMSSR2
  [31:0] ESF
