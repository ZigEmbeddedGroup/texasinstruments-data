# f29h85x_hsm_fwmgr_fw_regs register map
Vendor: Texas Instruments
Peripheral module from a debugger description file (folder HSM).
Registers are 32-bit, access not given, no defined reset value unless marked. A register's access mark holds for its fields unless they carry their own. Offsets are as the file gives them; lines under a group give offsets from that group; [hi:lo] are bit positions; {n}, {i} and the like mark numbered series; 'fields as' and 'values as' point back to an identical list; <NAME> marks a mode.

## HSM_FWMGR_FW — HSM FWMGR FW Registers
{0x0+0x20*i} MBOXRAM_SLV_FW_REGION_{i}_CONTROL (i=0..3) — Firewall Region {i} Control Register
{0x4+0x20*i} MBOXRAM_SLV_FW_REGION_{i}_PERMISSION_0 (i=0..3) — Firewall Region {i} Permission 0 Register
{0x8+0x20*i} MBOXRAM_SLV_FW_REGION_{i}_PERMISSION_1 (i=0..3) — Firewall Region {i} Permission 1 Register
{0xC+0x20*i} MBOXRAM_SLV_FW_REGION_{i}_PERMISSION_2 (i=0..3) — Firewall Region {i} Permission 2 Register
{0x10+0x20*i} MBOXRAM_SLV_FW_REGION_{i}_START_ADDRESS_L (i=0..3) — Firewall Region {i} Start Address Low Register
{0x14+0x20*i} MBOXRAM_SLV_FW_REGION_{i}_START_ADDRESS_H (i=0..3) — Firewall Region {i} Start Address High Register
{0x18+0x20*i} MBOXRAM_SLV_FW_REGION_{i}_END_ADDRESS_L (i=0..3) — Firewall Region {i} End Address Low Register
{0x1C+0x20*i} MBOXRAM_SLV_FW_REGION_{i}_END_ADDRESS_H (i=0..3) — Firewall Region {i} End Address High Register
{0x400+0x20*i} DTHE_CFG_FW_REGION_{i}_CONTROL (i=0..5) — Firewall Region {i} Control Register
{0x404+0x20*i} DTHE_CFG_FW_REGION_{i}_PERMISSION_0 (i=0..5) — Firewall Region {i} Permission 0 Register
{0x408+0x20*i} DTHE_CFG_FW_REGION_{i}_PERMISSION_1 (i=0..5) — Firewall Region {i} Permission 1 Register
{0x40C+0x20*i} DTHE_CFG_FW_REGION_{i}_PERMISSION_2 (i=0..5) — Firewall Region {i} Permission 2 Register
{0x410+0x20*i} DTHE_CFG_FW_REGION_{i}_START_ADDRESS_L (i=0..5) — Firewall Region {i} Start Address Low Register
{0x414+0x20*i} DTHE_CFG_FW_REGION_{i}_START_ADDRESS_H (i=0..5) — Firewall Region {i} Start Address High Register
{0x418+0x20*i} DTHE_CFG_FW_REGION_{i}_END_ADDRESS_L (i=0..5) — Firewall Region {i} End Address Low Register
{0x41C+0x20*i} DTHE_CFG_FW_REGION_{i}_END_ADDRESS_H (i=0..5) — Firewall Region {i} End Address High Register
