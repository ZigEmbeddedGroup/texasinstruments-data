# USB_USB2SS_DEBUG_RAM0_31040000h register map
Vendor: Texas Instruments
Peripheral module from a debugger description file (folder am62D).
Registers are 32-bit, read-write, reset 0x0 unless marked. A register's access mark holds for its fields unless they carry their own. Offsets are as the file gives them; lines under a group give offsets from that group; [hi:lo] are bit positions; {n}, {i} and the like mark numbered series; 'fields as' and 'values as' point back to an identical list; <NAME> marks a mode.

## USB2SS_DEBUG_RAM0
0x00 USB2SS_DEBUG_RAM0_RAM0_j — RAM0 memory region accessible through config interface for debug purpose only.
  [31:0] MEM — Memory location Reset Source: rst_mod_g_rst_n
