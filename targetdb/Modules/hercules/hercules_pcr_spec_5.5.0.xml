# hercules_pcr_spec_5.5.0 register map
Vendor: Texas Instruments
Peripheral module from a debugger description file (folder hercules).
Registers are 32-bit, access not given, no defined reset value unless marked. A register's access mark holds for its fields unless they carry their own. Offsets are as the file gives them; lines under a group give offsets from that group; [hi:lo] are bit positions; {n}, {i} and the like mark numbered series; 'fields as' and 'values as' point back to an identical list; <NAME> marks a mode.

## Pcr
0x00 PMProtSet0 — Set-only register to Protect PCS frames 0 to 31
0x04 PMProtSet1 — Set-only register to Protect PCS frames 32 to 64
0x10 PMProtClr0 — Clear-only register to Protect PCS frames 0 to 31
0x14 PMProtClr1 — Clear-only register to Protect PCS frames 32 to 64
{0x20+4i} PProtSet{i} (i=0..3) — Set-only register to Protect the 32 quadrants of PS{8i} to PS{8i+7}
{0x40+4i} PProtClr{i} (i=0..3) — clear-only register to Protect the quadrants of PS{8i} to PS{8i+7}
0x60 PCSPwrDwnSet0
0x64 PCSPwrDwnSet1
0x70 PCSPwrDwnClr0
0x74 PCSPwrDwnClr1
{0x80+4i} PSPwrDwnSet{i} (i=0..3)
{0xA0+4i} PSPwrDwnClr{i} (i=0..3)
0xC0 DbgPwrDwnSet — Debug Frame Power Down Set register
0x200 MstIdWrEna — MasterID Protection Write Enable Register
0x204 MstIdEna — MasterID Check Enable Register
0x208 MstIdDiagCtrl — MasterID Diagnostic Control Register
{0x300+8i} PS{i}MstId_L (i=0..31) — Peripheral Frame {i} (Quadrant 0 and 1) MasteriD Protection Register
{0x304+8i} PS{i}MstId_H (i=0..9) — Peripheral Frame {i} (Quadrant 2 and 3) MasteriD Protection Register
0x354 PS10MstId_H — Peripheral Frame 10(Quadrant 2 and 3) MasteriD Protection Register
{0x304+8i} PS{i}MstId_H (i=11..31) — Peripheral Frame {i} (Quadrant 2 and 3) MasteriD Protection Register
{0x400+8i} PPS{i}MstId_L (i=0..7) — Privileged Peripheral Frame {i} (Quadrant 0 and 1) MasteriD Protection Register
{0x404+8i} PPS{i}MstId_H (i=0..7) — Privileged Peripheral Frame {i} (Quadrant 2 and 3) MasteriD Protection Register
{0x440+8i} PPSE{i}MstId_L (i=0..31) — Privileged Peripheral Extended Frame {i} (Quadrant 0 and 1) MasteriD Protection Register
{0x444+8i} PPSE{i}MstId_H (i=0..20) — Privileged Peripheral Extended Frame {i} (Quadrant 2 and 3) MasteriD Protection Register
{0x444+8i} PPSE{i}MstId_H (i=22..31) — Privileged Peripheral Extended Frame {i} (Quadrant 2 and 3) MasteriD Protection Register
0x4FC PPSE21MstId_H — Privileged Peripheral Extended Frame 21 (Quadrant 2 and 3) MasteriD Protection Register
0x540 PCS0MstId — Memory Frame 0 MasteriD Protection Register
0x544 PCS2MstId — Memory Frame 1 MasteriD Protection Register
0x548 PCS4MstId — Memory Frame 2 MasteriD Protection Register
0x54C PCS6MstId — Memory Frame 3 MasteriD Protection Register
0x550 PCS8MstId — Memory Frame 4 MasteriD Protection Register
0x554 PCS10MstId — Memory Frame 5 MasteriD Protection Register
0x558 PCS12MstId — Memory Frame 6 MasteriD Protection Register
0x55C PCS14MstId — Memory Frame 7 MasteriD Protection Register
0x560 PCS16MstId — Memory Frame 8 MasteriD Protection Register
0x564 PCS18MstId — Memory Frame 9 MasteriD Protection Register
0x568 PCS20MstId — Memory Frame 10 MasteriD Protection Register
0x56C PCS22MstId — Memory Frame 11 MasteriD Protection Register
0x570 PCS24MstId — Memory Frame 12 MasteriD Protection Register
0x574 PCS26MstId — Memory Frame 13 MasteriD Protection Register
0x578 PCS28MstId — Memory Frame 14 MasteriD Protection Register
0x57C PCS30MstId — Memory Frame 15 MasteriD Protection Register
0x580 PCS32MstId — Memory Frame 16 MasteriD Protection Register
0x584 PCS34MstId — Memory Frame 17 MasteriD Protection Register
0x588 PCS36MstId — Memory Frame 18 MasteriD Protection Register
0x58C PCS38MstId — Memory Frame 19 MasteriD Protection Register
0x590 PCS40MstId — Memory Frame 20 MasteriD Protection Register
0x594 PCS42MstId — Memory Frame 21 MasteriD Protection Register
0x598 PCS44MstId — Memory Frame 22 MasteriD Protection Register
0x59C PCS46MstId — Memory Frame 23 MasteriD Protection Register
0x5A0 PCS48MstId — Memory Frame 24 MasteriD Protection Register
0x5A4 PCS50MstId — Memory Frame 25 MasteriD Protection Register
0x5A8 PCS52MstId — Memory Frame 26 MasteriD Protection Register
0x5AC PCS54MstId — Memory Frame 27 MasteriD Protection Register
0x5B0 PCS56MstId — Memory Frame 28 MasteriD Protection Register
0x5B4 PCS58MstId — Memory Frame 29 MasteriD Protection Register
0x5B8 PCS60MstId — Memory Frame 30 MasteriD Protection Register
0x5BC PCS62MstId — Memory Frame 31 MasteriD Protection Register
0x5C0 PPCS0MstId — Priviledged Memory Frame 0 MasteriD Protection Register
0x5C4 PPCS2MstId — Priviledged Memory Frame 1 MasteriD Protection Register
0x5C8 PPCS4MstId — Priviledged Memory Frame 2 MasteriD Protection Register
0x5CC PPCS6MstId — Priviledged Memory Frame 3 MasteriD Protection Register
0x5D0 PPCS8MstId — Priviledged Memory Frame 4 MasteriD Protection Register
0x5D4 PPCS10MstId — Priviledged Memory Frame 5 MasteriD Protection Register
0x5D8 PPCS12MstId — Priviledged Memory Frame 6 MasteriD Protection Register
0x5DC PPCS14MstId — Priviledged Memory Frame 7 MasteriD Protection Register
0x5E0 PCREXTMsTId — Master-ID Protection Register for External PCR

## Notices in the file
(c) Texas Instruments 2003-2012, All rights reserved.
