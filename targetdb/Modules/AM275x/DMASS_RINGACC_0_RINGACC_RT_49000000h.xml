# DMASS_RINGACC_0_RINGACC_RT_49000000h register map
Vendor: Texas Instruments
Peripheral module from a debugger description file (folder AM275x).
Registers are 32-bit, access not given, reset 0x0 unless marked. A register's access mark holds for its fields unless they carry their own. Offsets are as the file gives them; lines under a group give offsets from that group; [hi:lo] are bit positions; {n}, {i} and the like mark numbered series; 'fields as' and 'values as' point back to an identical list; <NAME> marks a mode.

## ringacc_rt
0x10 RINGACC_RT_RINGRT_DB_j — The Ring N Doorbell Register is written by software to increment or decrement the number of entries on a Ring. One or more entries as specified by the entry_cnt field can be added to a ring with a single write operation.
  [7:0] ENTRY_CNT — Signed number of entries by which to increment the ring occupancy. For normal Tx Ring operation, this value should be a positive number. This occ value for the ring is increased by this value each time the doorbell register is written (occ absolute value will increase or decrease based on the sign of the ENTRY_CNT). Reset Source: srst_n (access NA/W)
0x18 RINGACC_RT_RINGRT_OCC_j — The Ring N Occupancy Register can be read by software to determine the total number of valid entries on a ring. The contents of each of these registers are unary ORed in order to create a pending signal for the ring which can be used for triggering hardware operations and/or for generating interrupts to the host.
  [20:0] OCC — Total number of valid entries on the ring. This value is generally intended to be incremented by doorbell pokes from software and is decremented by the DMA engine as entries are completed. Reset Source: srst_n (access R/NA)
0x1C RINGACC_RT_RINGRT_INDX_j — The Ring N Current Index Register can be read by software for debug purposes to determine the current SW read index for the Ring for the channel.
  [19:0] INDX — Current SW owned read index for the ring. This value is initialized to 0 when the ring is set up and will be incremented by SW each time SW processes a ring entry. When the index is incremented to a value equal to the size field in the Ring Size Register for the ring the index will be reset back to 0. Reset Source: srst_n (access R/NA)
0x20 RINGACC_RT_RINGRT_HWOCC_j — The Ring N Hardware Occupancy Register contains the early increment/decrement version of the the total number of valid entries on a ring. The contents of each of these registers are unary ORed in order to create a pending signal for the ring which can be used for triggering hardware operations and/or for generating interrupts to the host.
  fields as RINGACC_RT_RINGRT_OCC_j
0x24 RINGACC_RT_RINGRT_HWINDX_j — The Ring N Current Index Register can be read by software for debug purposes to determine the current HW read index for the Ring for the channel.
  [19:0] INDX — Current HW owned read index for the ring. This value is initialized to 0 when the ring is set up and will be incremented by HW each time HW processes a ring entry. When the index is incremented to a value equal to the size field in the Ring Size Register for the ring the index will be reset back to 0. Reset Source: srst_n (access R/NA)
