# SA3_SS_INTAGGR_0_INTAGGR_INTR_44810000h register map
Vendor: Texas Instruments
Peripheral module from a debugger description file (folder AM275x).
Registers are 64-bit, access not given, reset 0x0 unless marked. A register's access mark holds for its fields unless they carry their own. Offsets are as the file gives them; lines under a group give offsets from that group; [hi:lo] are bit positions; {n}, {i} and the like mark numbered series; 'fields as' and 'values as' point back to an identical list; <NAME> marks a mode.

## intaggr_intr
0x00 INTAGGR_INTR_VINT_ENABLE_SET_j — The Interrupt Enable Set register is written by software to enable (i.e. unmask) specified bits to allow their current status to be considered in the generation of the corresponding level sensitive virtual interrupt output.
  [63:0] INTR_ENABLE — Interrupt enable set value. On writes, set bits will cause corresponding bits in the internal interrupt enable register to be set. Reads will reflect back the current status of the internal interrupt enable register. Reset Source: srst_n (access R/W1TS)
0x08 INTAGGR_INTR_VINT_ENABLE_CLEAR_j — The Interrupt Enable Clear register is written by software to disable (i.e. mask) specified bits to disallow their current status from be considered in the generation of the corresponding level sensitive virtual interrupt output.
  [63:0] INTR_ENABLE — Interrupt enable clear value. On writes, set bits will cause corresponding bits in the internal interrupt enable register to be cleared. Reads will reflect back the current status of the internal interrupt enable register. Reset Source: srst_n (access R/W1TC)
0x10 INTAGGR_INTR_VINT_STATUS_SET_j — The Interrupt Status register is read by software to determine the cause of an interrupt.
  [63:0] INTR_STATUS — Raw state (not enabled/masked) of bits in internal interrupt status register. Writing a 1 to any bit of this register will cause the corresponding raw status bit to be set Reset Source: srst_n (access R/W1TS)
0x18 INTAGGR_INTR_VINT_STATUS_CLEAR_j — The Interrupt Status register is read by software to determine the cause of an interrupt.
  [63:0] INTR_STATUS — Raw state (not enabled/masked) of bits in internal interrupt status register. Writing a 1 to any bit of this register will cause the corresponding raw status bit to be cleared Reset Source: srst_n (access R/W1TC)
0x20 INTAGGR_INTR_VINT_STATUSM_j — The Interrupt Masked Status register can be read by software to determine the cause of an interrupt.
  [63:0] INTR_STATUSM — Masked state of bits in internal interrupt status register. This value is the result of bitwise ANDing the interrupt enable and status registers Reset Source: srst_n (access R/NA)
