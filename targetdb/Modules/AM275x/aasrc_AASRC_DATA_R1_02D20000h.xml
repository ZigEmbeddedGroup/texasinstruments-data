# aasrc_AASRC_DATA_R1_02D20000h register map
Vendor: Texas Instruments
Peripheral module from a debugger description file (folder AM275x).
Registers are 32-bit, read-write, reset 0x0 unless marked. A register's access mark holds for its fields unless they carry their own. Offsets are as the file gives them; lines under a group give offsets from that group; [hi:lo] are bit positions; {n}, {i} and the like mark numbered series; 'fields as' and 'values as' point back to an identical list; <NAME> marks a mode.

## aasrc_data_r1
{0x0+0x200*i} AASRC_DATA_R1_STREAM_INPUT_FIFO_DATA_L{i} (i=0..7) — This is where the input samples are written for stream{i} left channel
  [31:0] IN_DATA{2i} — This is where the input samples are written for stream{i} left channel. Note that reads from any address within this stream region address range reads same value
{0x100+0x200*i} AASRC_DATA_R1_STREAM_INPUT_FIFO_DATA_R{i} (i=0..7) — This is where the input samples are written for stream{i} right channel
  [31:0] IN_DATA{2i+1} — This is where the input samples are written for stream{i} right channel. Note that reads from any address within this stream region address range reads same value
0x1000 AASRC_DATA_R1_STREAM_OUTPUT_FIFO_DATA_L0 ro — This is from where the output samples are read for stream0 left channel
  [31:0] OUT_DATA0 — This is from where the output samples are read for stream0 left channel. Note that reads from any address within this stream region address range reads same value
{0x1100+0x200*i} AASRC_DATA_R1_STREAM_OUTPUT_FIFO_DATA_R{i} ro (i=0..7) — This is from where the output samples are read for stream{i} right channel
  [31:0] OUT_DATA{2i+1} — This is from where the output samples are read for stream{i} right channel. Note that reads from any address within this stream region address range reads same value
0x1200 AASRC_DATA_R1_STREAM_OUTPUT_FIFO_DATA_L1 access not given reset not defined — This is from where the output samples are read for stream1 left channel
{0x1000+0x200*i} AASRC_DATA_R1_STREAM_OUTPUT_FIFO_DATA_L{i} ro (i=2..7) — This is from where the output samples are read for stream{i} left channel
  [31:0] OUT_DATA{2i} — This is from where the output samples are read for stream{i} left channel. Note that reads from any address within this stream region address range reads same value
