# DMASS_SEC_PROXY_0_PROXY_TARGET_4D000000h register map
Vendor: Texas Instruments
Peripheral module from a debugger description file (folder AM275x).
Registers are 32-bit, read-only, reset 0x0 unless marked. A register's access mark holds for its fields unless they carry their own. Offsets are as the file gives them; lines under a group give offsets from that group; [hi:lo] are bit positions; {n}, {i} and the like mark numbered series; 'fields as' and 'values as' point back to an identical list; <NAME> marks a mode.

## proxy_target
0x00 PROXY_TARGET_THREAD_DATA_j — The Proxy Private register contains private information for the proxy thread a and should not be written, writes are ignored. Reads are allowed to know the source thread of the message.
  [9:0] SRC_THR — Proxy source thread of message. Reset Source: rst_mod_g_rst_n
0x04 PROXY_TARGET_THREAD_MESSAGE_j_k rw — The Message Data for proxy thread a. The word with index b = 14 contains the completion final byte.
  [31:0] DATA — Proxy Message Data Reset Source: rst_mod_g_rst_n
