# FSS_OSPI_1_OSPI1_OSPI_DATA_VBP_R3_MAP_000A00000000h register map
Vendor: Texas Instruments
Peripheral module from a debugger description file (folder AM275x).
Registers are 32-bit, read-write, reset 0x0 unless marked. A register's access mark holds for its fields unless they carry their own. Offsets are as the file gives them; lines under a group give offsets from that group; [hi:lo] are bit positions; {n}, {i} and the like mark numbered series; 'fields as' and 'values as' point back to an identical list; <NAME> marks a mode.

## ospi1_ospi_data_vbp_r3_map
0x00 OSPI1_OSPI_DATA_VBP_R3_MAP_OSPI_CORE_MEM_j — OSPI Core bypass memory mapped with Region 3
  [31:0] OSPI_MEM — OSPI Core Mem Reset Source: rst_mod_g_rst_n
