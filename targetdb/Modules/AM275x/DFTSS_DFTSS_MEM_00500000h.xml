# DFTSS_DFTSS_MEM_00500000h register map
Vendor: Texas Instruments
Peripheral module from a debugger description file (folder AM275x).
Registers are 32-bit, read-write, reset 0x0 unless marked. A register's access mark holds for its fields unless they carry their own. Offsets are as the file gives them; lines under a group give offsets from that group; [hi:lo] are bit positions; {n}, {i} and the like mark numbered series; 'fields as' and 'values as' point back to an identical list; <NAME> marks a mode.

## DFTSS_MEM
0x1E0 DFTSS_MEM_PACT access not given — This register is equivalent to pbist active in the PBIST controller
  [0] PACK rw — Enable to start the fail-processing state machine. At reset, diag_clk to all controllers is enabled but it is disabled when 1 is written to this register. If 0 is written to the register at any time, processing of failures stops and the combiner goes idle. Reset Source: vbusp_rst_mod_g_rst_n
0x1E4 DFTSS_MEM_FAIL_DELAY access not given reset 0x48 — This register is equivalent to FDLY in the PBIST controller
  [7:0] FDLY rw — This register makes sure that there is delay between processing fails from different controllers. Reset Source: vbusp_rst_mod_g_rst_n
0x1E8 DFTSS_MEM_PBIST_ID access not given — This register is equivalent to PBIST_ID in the PBIST controller
  [3:0] PBISTID rw — The combiner is treated as a pbist controller. The register is written to when any controllers PBIST_ID registers is written to or when a separate combiners ID is written to. Reset Source: vbusp_rst_mod_g_rst_n
0x1EC DFTSS_MEM_STATUS — This register shows fail status at any time during testing
  [31:0] STATUS — Fail values are loaded into this register based on the MASK0 register. If any bit of MASK0 is set to 0, then the corresponding controllers fail signal is set to 1 in the STATUS register. The size of this register is NO_OF_CTL - 1. This register is accessed as a 32-bit register. On read, unused bits return 0s. Reset Source: vbusp_rst_mod_g_rst_n
0x1F0 DFTSS_MEM_MASK0 reset 0xFFFFFFFF — This register is used to determine which controllers are enabled for datalogging
  [31:0] ENABLE — This register must be programmed before starting any tests. Each bit with a value of 1 in this 32-bit register enables the corresponding controller for datalogging. This register gates all incoming status signals from controllers. At reset all controllers are enabled for datalogging. This register is also used as gating for the vlct_error signal coming from all controllers. The bit mask0[NO_OF_CTL] gates the pbist_ext_err signal of the combiner. The size of this register is NO_OF_CTL. This register is accessed as a 32-bit register Reset Source: vbusp_rst_mod_g_rst_n
0x1F0 DFTSS_MEM_MASK1 reset 0xFFFFFFFF — This register enables PBIST controllers for ROM testing
  [31:0] ENABLE — Must be programmed before kicking off ROM based testing. Each bit with a value of 1 in this 32-bit register enables the corresponding ROM interface. This register gates tmode_pbist_rom signal. At reset all controllers are enabled for ROM-based testing. The size of this register is NO_OF_CTL - 1. This register is accessed as a 32-bit register. On read, unused bits return 0s. Reset Source: vbusp_rst_mod_g_rst_n
0x1F0 DFTSS_MEM_MASK2 — This register enables pbist controllers for VLCT reads
  [31:0] EANBLE — Must be programmed before asserting read for any of the controllers. Each bit with a value of 1 in this 32-bit register enables the read request for the corresponding controller. You can consider the register as one-hot, as only one controller can be read at a time. The size of this register is NO_OF_CTL. The MSB of this register (pbis_mask2[NO_OF_CTL]) is used to read data from the VLCT interface. This register is accessed as a 32-bit register. On read, unused bits return 0s. Reset Source: vbusp_rst_mod_g_rst_n
