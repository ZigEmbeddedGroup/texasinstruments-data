# FSS0_DAT_REG3_000500000000h register map
Vendor: Texas Instruments
Peripheral module from a debugger description file (folder AM275x).
Registers are 32-bit, read-write, reset 0x0 unless marked. A register's access mark holds for its fields unless they carry their own. Offsets are as the file gives them; lines under a group give offsets from that group; [hi:lo] are bit positions; {n}, {i} and the like mark numbered series; 'fields as' and 'values as' point back to an identical list; <NAME> marks a mode.

## dat_reg3
0x00 DAT_REG3_HPB_DATA_MEM_j — FSAS bypass data region3
  [31:0] HPB_DATA — FSAS data region1 Reset Source: rst_mod_g_rst_n
