# wl_phy_mcu_ctx_ram_secure register map
Vendor: Texas Instruments
Peripheral module from a debugger description file (folder CC35X1).
Registers are 32-bit, access not given, no defined reset value unless marked. A register's access mark holds for its fields unless they carry their own. Offsets are as the file gives them; lines under a group give offsets from that group; [hi:lo] are bit positions; {n}, {i} and the like mark numbered series; 'fields as' and 'values as' point back to an identical list; <NAME> marks a mode.

## wl_phy_mcu_ctx_ram_secure
0x00 phy_ctx_ram — PHY Cortex Ram, 24KB ULL. Address Map: 0090_0000:0090_5FFF
