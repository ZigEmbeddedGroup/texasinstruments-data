# NAVSS0_RINGACC_0_ALIAS64K_RINGACC0_SRC_FIFOS register map
Vendor: Texas Instruments
Peripheral module from a debugger description file (folder J721S2).
Registers are 32-bit, read-write, reset 0x0 unless marked. A register's access mark holds for its fields unless they carry their own. Offsets are as the file gives them; lines under a group give offsets from that group; [hi:lo] are bit positions; {n}, {i} and the like mark numbered series; 'fields as' and 'values as' point back to an identical list; <NAME> marks a mode.

## NAVSS0_RINGACC_0_ALIAS64K_RINGACC0_SRC_FIFOS
0x00 ALIAS64K_RINGACC0__SRC__FIFOS_RING_HEAD_DATA — The Ring Head Entry Data Registers contain the data which is to be written or which was read from the ring head. These registers are virtual and non-static (i.e. they are just address locations that are used to access the ring head element for reads or writes. The data is right justified.)
  [31:0] DATA — Block of ring head or tail element data
0x200 ALIAS64K_RINGACC0__SRC__FIFOS_RING_TAIL_DATA — The Ring Tail Entry Data Registers contain the data which is to be written or which was read from the ring tail. These registers are virtual and non-static (i.e. they are just address locations that are used to access the ring tail element for reads or writes. The data is right justified.)
  [31:0] DATA — Block of ring head or tail element data
0x400 ALIAS64K_RINGACC0__SRC__FIFOS_PEEK_HEAD_DATA — The Ring Peek Head Entry Data Registers contain the data which is to be read from the ring head without removing the element. These registers are virtual and non-static (i.e. they are just address locations that are used to access the ring head element for reads. Writes are ignored. The data is right justified.)
  [31:0] DATA — Block of ring head or tail element data. Reserved for rings in ring mode.
0x600 ALIAS64K_RINGACC0__SRC__FIFOS_PEEK_TAIL_DATA — The Ring Peek Tail Entry Data Registers contain the data which is to be read from the ring tail without removing the element. These registers are virtual and non-static (i.e. they are just address locations that are used to access the ring tail element for reads. Writes are ignored. The data is right justified.)
  fields as ALIAS64K_RINGACC0__SRC__FIFOS_PEEK_HEAD_DATA
