# NAVSS0_TIMERMGR_0_TIMERMGR0_CFG_OES register map
Vendor: Texas Instruments
Peripheral module from a debugger description file (folder J721S2).
Registers are 32-bit, read-write, reset 0xFFFF unless marked. A register's access mark holds for its fields unless they carry their own. Offsets are as the file gives them; lines under a group give offsets from that group; [hi:lo] are bit positions; {n}, {i} and the like mark numbered series; 'fields as' and 'values as' point back to an identical list; <NAME> marks a mode.

## NAVSS0_TIMERMGR_0_TIMERMGR0_CFG_OES
0x00 TIMERMGR0__CFG__OES_TIMER_EVENT_INDEX — This programs the event index for a given timer
  [15:0] OES — The event index for a given timer to be used on the output event interface
