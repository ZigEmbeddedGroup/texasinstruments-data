# MCU_NAVSS0_PROXY0_PROXY_CFG_BUF register map
Vendor: Texas Instruments
Peripheral module from a debugger description file (folder J721S2).
Registers are 32-bit, read-write, reset 0x0 unless marked. A register's access mark holds for its fields unless they carry their own. Offsets are as the file gives them; lines under a group give offsets from that group; [hi:lo] are bit positions; {n}, {i} and the like mark numbered series; 'fields as' and 'values as' point back to an identical list; <NAME> marks a mode.

## MCU_NAVSS0_PROXY0_PROXY_CFG_BUF
0x00 PROXY0__CFG__BUF__BUFRAM_SLV__RAM_DATA_REG — The Proxy Buffer for the proxy
  [31:0] DATA — Proxy Buffer Data
