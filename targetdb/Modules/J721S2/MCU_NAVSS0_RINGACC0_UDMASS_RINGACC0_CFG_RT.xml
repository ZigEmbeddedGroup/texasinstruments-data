# MCU_NAVSS0_RINGACC0_UDMASS_RINGACC0_CFG_RT register map
Vendor: Texas Instruments
Peripheral module from a debugger description file (folder J721S2).
Registers are 32-bit, access not given, reset 0x0 unless marked. A register's access mark holds for its fields unless they carry their own. Offsets are as the file gives them; lines under a group give offsets from that group; [hi:lo] are bit positions; {n}, {i} and the like mark numbered series; 'fields as' and 'values as' point back to an identical list; <NAME> marks a mode.

## MCU_NAVSS0_RINGACC0_UDMASS_RINGACC0_CFG_RT
0x10 PAR_UDMASS__RINGACC0_CFG__RT_RT_DB — The Ring N Doorbell Register is written by software to increment or decrement the number of entries on a Ring. One or more entries as specified by the entry_cnt field can be added to a ring with a single write operation.
  [7:0] ENTRY_CNT — Signed number of entries by which to increment the ring occupancy. For normal Tx Ring operation, this value should be a positive number. This occ value for the ring is increased by this value each time the doorbell register is written (occ absolute value will increase or decrease based on the sign of the tentry_cnt). (access NA/W)
0x18 PAR_UDMASS__RINGACC0_CFG__RT_RT_OCC — The Ring N Occupancy Register can be read by software to determine the total number of valid entries on a ring. The contents of each of these registers are unary ORed in order to create a pending signal for the ring which can be used for triggering hardware operations and/or for generating interrupts to the host.
  [20:0] OCC — Total number of valid entries on the ring. This value is generally intended to be incremented by doorbell pokes from software and is decremented by the DMA engine as entries are completed. (access R/NA)
0x1C PAR_UDMASS__RINGACC0_CFG__RT_RT_INDX — The Ring N Current Index Register can be read by software for debug purposes to determine the current SW read index for the Ring for the channel.
  [19:0] INDX — Current SW owned read index for the ring. This value is initialized to 0 when the ring is set up and will be incremented by SW each time SW processes a ring entry. When the index is incremented to a value equal to the size field in the Ring Size Register for the ring the index will be reset back to 0. (access R/NA)
0x20 PAR_UDMASS__RINGACC0_CFG__RT_RT_HWOCC — The Ring N Hardware Occupancy Register contains the early increment/decrement version of the the total number of valid entries on a ring. The contents of each of these registers are unary ORed in order to create a pending signal for the ring which can be used for triggering hardware operations and/or for generating interrupts to the host.
  fields as PAR_UDMASS__RINGACC0_CFG__RT_RT_OCC
0x24 PAR_UDMASS__RINGACC0_CFG__RT_RT_HWINDX — The Ring N Current Index Register can be read by software for debug purposes to determine the current HW read index for the Ring for the channel.
  [19:0] INDX — Current HW owned read index for the ring. This value is initialized to 0 when the ring is set up and will be incremented by HW each time HW processes a ring entry. When the index is incremented to a value equal to the size field in the Ring Size Register for the ring the index will be reset back to 0. (access R/NA)
