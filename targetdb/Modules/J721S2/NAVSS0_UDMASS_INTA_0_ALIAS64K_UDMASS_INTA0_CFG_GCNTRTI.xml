# NAVSS0_UDMASS_INTA_0_ALIAS64K_UDMASS_INTA0_CFG_GCNTRTI register map
Vendor: Texas Instruments
Peripheral module from a debugger description file (folder J721S2).
Registers are 64-bit, access not given, reset 0x0 unless marked. A register's access mark holds for its fields unless they carry their own. Offsets are as the file gives them; lines under a group give offsets from that group; [hi:lo] are bit positions; {n}, {i} and the like mark numbered series; 'fields as' and 'values as' point back to an identical list; <NAME> marks a mode.

## NAVSS0_UDMASS_INTA_0_ALIAS64K_UDMASS_INTA0_CFG_GCNTRTI
0x00 ALIAS64K_UDMASS_INTA0__CFG__GCNTRTI_count — The ETL Count register is read by software to determine how many times the event message has been received. This register can be written to decrement the count by a specified amount to acknowledge that a count has been processed by the host.
  [31:0] CCNT — Current count. This field is incremented by the event count for each message received with this event on the Counted ETL Interface. On write, this field will be decremented by the value written. Writing a value greater than the current count is illegal. (access R/WTD)
