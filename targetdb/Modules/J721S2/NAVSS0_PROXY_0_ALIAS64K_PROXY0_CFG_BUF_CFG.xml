# NAVSS0_PROXY_0_ALIAS64K_PROXY0_CFG_BUF_CFG register map
Vendor: Texas Instruments
Peripheral module from a debugger description file (folder J721S2).
Registers are 32-bit, read-write, reset 0xFFFF unless marked. A register's access mark holds for its fields unless they carry their own. Offsets are as the file gives them; lines under a group give offsets from that group; [hi:lo] are bit positions; {n}, {i} and the like mark numbered series; 'fields as' and 'values as' point back to an identical list; <NAME> marks a mode.

## NAVSS0_PROXY_0_ALIAS64K_PROXY0_CFG_BUF_CFG
0x00 ALIAS64K_PROXY0__CFG__BUF__CFG__CFG_EVT_REG — The Proxy Event for the proxy
  [15:0] ERR_EVENT — Proxy Error Event
