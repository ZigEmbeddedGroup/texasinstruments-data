# COMPUTE_CLUSTER0_GIC500SS_GIC_MESSAGE_BASED_SPIS register map
Vendor: Texas Instruments
Peripheral module from a debugger description file (folder J721S2).
Registers are 32-bit, read-write, reset 0x0 unless marked. A register's access mark holds for its fields unless they carry their own. Offsets are as the file gives them; lines under a group give offsets from that group; [hi:lo] are bit positions; {n}, {i} and the like mark numbered series; 'fields as' and 'values as' point back to an identical list; <NAME> marks a mode.

## COMPUTE_CLUSTER0_GIC500SS_GIC_MESSAGE_BASED_SPIS
0x40 GIC_MESSAGE_BASED_SPIS_Message_based_SPIs__1_GICD_SETSPI_NSR — Non-Secure SPI Set Register
  [9:0] MESSAGE_BASED_SPIS__1_GICD_SETSPI_NSR__0_10
0x48 GIC_MESSAGE_BASED_SPIS_Message_based_SPIs__2_GICD_CLRSPI_NSR — Non-Secure SPI Clear Register
  [9:0] MESSAGE_BASED_SPIS__2_GICD_CLRSPI_NSR__0_10
0x50 GIC_MESSAGE_BASED_SPIS_Message_based_SPIs__3_GICD_SETSPI_SR — Secure SPI Set Register
  [9:0] MESSAGE_BASED_SPIS__3_GICD_SETSPI_SR__0_10
0x58 GIC_MESSAGE_BASED_SPIS_Message_based_SPIs__4_GICD_CLRSPI_SR — Secure SPI Clear Register
  [9:0] MESSAGE_BASED_SPIS__4_GICD_CLRSPI_SR__0_10
