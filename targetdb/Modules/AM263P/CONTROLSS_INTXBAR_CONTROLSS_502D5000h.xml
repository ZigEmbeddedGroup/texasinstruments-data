# CONTROLSS_INTXBAR_CONTROLSS_502D5000h register map
Vendor: Texas Instruments
Peripheral module from a debugger description file (folder AM263P).
Registers are 32-bit, read-write, reset 0x0 unless marked. A register's access mark holds for its fields unless they carry their own. Offsets are as the file gives them; lines under a group give offsets from that group; [hi:lo] are bit positions; {n}, {i} and the like mark numbered series; 'fields as' and 'values as' point back to an identical list; <NAME> marks a mode.

## CONTROLSS
{0x100+0x40*i} CONTROLSS_INTXBAR{i}_G0 (i=0..31) — INT XBAR {i} Input Select.
  [31:0] INTXBAR{i}_G0_SEL — EPWM INT interrupt to corresponding XBAR1:PWMx.INT is selected0:PWMx.INT is de-selected x can have value from 0 to 31 corresponding to each PWM instance
{0x104+0x40*i} CONTROLSS_INTXBAR{i}_G1 (i=0..31) — INT XBAR {i} Input Select.
  [31:0] INTXBAR{i}_G1_SEL — EPWM TZINT interrupt to corresponding XBAR1:PWMx.TZINT is selected0:PWMx.TZINT is de-selected
{0x108+0x40*i} CONTROLSS_INTXBAR{i}_G2 (i=0..31) — INT XBAR {i} Input Select.
  [31:0] INTXBAR{i}_G2_SEL — Corresponding INT XBAR G2 Input SelectBit0:ADC0.INT1Bit1:ADC0.INT2Bit2:ADC0.INT3Bit3:ADC0.INT4Bit4:ADC0.EVTINTBit5:ADC1.INT1Bit6:ADC1.INT2Bit7:ADC1.INT3Bit8:ADC1.INT4Bit9:ADC1.EVTINTBit10:ADC2.INT1Bit11:ADC2.INT2Bit12:ADC2.INT3Bit13:ADC2.INT4Bit14:ADC2.EVTINTBit15:ADC3.INT1Bit16:ADC3.INT2Bit17:ADC3.INT3Bit18:ADC3.INT4Bit19:ADC3.EVTINTBit20:ADC4.INT1Bit21:ADC4.INT2Bit22:ADC4.INT3Bit23:ADC4.INT4Bit24:ADC4.EVTINTBit 2530:ReservedBit31:ASC_AGG0.INT
{0x10C+0x40*i} CONTROLSS_INTXBAR{i}_G3 (i=0..31) — INT XBAR {i} Input Select.
  [15:0] INTXBAR{i}_G3_SEL — Corresponding INT XBAR G3 Input Select0:FSIRX0.INT1N1:FSIRX0.INT2N2:FSIRX1.INT1N3:FSIRX1.INT2N4:FSIRX2.INT1N5:FSIRX2.INT2N6:FSIRX3.INT1N7:FSIRX3.INT2N8:FSITX0.INT1N9:FSITX0.INT2N10:FSITX1.INT1N11:FSITX1.INT2N12:FSITX2.INT1N13:FSITX2.INT2N14:FSITX3.INT1N15:FSITX3.INT2N
{0x110+0x40*i} CONTROLSS_INTXBAR{i}_G4 (i=0..31) — INT XBAR {i} Input Select.
  [9:0] INTXBAR{i}_G4_SEL — Corresponding INT XBAR G4 Input Select0:SD0.ERR1:SD0.FILT1.DRINT2:SD0.FILT2.DRINT3:SD0.FILT3.DRINT4:SD0.FILT4.DRINT5:SD1.ERR6:SD1.FILT1.DRINT7:SD1.FILT2.DRINT8:SD1.FILT3.DRINT9:SD1.FILT4.DRINT
{0x114+0x40*i} CONTROLSS_INTXBAR{i}_G5 (i=0..31) — INT XBAR {i} Input Select.
  [15:0] INTXBAR{i}_G5_SEL — Corresponding INT XBAR G5 Input Select0:ECAP0.INT1:ECAP1.INT2:ECAP2.INT3:ECAP3.INT4:ECAP4.INT5:ECAP5.INT6:ECAP6.INT7:ECAP7.INT8:ECAP8.INT9:ECAP9.INT10:ECAP10.INT11:ECAP11.INT12:ECAP12.INT13:ECAP13.INT14:ECAP14.INT15:ECAP15.INT
{0x118+0x40*i} CONTROLSS_INTXBAR{i}_G6 (i=0..31) — INT XBAR {i} Input Select.
  [2:0] INTXBAR{i}_G6_SEL — Corresponding INT XBAR G6 Input Select0:EQEP0.INT1:EQEP1.INT2:EQEP2.INT
{0x11C+0x40*i} CONTROLSS_INTXBAR{i}_G7 (i=0..31) — INT XBAR {i} Input Select.
  [9:0] INTXBAR{i}_G7_SEL — Corresponding INT XBAR G7 Input SelectBit0:ADCR0.INT1Bit1:ADCR0.INT2Bit2:ADCR0.INT3Bit3:ADCR0.INT4Bit4:ADCR0.EVTINTBit5:ADCR1.INT1Bit6:ADCR1.INT2Bit7:ADCR1.INT3Bit8:ADCR1.INT4Bit9:ADCR1.EVTINTBit 1031:Reserved
{0x120+0x40*i} CONTROLSS_INTXBAR{i}_G8 (i=0..31) — INT XBAR {i} Input Select.
  [19:0] INTXBAR{i}_G8_SEL — Corresponding INT XBAR G8 Input Select0:CMP12SSA0.CTRIPL1:CMP12SSA0.CTRIPH2:CMP12SSA1.CTRIPL3:CMP12SSA1.CTRIPH4:CMP12SSA2.CTRIPL5:CMP12SSA2.CTRIPH6:CMP12SSA3.CTRIPL7:CMP12SSA3.CTRIPH8:CMP12SSA4.CTRIPL9:CMP12SSA4.CTRIPH10:CMP12SSA5.CTRIPL11:CMP12SSA5.CTRIPH12:CMP12SSA6.CTRIPL13:CMP12SSA6.CTRIPH14:CMP12SSA7.CTRIPL15:CMP12SSA7.CTRIPH16:CMP12SSA8.CTRIPL17:CMP12SSA8.CTRIPH18:CMP12SSA9.CTRIPL19:CMP12SSA9.CTRIPH
{0x124+0x40*i} CONTROLSS_INTXBAR{i}_G9 (i=0..31) — INT XBAR {i} Input Select.
  [19:0] INTXBAR{i}_G9_SEL — Corresponding INT XBAR G9 Input Select0:CMP12SSB0.CTRIPL1:CMP12SSB0.CTRIPH2:CMP12SSB1.CTRIPL3:CMP12SSB1.CTRIPH4:CMP12SSB2.CTRIPL5:CMP12SSB2.CTRIPH6:CMP12SSB3.CTRIPL7:CMP12SSB3.CTRIPH8:CMP12SSB4.CTRIPL9:CMP12SSB4.CTRIPH10:CMP12SSB5.CTRIPL11:CMP12SSB5.CTRIPH12:CMP12SSB6.CTRIPL13:CMP12SSB6.CTRIPH14:CMP12SSB7.CTRIPL15:CMP12SSB7.CTRIPH16:CMP12SSB8.CTRIPL17:CMP12SSB8.CTRIPH18:CMP12SSB9.CTRIPL19:CMP12SSB9.CTRIPH
