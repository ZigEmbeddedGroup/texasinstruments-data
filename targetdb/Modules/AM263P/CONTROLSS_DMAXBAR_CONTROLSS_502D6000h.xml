# CONTROLSS_DMAXBAR_CONTROLSS_502D6000h register map
Vendor: Texas Instruments
Peripheral module from a debugger description file (folder AM263P).
Registers are 32-bit, read-write, reset 0x0 unless marked. A register's access mark holds for its fields unless they carry their own. Offsets are as the file gives them; lines under a group give offsets from that group; [hi:lo] are bit positions; {n}, {i} and the like mark numbered series; 'fields as' and 'values as' point back to an identical list; <NAME> marks a mode.

## CONTROLSS
{0x100+0x40*i} CONTROLSS_DMAXBAR{i}_GSEL (i=0..15) — DMA XBAR{i} Input Select.
  [2:0] DMAXBAR{i}_GSEL_GSEL — Select input source:0:G0 selected..6:G6 selected
{0x104+0x40*i} CONTROLSS_DMAXBAR{i}_G0 (i=0..15) — DMA XBAR{i} Input Select.
  [4:0] DMAXBAR{i}_G0_SEL — EPWM SOCA to corresponding XBAR0:PWM0.SOCA is selected 1:PWM1.SOCA is selected . . 31:PWM31.SOCA is selected
{0x108+0x40*i} CONTROLSS_DMAXBAR{i}_G1 (i=0..15) — DMA XBAR{i} Input Select.
  [4:0] DMAXBAR{i}_G1_SEL — EPWM SOCB to corresponding XBAR0:PWM0.SOCB is selected 1:PWM1.SOCB is selected . . 31:PWM31.SOCB is selected
{0x10C+0x40*i} CONTROLSS_DMAXBAR{i}_G2 (i=0..15) — DMA XBAR{i} Input Select.
  [4:0] DMAXBAR{i}_G2_SEL — ADC DMA requests to corresponding XBAR0:ADC0.INT11:ADC0.INT22:ADC0.INT33:ADC0.INT44:ADC0.EVTINT5:ADC1.INT16:ADC1.INT27:ADC1.INT38:ADC1.INT49:ADC1.EVTINT10:ADC2.INT111:ADC2.INT212:ADC2.INT313:ADC2.INT414:ADC2.EVTINT15:ADC3.INT116:ADC3.INT217:ADC3.INT318:ADC3.INT419:ADC3.EVTINT20:ADC4.INT121:ADC4.INT222:ADC4.INT323:ADC4.INT424:ADC4.EVTINT
{0x110+0x40*i} CONTROLSS_DMAXBAR{i}_G3 (i=0..15) — DMA XBAR{i} Input Select.
  [3:0] DMAXBAR{i}_G3_SEL — FSI DMA requests to corresponding XBAR0:FSIRX0.RX_DMA_EVT1; FSIRX0_RX_data_tag_match2:FSIRX0_RX_ping_tag_match3:FSIRX1.RX_DMA_EVT4; FSIRX1_RX_data_tag_match5:FSIRX1_RX_ping_tag_match6:FSIRX2.RX_DMA_EVT7; FSIRX2_RX_data_tag_match8:FSIRX2_RX_ping_tag_match9:FSIRX3.RX_DMA_EVT10; FSIRX3_RX_data_tag_match11:FSIRX3_RX_ping_tag_match12:FSITX0.TX_DMA_EVT13:FSITX1.TX_DMA_EVT14:FSITX2.TX_DMA_EVT15:FSITX3.TX_DMA_EVT
{0x114+0x40*i} CONTROLSS_DMAXBAR{i}_G4 (i=0..15) — DMA XBAR{i} Input Select.
  [2:0] DMAXBAR{i}_G4_SEL — SDFM DMA requests to corresponding XBAR0:SD0.FILT1.DRINT1:SD0.FILT2.DRINT2:SD0.FILT3.DRINT3:SD0.FILT4.DRINT4:SD1.FILT1.DRINT5:SD1.FILT2.DRINT6:SD1.FILT3.DRINT7:SD1.FILT4.DRINT
{0x118+0x40*i} CONTROLSS_DMAXBAR{i}_G5 (i=0..15) — DMA XBAR{i} Input Select.
  [3:0] DMAXBAR{i}_G5_SEL — ECAP DMA requests to corresponding XBAR0:ECAP0.DMA_INT1:ECAP1.DMA_INT2:ECAP2.DMA_INT3:ECAP3.DMA_INT4:ECAP4.DMA_INT5:ECAP5.DMA_INT6:ECAP6.DMA_INT7:ECAP7.DMA_INT8:ECAP8.DMA_INT9:ECAP9.DMA_INT10:ECAP10.DMA_INT 11:ECAP11.DMA_INT12:ECAP12.DMA_INT13:ECAP13.DMA_INT14:ECAP14.DMA_INT15:ECAP15.DMA_INT
{0x11C+0x40*i} CONTROLSS_DMAXBAR{i}_G6 (i=0..15) — DMA XBAR{i} Input Select.
  [3:0] DMAXBAR{i}_G6_SEL — ADC_R DMA requests to corresponding XBAR0:ADCR0.INT11:ADCR0.INT22:ADCR0.INT33:ADCR0.INT44:ADCR0.EVTINT5:ADCR1.INT16:ADCR1.INT27:ADCR1.INT38:ADCR1.INT49:ADCR1.EVTINT
