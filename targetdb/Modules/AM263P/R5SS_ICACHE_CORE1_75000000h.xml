# R5SS_ICACHE_CORE1_75000000h register map
Vendor: Texas Instruments
Peripheral module from a debugger description file (folder AM263P).
Registers are 32-bit, read-write, reset 0x0 unless marked. A register's access mark holds for its fields unless they carry their own. Offsets are as the file gives them; lines under a group give offsets from that group; [hi:lo] are bit positions; {n}, {i} and the like mark numbered series; 'fields as' and 'values as' point back to an identical list; <NAME> marks a mode.

## ICACHE_CORE1
0x00 ICACHE_CORE1_START
  [31:0] START — Memory start address
0x7FFFFC ICACHE_CORE1_END
  [31:0] END — Memory end address
