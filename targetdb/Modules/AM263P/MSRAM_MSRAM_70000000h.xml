# MSRAM_MSRAM_70000000h register map
Vendor: Texas Instruments
Peripheral module from a debugger description file (folder AM263P).
Registers are 32-bit, read-write, reset 0x0 unless marked. A register's access mark holds for its fields unless they carry their own. Offsets are as the file gives them; lines under a group give offsets from that group; [hi:lo] are bit positions; {n}, {i} and the like mark numbered series; 'fields as' and 'values as' point back to an identical list; <NAME> marks a mode.

## MSRAM
0x00 MSRAM_START — L2 Memory start address.
  [31:0] START — L2 Memory start address
0x7FFFC MSRAM_END — L2 Memory end address.
  [31:0] END — L2 Memory end address
