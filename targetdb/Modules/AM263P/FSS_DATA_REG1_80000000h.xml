# FSS_DATA_REG1_80000000h register map
Vendor: Texas Instruments
Peripheral module from a debugger description file (folder AM263P).
Registers are 32-bit, read-write, reset 0x0 unless marked. A register's access mark holds for its fields unless they carry their own. Offsets are as the file gives them; lines under a group give offsets from that group; [hi:lo] are bit positions; {n}, {i} and the like mark numbered series; 'fields as' and 'values as' point back to an identical list; <NAME> marks a mode.

## DATA_REG1
0x00 DATA_REG1_HPB_DATA_MEM_j — FSAS boot data region1.
  [31:0] HPB_DATA — FSAS data region1
