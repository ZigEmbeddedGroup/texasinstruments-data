# ICSSM_ICSSM_PR1_PDSP1_IRAM_DEBUG_48024400h register map
Vendor: Texas Instruments
Peripheral module from a debugger description file (folder AM263P).
Registers are 32-bit, read-write, reset 0x0 unless marked. A register's access mark holds for its fields unless they carry their own. Offsets are as the file gives them; lines under a group give offsets from that group; [hi:lo] are bit positions; {n}, {i} and the like mark numbered series; 'fields as' and 'values as' point back to an identical list; <NAME> marks a mode.

## ICSSM_PR1_PDSP1_IRAM_DEBUG
0x00 ICSSM_PR1_PDSP1_IRAM_DEBUG_IGP_j — PDSP Internal General Purpose Register.
  [31:0] REGN — PDSP Internal GP Register N
0x80 ICSSM_PR1_PDSP1_IRAM_DEBUG_ICTE_j ro — PDSP Internal Contants Table Entry Register.
  [31:0] CT_ENTRYN — PDSP Internal Constants Table Entry N
