# RESTORE_CM_CORE register map
Vendor: Texas Instruments
Peripheral module from a debugger description file (folder DM50x).
Registers are 32-bit, read-write, reset 0x0 unless marked. A register's access mark holds for its fields unless they carry their own. Offsets are as the file gives them; lines under a group give offsets from that group; [hi:lo] are bit positions; {n}, {i} and the like mark numbered series; 'fields as' and 'values as' point back to an identical list; <NAME> marks a mode.

## RESTORE_CM_CORE
0x00 CM_L3MAIN1_CLKSTCTRL_RESTORE — Second address map for register. Used only by automatic restore upon wakeup from device OFF mode.
  [31:0] RESTORE — SeeCM_L3MAIN1_CLKSTCTRL register.
0x08 CM_L4CFG_CLKSTCTRL_RESTORE — Second address map for register. Used only by automatic restore upon wakeup from device OFF mode.
  [31:0] RESTORE — See CM_L4CFG_CLKSTCTRLregister.
0x10 CM_L4PER_CLKSTCTRL_RESTORE — Second address map for register. Used only by automatic restore upon wakeup from device OFF mode.
  [31:0] RESTORE — SeeCM_L4PER_CLKSTCTRL register.
0x14 CM_L3INIT_CLKSTCTRL_RESTORE — Second address map for register. Used only by automatic restore upon wakeup from device OFF mode.
  [31:0] RESTORE — SeeCM_L3INIT_CLKSTCTRL register.
0x18 CM_L3INSTR_L3_MAIN_2_CLKCTRL_RESTORE reset 0x30001 — Second address map for register. Used only by automatic restore upon wakeup from device OFF mode. [warm reset insensitive]
  [31:0] RESTORE — See CM_L3INSTR_L3_MAIN_3_CLKCTRL register.
0x1C CM_L3INSTR_L3_INSTR_CLKCTRL_RESTORE reset 0x30001 — Second address map for register. Used only by automatic restore upon wakeup from device OFF mode. [warm reset insensitive]
  [31:0] RESTORE — SeeCM_L3INSTR_L3_INSTR_CLKCTRL register.
0x20 CM_L3INSTR_OCP_WP_NOC_CLKCTRL_RESTORE reset 0x30001 — Second address map for register. Used only by automatic restore upon wakeup from device OFF mode. [warm reset insensitive]
  [31:0] RESTORE — SeeCM_L3INSTR_OCP_WP_NOC_CLKCTRL register.
0x24 CM_CM_CORE_PROFILING_CLKCTRL_RESTORE reset 0x30001 — Second address map for register. Used only by automatic restore upon wakeup from device OFF mode. [warm reset insensitive]
  [31:0] RESTORE — SeeCM_CM_CORE_PROFILING_CLKCTRL register.
0x30 CM_L3MAIN1_DYNAMICDEP_RESTORE reset 0x4001058 — Second address map for register. Used only by automatic restore upon wakeup from device OFF mode.
  [31:0] RESTORE — SeeCM_L3MAIN1_DYNAMICDEP register.
0x40 CM_L4CFG_DYNAMICDEP_RESTORE reset 0x40789F2 — Second address map for register. Used only by automatic restore upon wakeup from device OFF mode.
  [31:0] RESTORE — SeeCM_L4CFG_DYNAMICDEP register.
0x44 CM_L4PER_DYNAMICDEP_RESTORE reset 0x4004180 — Second address map for register. Used only by automatic restore upon wakeup from device OFF mode.
  [31:0] RESTORE — SeeCM_L4PER_DYNAMICDEP register.
0x48 CM_COREAON_IO_SRCOMP_CLKCTRL_RESTORE reset 0x20 — Second address map for register CM_COREAON_IO_SRCOMP_CLKCTRL. Used only by automatic restore upon wakeup from device OFF mode.
  [31:0] RESTORE — See CCM_DYN_DEP_PRESCAL register.
0x54 CM_DMA_STATICDEP_RESTORE reset 0xB0F0 — Second address map for register CM_DMA_STATICDEP. Used only by automatic restore upon wakeup from device OFF mode.
  [31:0] RESTORE — See CM_DMA_STATICDEP register.
