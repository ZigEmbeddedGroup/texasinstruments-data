# RESTORE_CM_CORE_AON register map
Vendor: Texas Instruments
Peripheral module from a debugger description file (folder DM50x).
Registers are 32-bit, read-write, reset 0x4 unless marked. A register's access mark holds for its fields unless they carry their own. Offsets are as the file gives them; lines under a group give offsets from that group; [hi:lo] are bit positions; {n}, {i} and the like mark numbered series; 'fields as' and 'values as' point back to an identical list; <NAME> marks a mode.

## RESTORE_CM_CORE_AON
0x00 CM_CLKSEL_CORE_RESTORE reset 0x0 — Second address map for register. Used only by automatic restore upon wakeup from device OFF mode.
  [31:0] RESTORE — SeeCM_CLKSEL_CORE register.
0x04 CM_DIV_M2_DPLL_CORE_RESTORE reset 0x1 — Second address map for register. Used only by automatic restore upon wakeup from device OFF mode.
  [31:0] RESTORE — SeeCM_DIV_M2_DPLL_CORE register.
0x08 CM_DIV_M3_DPLL_CORE_RESTORE reset 0x1 — Second address map for register CM_DIV_M3_DPLL_CORE. Used only by automatic restore upon wakeup from device OFF mode.
  [31:0] RESTORE — See CM_DIV_M3_DPLL_CORE register.
0x0C CM_DIV_H11_DPLL_CORE_RESTORE — Second address map for register CM_DIV_H11_DPLL_CORE. Used only by automatic restore upon wakeup from device OFF mode.
  [31:0] RESTORE — See CM_DIV_H11_DPLL_CORE register.
0x10 CM_DIV_H12_DPLL_CORE_RESTORE — Second address map for register. Used only by automatic restore upon wakeup from device OFF mode.
  [31:0] RESTORE — SeeCM_DIV_H12_DPLL_CORE register.
0x14 CM_DIV_H13_DPLL_CORE_RESTORE — Second address map for register CM_DIV_H13_DPLL_CORE. Used only by automatic restore upon wakeup from device OFF mode.
  [31:0] RESTORE — SeeCM_DIV_H12_DPLL_CORE register.
0x18 CM_DIV_H14_DPLL_CORE_RESTORE — Second address map for register. Used only by automatic restore upon wakeup from device OFF mode.
  [31:0] RESTORE — SeeCM_DIV_H14_DPLL_CORE register.
0x1C CM_DIV_H21_DPLL_CORE_RESTORE — Second address map for register CM_DIV_H21_DPLL_CORE. Used only by automatic restore upon wakeup from device OFF mode.
  [31:0] RESTORE — See CM_DIV_H21_DPLL_CORE register.
0x20 CM_DIV_H22_DPLL_CORE_RESTORE — Second address map for register. Used only by automatic restore upon wakeup from device OFF mode.
  [31:0] RESTORE — SeeCM_DIV_H22_DPLL_CORE register.
0x24 CM_DIV_H23_DPLL_CORE_RESTORE reset 0x8 — Second address map for register. Used only by automatic restore upon wakeup from device OFF mode.
  [31:0] RESTORE — SeeCM_DIV_H23_DPLL_CORE register.
0x28 CM_DIV_H24_DPLL_CORE_RESTORE reset 0x8 — Second address map for register. Used only by automatic restore upon wakeup from device OFF mode.
  [31:0] RESTORE — SeeCM_DIV_H24_DPLL_CORE register.
0x2C CM_CLKSEL_DPLL_CORE_RESTORE reset 0x0 — Second address map for register. Used only by automatic restore upon wakeup from device OFF mode.
  [31:0] RESTORE — SeeCM_CLKSEL_DPLL_CORE register.
0x30 CM_SSC_DELTAMSTEP_DPLL_CORE_RESTORE reset 0x0 — Second address map for register CM_SSC_DELTAMSTEP_DPLL_CORE. Used only by automatic restore upon wakeup from device OFF mode. [warm reset insensitive]
  [31:0] RESTORE — See CM_SSC_DELTAMSTEP_DPLL_CORE register.
0x34 CM_SSC_MODFREQDIV_DPLL_CORE_RESTORE reset 0x0 — Second address map for register CM_SSC_MODFREQDIV_DPLL_CORE. Used only by automatic restore upon wakeup from device OFF mode. [warm reset insensitive]
  [31:0] RESTORE — See CM_SSC_MODFREQDIV_DPLL_CORE register.
0x38 CM_CLKMODE_DPLL_CORE_RESTORE — Second address map for register. Used only by automatic restore upon wakeup from device OFF mode.
  [31:0] RESTORE — SeeCM_CLKMODE_DPLL_CORE register.
0x3C CM_SHADOW_FREQ_CONFIG2_RESTORE reset 0x20 — Second address map for register. Used only by automatic restore upon wakeup from device OFF mode.
  [31:0] RESTORE — SeeCM_SHADOW_FREQ_CONFIG2 register.
0x40 CM_SHADOW_FREQ_CONFIG1_RESTORE reset 0xC0C — Second address map for register. Used only by automatic restore upon wakeup from device OFF mode.
  [31:0] RESTORE — SeeCM_SHADOW_FREQ_CONFIG1 register.
0x44 CM_AUTOIDLE_DPLL_CORE_RESTORE reset 0x0 — Second address map for register. Used only by automatic restore upon wakeup from device OFF mode.
  [31:0] RESTORE — See CM_AUTOIDLE_DPLL_COREregister.
0x48 CM_MPU_CLKSTCTRL_RESTORE reset 0x0 — Second address map for register CM_MPU_CLKSTCTRL. Used only by automatic restore upon wakeup from device OFF mode.
  [31:0] RESTORE — See CM_MPU_CLKSTCTRL register.
0x4C CM_CM_CORE_AON_PROFILING_CLKCTRL_RESTORE reset 0x30001 — Second address map for register. Used only by automatic restore upon wakeup from device OFF mode. [warm reset insensitive]
  [31:0] RESTORE — SeeCM_CM_CORE_AON_PROFILING_CLKCTRL register.
0x50 CM_DYN_DEP_PRESCAL_RESTORE reset 0x20 — Second address map for register. Used only by automatic restore upon wakeup from device OFF mode.
  [31:0] RESTORE — See CCM_DYN_DEP_PRESCAL register.
