# TESOC register map
Vendor: Texas Instruments
Peripheral module from a debugger description file (folder DM50x).
Registers are 32-bit, read-write, reset 0x0 unless marked. A register's access mark holds for its fields unless they carry their own. Offsets are as the file gives them; lines under a group give offsets from that group; [hi:lo] are bit positions; {n}, {i} and the like mark numbered series; 'fields as' and 'values as' point back to an identical list; <NAME> marks a mode.

## TESOC
0x00 TESOC_IP_REVISION ro reset not defined — IP Revision Information
  [31:0] IP_REVISION
0x10 TESOC_IP_HWINFO ro — IP Hardware Information
  [31:0] IP_HWINFO
0x20 TESOC_IP_SYSCONFIG
  [31:0] IP_SYSCONFIG
0x80 TESOC_INTR_EOI — End Of Interrupt register - Interrupt handler
  [31:0] INTR_EOI — Write the number of the interrupt line to apply a SW EOI to it. Note that there is only a single line (i.e. number 0). Read : Read always returns 0 Write 0 : SW EOI on interrupt line Write 1 : No action
0x90 TESOC_INTR_STATUS_RAW_SET — Set Interrupt Status Raw register
  [31:0] INTR_STATUS_RAW_SET — Settable raw status for interrupt event. For each bit of the bit field: Read 0: No event pending Read 1: Event is pending Write 0: No action Write 1: Set event (debug)
0xA0 TESOC_INTR_STATUS_ENABLED_CLEAR — This register contains status flags of the enabled interrupts.
  [31:0] INTR_STATUS_ENABLED_CLEAR — Interrupt Enabled Status. Read indicates enabled status. Read 0x0: No interrupt Read 0x1: Interrupt pending Write 0: No action Write 1: Clears the interrupt status flag. The corresponding raw status flag is also cleared.
0xB0 TESOC_INTR_ENABLE_SET — Interrupt enable register
  [31:0] INTR_ENABLE_SET — Read 0x0: Interrupt is disabled Read 0x1: Interrupt is enabled Write: 0x0: No action Write 0x1: Enables the interrupt
0xC0 TESOC_INTR_ENABLE_CLEAR — Interrupt clear register
  [31:0] INTR_ENABLE_CLEAR — Read 0x0: Interrupt is disabled Read 0x1: Interrupt is enabled Write: 0x0: No action Write 0x1: Clears the interrupt
0xD0 TESOC_LOCK access per field reset 0x5 — LOCK Register.
  [3:0] LOCK rw — Lock feature prevents unintentional updates to TESOC registers. Writes to TESOC registers are be possible only when TESOC registers are unlocked by writing 0xA to LOCK key bits ofTESOC_LOCK register. On reset, these bits are be set to 0x5 and hence the TESOC registers are be in the locked state. There is no built in protection based on master ID. It is the responsibility of the user to ensure that only a single valid master updates the TESOC registers. A value of 4'b0101 indicates that TESOC Configuration Registers are locked for write access. Default value is locked. To unlock, a value 4'b1010 must be written. 0x5: Locked 0xA: Unlocked
0xE0 TESOC_ABORT access per field — ABORT Register.
  [3:0] ABORT rw — This has to be written into by the software to abort field-test immediately and transfer control on test module to application. General usage cases are, if an interrupt is registered that needs the module being tested, software can write into this bitfield to stop field-test. A write with value of 4'b0101 creates an ABORT condition for TESOC. On seeing this, HW stops execution the slice sequence and raises the interrupt. This register is cleared by HW. 0x5: Abort
0xF0 TESOC_BUSY ro — BUSY Register.
  [3:0] BUSY — During BUSY state: . Software has to poll the register before sending any configuration command OR data to TESOC. It can do so only when TESOC is not busy. 0x5: Busy 0x0: Not busy Other values: Not busy
{0x110+0x10*i} TESOC_DIAG_INFO_{i}_i_0 (i=0..15) — Error Diagnostics Information Register bank
  [31:0] DIAG_INFO_{i} — See
{0x114+0x10*i} TESOC_DIAG_INFO_{i}_i_1 (i=0..15) — Error Diagnostics Information Register bank
  [31:0] DIAG_INFO_{i} — See
{0x118+0x10*i} TESOC_DIAG_INFO_{i}_i_2 (i=0..15) — Error Diagnostics Information Register bank
  [31:0] DIAG_INFO_{i} — See
{0x11C+0x10*i} TESOC_DIAG_INFO_{i}_i_3 (i=0..15) — Error Diagnostics Information Register bank
  [31:0] DIAG_INFO_{i} — See
0x210 TESOC_DOMAIN_EN_DOM0 access per field — Start Domain Register for domain PD_IPU.
  [0] START_DOMAIN rw — This bitfield indicates that a particular processor can be moved into field-test mode. This is needed more from a safety purpose and to have multiple levels of checks to avoid any false trigger of field-test on the processor. A field-test can be triggered on a processor by writing both TESOC_SLICE_CONFIG_DOM0 andTESOC_DOMAIN_EN_DOM0 registers. 0x0: Field test for domain PD_IPU is disabled 0x1: Field test for domain PD_IPU is enabled This bitfield is HW cleared once the field test is started.
0x220 TESOC_DOMAIN_EN_DOM1 access per field — Start Domain Register for domain PD_EVE1.
  [0] START_DOMAIN rw — This bitfield indicates that a particular processor can be moved into field-test mode. This is needed more from a safety purpose and to have multiple levels of checks to avoid any false trigger of field-test on the processor. A field-test can be triggered on a processor by writing both TESOC_SLICE_CONFIG_DOM1 andTESOC_DOMAIN_EN_DOM1 registers. 0x0: Field test for domain PD_EVE1 is disabled 0x1: Field test for domain PD_EVE1 is enabled This bitfield is HW cleared once the field test is started.
0x230 TESOC_DOMAIN_EN_DOM2 access per field — Start Domain Register for domain PD_DSP1.
  [0] START_DOMAIN rw — This bitfield indicates that a particular processor can be moved into field-test mode. This is needed more from a safety purpose and to have multiple levels of checks to avoid any false trigger of field-test on the processor. A field-test can be triggered on a processor by writing both TESOC_SLICE_CONFIG_DOM2 andTESOC_DOMAIN_EN_DOM2 registers. 0x0: Field test for domain PD_DSP1 is disabled 0x1: Field test for domain PD_DSP1 is enabled This bitfield is HW cleared once the field test is started.
0x240 TESOC_DOMAIN_EN_DOM3 access per field — Start Domain Register for domain PD_DSP2.
  [0] START_DOMAIN rw — This bitfield indicates that a particular processor can be moved into field-test mode. This is needed more from a safety purpose and to have multiple levels of checks to avoid any false trigger of field-test on the processor. A field-test can be triggered on a processor by writing both TESOC_SLICE_CONFIG_DOM3 andTESOC_DOMAIN_EN_DOM3 registers. 0x0: Field test for domain PD_DSP2 is disabled 0x1: Field test for domain PD_DSP2 is enabled This bitfield is HW cleared once the field test is started.
0x250 TESOC_DOMAIN_EN_DOM4 access per field — Start Domain Register for domains PD_ISS and PD_DSS.
  [0] START_DOMAIN rw — This bitfield indicates that a particular processor can be moved into field-test mode. This is needed more from a safety purpose and to have multiple levels of checks to avoid any false trigger of field-test on the processor. A field-test can be triggered on a processor by writing both TESOC_SLICE_CONFIG_DOM4 andTESOC_DOMAIN_EN_DOM4 registers. 0x0: Field test for domains PD_ISS and PD_DSS is disabled 0x1: Field test for domains PD_ISS and PD_DSS is enabled This bitfield is HW cleared once the field test is started.
{0x260+4i} TESOC_SLICE_CONFIG_DOM0_n_{i} (i=0..7) — Slice Configuration Register 1: Slice at bit position enabled 0: Slice at bit position disabled
  [31:0] CONFIG_REG_21_DOM0 — One bit per slice. Software has to write into this register to run the slices required. Multiple bits can be written to indicate the slices that need to be run in one go back to back. TESOC starts running slices from LSB to MSB. There is no flexibility to run higher slice first. (256 bits per domain)
{0x280+4i} TESOC_SLICE_CONFIG_DOM1_n_{i} (i=0..7) — Slice Configuration Register 1: Slice at bit position enabled 0: Slice at bit position disabled
  [31:0] CONFIG_REG_21_DOM1 — One bit per slice. Software has to write into this register to run the slices required. Multiple bits can be written to indicate the slices that need to be run in one go back to back. TESOC starts running slices from LSB to MSB. There is no flexibility to run higher slice first. (256 bits per domain)
{0x2A0+4i} TESOC_SLICE_CONFIG_DOM2_n_{i} (i=0..7) — Slice Configuration Register 1: Slice at bit position enabled 0: Slice at bit position disabled
  [31:0] CONFIG_REG_21_DOM2 — One bit per slice. Software has to write into this register to run the slices required. Multiple bits can be written to indicate the slices that need to be run in one go back to back. TESOC starts running slices from LSB to MSB. There is no flexibility to run higher slice first. (256 bits per domain)
{0x2C0+4i} TESOC_SLICE_CONFIG_DOM3_n_{i} (i=0..7) — Slice Configuration Register 1: Slice at bit position enabled 0: Slice at bit position disabled
  [31:0] CONFIG_REG_21_DOM3 — One bit per slice. Software has to write into this register to run the slices required. Multiple bits can be written to indicate the slices that need to be run in one go back to back. TESOC starts running slices from LSB to MSB. There is no flexibility to run higher slice first. ( 256 bits per domain)
{0x2E0+4i} TESOC_SLICE_CONFIG_DOM4_n_{i} (i=0..7) — Slice Configuration Register 1: Slice at bit position enabled 0: Slice at bit position disabled
  [31:0] CONFIG_REG_21_DOM4 — One bit per slice. Software has to write into this register to run the slices required. Multiple bits can be written to indicate the slices that need to be run in one go back to back. TESOC starts running slices from LSB to MSB. There is no flexibility to run higher slice first. (256 bits per domain)
{0x300+4i} TESOC_SLICE_STATUS_DOM0_n_{i} (i=0..7) — Slice Completion Status Register 1: Slice at bit position completed execution 0: Slice at bit position not completed execution
  [31:0] CONFIG_REG_22_DOM0 — One bit per slice. This is the status bitfield written by TESOC module. This indicates if the slices configured by software have been successfully completed. This only indicates if the slice was completely run, without being stopped due to Abort OR any other reasons. This does not indicate if the slice has passed OR failed. (256 bits per domain)
{0x320+4i} TESOC_SLICE_STATUS_DOM1_n_{i} (i=0..7) — Slice Completion Status Register 1: Slice at bit position completed execution 0: Slice at bit position not completed execution
  [31:0] CONFIG_REG_22_DOM1 — One bit per slice. This is the status bitfield written by TESOC module. This indicates if the slices configured by software have been successfully completed. This only indicates if the slice was completely run, without being stopped due to Abort OR any other reasons. This does not indicate if the slice has passed OR failed. (256 bits per domain)
{0x340+4i} TESOC_SLICE_STATUS_DOM2_n_{i} (i=0..7) — Slice Completion Status Register 1: Slice at bit position completed execution 0: Slice at bit position not completed execution
  [31:0] CONFIG_REG_22_DOM2 — One bit per slice. This is the status bitfield written by TESOC module. This indicates if the slices configured by software have been successfully completed. This only indicates if the slice was completely run, without being stopped due to Abort OR any other reasons. This does not indicate if the slice has passed OR failed. (256 bits per domain)
{0x360+4i} TESOC_SLICE_STATUS_DOM3_n_{i} (i=0..7) — Slice Completion Status Register 1: Slice at bit position completed execution 0: Slice at bit position not completed execution
  [31:0] CONFIG_REG_22_DOM3 — One bit per slice. This is the status bitfield written by TESOC module. This indicates if the slices configured by software have been successfully completed. This only indicates if the slice was completely run, without being stopped due to Abort OR any other reasons. This does not indicate if the slice has passed OR failed. (256 bits per domain)
{0x380+4i} TESOC_SLICE_STATUS_DOM4_n_{i} (i=0..7) — Slice Completion Status Register 1: Slice at bit position completed execution 0: Slice at bit position not completed execution
  [31:0] CONFIG_REG_22_DOM4 — One bit per slice. This is the status bitfield written by TESOC module. This indicates if the slices configured by software have been successfully completed. This only indicates if the slice was completely run, without being stopped due to Abort OR any other reasons. This does not indicate if the slice has passed OR failed. (256 bits per domain)
{0x3A0+4i} TESOC_SLICE_RESULT_DOM0_n_{i} (i=0..7) — Slice Result Register 1: Slice at bit position PASSED 0: Slice at bit position FAILED
  [31:0] CONFIG_REG_23_DOM0 — One bit per slice. This is the status register written by TESOC module. This register indicates if the slices configured by software have passed OR failed. '1' indicates pass and '0' indicates fail. Software has to first readTESOC_SLICE_STATUS_DOM0_n to check if slice was completely run and then read this register to check pass/fail status. Default value of this register is '1'. (256 bits per domain)
{0x3C0+4i} TESOC_SLICE_RESULT_DOM1_n_{i} (i=0..7) — Slice Result Register 1: Slice at bit position PASSED 0: Slice at bit position FAILED
  [31:0] CONFIG_REG_23_DOM1 — One bit per slice. This is the status register written by TESOC module. This register indicates if the slices configured by software have passed OR failed. '1' indicates pass and '0' indicates fail. Software has to first readTESOC_SLICE_STATUS_DOM1_n to check if slice was completely run and then read this register to check pass/fail status. Default value of this register is '1'. (256 bits per domain)
{0x3E0+4i} TESOC_SLICE_RESULT_DOM2_n_{i} (i=0..7) — Slice Result Register 1: Slice at bit position PASSED 0: Slice at bit position FAILED
  [31:0] CONFIG_REG_23_DOM2 — One bit per slice. This is the status register written by TESOC module. This register indicates if the slices configured by software have passed OR failed. '1' indicates pass and '0' indicates fail. Software has to first readTESOC_SLICE_STATUS_DOM2_n to check if slice was completely run and then read this register to check pass/fail status. Default value of this register is '1'. (256 bits per domain)
{0x400+4i} TESOC_SLICE_RESULT_DOM3_n_{i} (i=0..7) — Slice Result Register 1: Slice at bit position PASSED 0: Slice at bit position FAILED
  [31:0] CONFIG_REG_23_DOM3 — One bit per slice. This is the status register written by TESOC module. This register indicates if the slices configured by software have passed OR failed. '1' indicates pass and '0' indicates fail. Software has to first readTESOC_SLICE_STATUS_DOM3_n to check if slice was completely run and then read this register to check pass/fail status. Default value of this register is '1'. (256 bits per domain)
{0x420+4i} TESOC_SLICE_RESULT_DOM4_n_{i} (i=0..7) — Slice Result Register 1: Slice at bit position PASSED 0: Slice at bit position FAILED
  [31:0] CONFIG_REG_23_DOM4 — One bit per slice. This is the status register written by TESOC module. This register indicates if the slices configured by software have passed OR failed. '1' indicates pass and '0' indicates fail. Software has to first readTESOC_SLICE_STATUS_DOM4_n to check if slice was completely run and then read this register to check pass/fail status. Default value of this register is '1'. (256 bits per domain)
0x10500 TESOC_TESOC_ROM_k_0 ro — This MMR space maps to TESOC ROM TESOC ROM is logically 64 bit wide. Each OCP read returns 64 bit data only on lower 64 bits of the OCP data bus. Upper 64 bits are zero.
  [31:0] TESOC_ROM — ROM holds the basic/default test vectors. Within the device, this covers 90% of stuck-at coverage and 100% MBIST on the 3 core processors (IPU, EVE and DSP). It also includes 100% MBIST for ISS, DSS and VIP. The ROM image is the encoded version of the test vectors and is already divided into slices. It consists of multiple control word and data words, which when decoded result into actual test vectors. The ROM image will vary from design to design and from customer requirements.
0x10504 TESOC_TESOC_ROM_k_1 ro — This MMR space maps to TESOC ROM TESOC ROM is logically 64 bit wide. Each OCP read returns 64 bit data only on lower 64 bits of the OCP data bus. Upper 64 bits are zero.
  fields as TESOC_TESOC_ROM_k_0
