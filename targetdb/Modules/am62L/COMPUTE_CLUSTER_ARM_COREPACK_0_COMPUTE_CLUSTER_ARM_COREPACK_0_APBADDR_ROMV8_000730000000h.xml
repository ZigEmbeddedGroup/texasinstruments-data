# COMPUTE_CLUSTER_ARM_COREPACK_0_COMPUTE_CLUSTER_ARM_COREPACK_0_APBADDR_ROMV8_000730000000h register map
Vendor: Texas Instruments
Peripheral module from a debugger description file (folder am62L).
Registers are 32-bit, access not given, no defined reset value unless marked. A register's access mark holds for its fields unless they carry their own. Offsets are as the file gives them; lines under a group give offsets from that group; [hi:lo] are bit positions; {n}, {i} and the like mark numbered series; 'fields as' and 'values as' point back to an identical list; <NAME> marks a mode.

## COMPUTE_CLUSTER_ARM_COREPACK_0_APBADDR_ROMV8
0x00 COMPUTE_CLUSTER_ARM_COREPACK_0_APBADDR_ROMV8_ROMENTRY0 — ROM Table Entry Register 0 (CPU 0 Debug Component)
0x04 COMPUTE_CLUSTER_ARM_COREPACK_0_APBADDR_ROMV8_ROMENTRY1 — ROM Table Entry Register 1 (CPU 0 CTI Component)
0x08 COMPUTE_CLUSTER_ARM_COREPACK_0_APBADDR_ROMV8_ROMENTRY2 — ROM Table Entry Register 2 (CPU 0 PMU Component)
0x0C COMPUTE_CLUSTER_ARM_COREPACK_0_APBADDR_ROMV8_ROMENTRY3 — ROM Table Entry Register 3 (CPU 0 ETM Component)
0x10 COMPUTE_CLUSTER_ARM_COREPACK_0_APBADDR_ROMV8_ROMENTRY4 — ROM Table Entry Register 4 (CPU 1 Debug Component)
0x14 COMPUTE_CLUSTER_ARM_COREPACK_0_APBADDR_ROMV8_ROMENTRY5 — ROM Table Entry Register 5 (CPU 1 CTI Component)
0x18 COMPUTE_CLUSTER_ARM_COREPACK_0_APBADDR_ROMV8_ROMENTRY6 — ROM Table Entry Register 6 (CPU 1 PMU Component)
0x1C COMPUTE_CLUSTER_ARM_COREPACK_0_APBADDR_ROMV8_ROMENTRY7 — ROM Table Entry Register 7 (CPU 1 ETM Component)
{0xFC0+4i} COMPUTE_CLUSTER_ARM_COREPACK_0_APBADDR_ROMV8_ROM_PERIPHID{i}_VAL (i=4..7) — ROM Peripheral ID {i}
{0xFE0+4i} COMPUTE_CLUSTER_ARM_COREPACK_0_APBADDR_ROMV8_ROM_PERIPHID{i}_VAL (i=0..3) — ROM Peripheral ID {i}
{0xFF0+4i} COMPUTE_CLUSTER_ARM_COREPACK_0_APBADDR_ROMV8_ROM_COMPONID{i}_VAL (i=0..3) — ROM Component ID {i}
