# DEBUGSS_DEBUGSS register map
Vendor: Texas Instruments
Peripheral module from a debugger description file (folder AM263).
Registers are 32-bit, read-write, reset 0x0 unless marked. A register's access mark holds for its fields unless they carry their own. Offsets are as the file gives them; lines under a group give offsets from that group; [hi:lo] are bit positions; {n}, {i} and the like mark numbered series; 'fields as' and 'values as' point back to an identical list; <NAME> marks a mode.

## DEBUGSS_DEBUGSS (part 1 of 3)
0x3DEE8 DEBUGSS_MSS_R5SS0_B_ETM_ITTRIGGERREQ ro
  [31:0] MSS_R5SS0_ETM_ITATBCTR2 — Not Defined
0x3DEEC DEBUGSS_MSS_R5SS0_B_ETM_ITATBDATA0 wo
  [31:0] MSS_R5SS0_ETM_ITATBCTR1 — Not Defined
0x3DEF0 DEBUGSS_MSS_R5SS0_B_ETM_ITATBCTR2 wo
  [31:0] MSS_R5SS0_ETM_ITATBCTR0 — Not Defined
0x3DEF4 DEBUGSS_MSS_R5SS0_B_ETM_ITATBCTR1
  [31:0] MSS_R5SS0_ETM_ITCTRL — Not Defined
0x3DEF8 DEBUGSS_MSS_R5SS0_B_ETM_ITATBCTR0
  [31:0] MSS_R5SS0_ETM_CLAIMSET — Not Defined
0x3DF00 DEBUGSS_MSS_R5SS0_B_ETM_ITCTRL
  [31:0] MSS_R5SS0_ETM_CLAIMCLR — Not Defined
0x3DFA0 DEBUGSS_MSS_R5SS0_B_ETM_CLAIMSET wo
  [31:0] MSS_R5SS0_ETM_LAR — Not Defined
0x3DFA4 DEBUGSS_MSS_R5SS0_B_ETM_CLAIMCLR ro
  [31:0] MSS_R5SS0_ETM_LSR — Not Defined
0x3DFB0 DEBUGSS_MSS_R5SS0_B_ETM_LAR ro
  [31:0] MSS_R5SS0_ETM_AUTHSTATUS — Not Defined
0x3DFB4 DEBUGSS_MSS_R5SS0_B_ETM_LSR ro
  [31:0] MSS_R5SS0_ETM_DEVID — Not Defined
0x3DFB8 DEBUGSS_MSS_R5SS0_B_ETM_AUTHSTATUS ro
  [31:0] MSS_R5SS0_ETM_DEVTYPE — Not Defined
0x3DFC8 DEBUGSS_MSS_R5SS0_B_ETM_DEVID ro
  [31:0] MSS_R5SS0_ETM_PIDR4 — Not Defined
0x3DFCC DEBUGSS_MSS_R5SS0_B_ETM_DEVTYPE ro
  [31:0] MSS_R5SS0_ETM_PIDR5 — Not Defined
0x3DFD0 DEBUGSS_MSS_R5SS0_B_ETM_PIDR4 ro
  [31:0] MSS_R5SS0_ETM_PIDR6 — Not Defined
0x3DFD4 DEBUGSS_MSS_R5SS0_B_ETM_PIDR5 ro
  [31:0] MSS_R5SS0_ETM_PIDR7 — Not Defined
0x3DFD8 DEBUGSS_MSS_R5SS0_B_ETM_PIDR6 ro
  [31:0] MSS_R5SS0_ETM_PIDR0 — Not Defined
0x3DFDC DEBUGSS_MSS_R5SS0_B_ETM_PIDR7 ro
  [31:0] MSS_R5SS0_ETM_PIDR1 — Not Defined
0x3DFE0 DEBUGSS_MSS_R5SS0_B_ETM_PIDR0 ro
  [31:0] MSS_R5SS0_ETM_PIDR2 — Not Defined
0x3DFE4 DEBUGSS_MSS_R5SS0_B_ETM_PIDR1 ro
  [31:0] MSS_R5SS0_ETM_PIDR3 — Not Defined
0x3DFE8 DEBUGSS_MSS_R5SS0_B_ETM_PIDR2 ro
  [31:0] MSS_R5SS0_ETM_CIDR0 — Not Defined
0x3DFEC DEBUGSS_MSS_R5SS0_B_ETM_PIDR3 ro
  [31:0] MSS_R5SS0_ETM_CIDR1 — Not Defined
0x3DFF0 DEBUGSS_MSS_R5SS0_B_ETM_CIDR0 ro
  [31:0] MSS_R5SS0_ETM_CIDR2 — Not Defined
0x3DFF4 DEBUGSS_MSS_R5SS0_B_ETM_CIDR1 ro
  [31:0] MSS_R5SS0_ETM_CIDR3 — Not Defined
0x3DFF8 DEBUGSS_MSS_R5SS0_B_ETM_CIDR2
  [31:0] MSS_R5SS1_APB_DBGDIDR — http://infocenter.arm.com/help/topic/com.arm.doc.ddi0363e/Cegejeeb.htmlDebug Identification Register
0x3DFFC DEBUGSS_MSS_R5SS0_B_ETM_CIDR3
  [31:0] MSS_R5SS1_APB_DBGWFAR — Watchpoint Fault Address Register
0x40000 DEBUGSS_MSS_R5SS1_ROM
  [31:0] MSS_R5SS1_APB_DBGVCR — Vector Catch Register
0x50000 DEBUGSS_MSS_R5SS1_A_APB_DBGDIDR
  [31:0] MSS_R5SS1_APB_DBGECR — Not Implemented
0x50018 DEBUGSS_MSS_R5SS1_A_APB_DBGWFAR
  [31:0] MSS_R5SS1_APB_DBGDSCCR — Debug State Cache Control Register
0x5001C DEBUGSS_MSS_R5SS1_A_APB_DBGVCR
  [31:0] MSS_R5SS1_APB_DBGDTRRX — Host to Target Data Transfer Register
0x50024 DEBUGSS_MSS_R5SS1_A_APB_DBGECR
  [31:0] MSS_R5SS1_APB_DBGITR — Instruction Transfer Register
0x50028 DEBUGSS_MSS_R5SS1_A_APB_DBGDSCCR
  [31:0] MSS_R5SS1_APB_DBGDSCR — Debug Status and Control Register
0x50080 DEBUGSS_MSS_R5SS1_A_APB_DBGDTRRX
  [31:0] MSS_R5SS1_APB_DBGDTRTX — Target to Host Data Transfer Register
0x50084 DEBUGSS_MSS_R5SS1_A_APB_DBGITR
  [31:0] MSS_R5SS1_APB_DBGDRCR — Debug Run Control Register
0x50088 DEBUGSS_MSS_R5SS1_A_APB_DBGDSCR
  [31:0] MSS_R5SS1_APB_DBGBVR0 — Break Point Value Register 0
0x5008C DEBUGSS_MSS_R5SS1_A_APB_DBGDTRTX
  [31:0] MSS_R5SS1_APB_DBGBVR1 — Break Point Value Register 1
0x50090 DEBUGSS_MSS_R5SS1_A_APB_DBGDRCR
  [31:0] MSS_R5SS1_APB_DBGBVR2 — Break Point Value Register 2
{0x50100+4i} DEBUGSS_MSS_R5SS1_A_APB_DBGBVR{i} (i=0..4)
  [31:0] MSS_R5SS1_APB_DBGBVR{i+3} — Break Point Value Register {i+3}
{0x50100+4i} DEBUGSS_MSS_R5SS1_A_APB_DBGBVR{i} (i=5..7)
  [31:0] MSS_R5SS1_APB_DBGBCR{i-5} — Break Point Control Register {i-5}
{0x50140+4i} DEBUGSS_MSS_R5SS1_A_APB_DBGBCR{i} (i=0..4)
  [31:0] MSS_R5SS1_APB_DBGBCR{i+3} — Break Point Control Register {i+3}
{0x50140+4i} DEBUGSS_MSS_R5SS1_A_APB_DBGBCR{i} (i=5..7)
  [31:0] MSS_R5SS1_APB_DBGWVR{i-5} — Watch Point Value Register {i-5}
{0x50180+4i} DEBUGSS_MSS_R5SS1_A_APB_DBGWVR{i} (i=0..4)
  [31:0] MSS_R5SS1_APB_DBGWVR{i+3} — Watch Point Value Register {i+3}
{0x50180+4i} DEBUGSS_MSS_R5SS1_A_APB_DBGWVR{i} (i=5..7)
  [31:0] MSS_R5SS1_APB_DBGWCR{i-5} — Watch Point Control Register {i-5}
{0x501C0+4i} DEBUGSS_MSS_R5SS1_A_APB_DBGWCR{i} (i=0..4)
  [31:0] MSS_R5SS1_APB_DBGWCR{i+3} — Watch Point Control Register {i+3}
0x501D4 DEBUGSS_MSS_R5SS1_A_APB_DBGWCR5
  [31:0] MSS_R5SS1_APB_DBGOSLAR — Not Implemented
0x501D8 DEBUGSS_MSS_R5SS1_A_APB_DBGWCR6
  [31:0] MSS_R5SS1_APB_DBGOSLSR — Operating System Lock Status Register
0x501DC DEBUGSS_MSS_R5SS1_A_APB_DBGWCR7
  [31:0] MSS_R5SS1_APB_DBGOSSRR — Not Implemented
0x50300 DEBUGSS_MSS_R5SS1_A_APB_DBGOSLAR
  [31:0] MSS_R5SS1_APB_DBGPRCR — Device Power Down and Reset Control Regsiter
0x50304 DEBUGSS_MSS_R5SS1_A_APB_DBGOSLSR
  [31:0] MSS_R5SS1_APB_DBGPRSR — Device Power Down and Reset Status Register
0x50308 DEBUGSS_MSS_R5SS1_A_APB_DBGOSSRR
  [31:0] MSS_R5SS1_APB_PROCID_MIDR — Main ID Register
0x50310 DEBUGSS_MSS_R5SS1_A_APB_DBGPRCR
  [31:0] MSS_R5SS1_APB_PROCID_CTR — Cache Type Register
0x50314 DEBUGSS_MSS_R5SS1_A_APB_DBGPRSR
  [31:0] MSS_R5SS1_APB_PROCID_TCMTR — TCM Type Register
0x50D00 DEBUGSS_MSS_R5SS1_A_APB_PROCID_MIDR
  [31:0] MSS_R5SS1_APB_PROCID_MPUIR — MPU Type Register
0x50D04 DEBUGSS_MSS_R5SS1_A_APB_PROCID_CTR
  [31:0] MSS_R5SS1_APB_PROCID_MPIDR — Multiprocessor Affinity Register
0x50D08 DEBUGSS_MSS_R5SS1_A_APB_PROCID_TCMTR
  [31:0] MSS_R5SS1_APB_PROCID_PFR0 — Processor Feature Register 0
0x50D10 DEBUGSS_MSS_R5SS1_A_APB_PROCID_MPUIR
  [31:0] MSS_R5SS1_APB_PROCID_PFR1 — Processor Feature Register 1
0x50D14 DEBUGSS_MSS_R5SS1_A_APB_PROCID_MPIDR
  [31:0] MSS_R5SS1_APB_PROCID_DFR0 — Debug Feature Register 0
0x50D20 DEBUGSS_MSS_R5SS1_A_APB_PROCID_PFR0
  [31:0] MSS_R5SS1_APB_PROCID_AFR0 — Auxiliary Feature Register 0
0x50D24 DEBUGSS_MSS_R5SS1_A_APB_PROCID_PFR1
  [31:0] MSS_R5SS1_APB_PROCID_MMFR0 — Processor Feature Register 0
0x50D28 DEBUGSS_MSS_R5SS1_A_APB_PROCID_DFR0
  [31:0] MSS_R5SS1_APB_PROCID_MMFR1 — Memory Model Feature Register 1
0x50D2C DEBUGSS_MSS_R5SS1_A_APB_PROCID_AFR0
  [31:0] MSS_R5SS1_APB_PROCID_MMFR2 — Memory Model Feature Register 2
0x50D30 DEBUGSS_MSS_R5SS1_A_APB_PROCID_MMFR0
  [31:0] MSS_R5SS1_APB_PROCID_MMFR3 — Memory Model Feature Register 3
{0x50D30+4i} DEBUGSS_MSS_R5SS1_A_APB_PROCID_MMFR{i} (i=1..3)
  [31:0] MSS_R5SS1_APB_PROCID_ISAR{i-1} — ISA Feature Register {i-1}
{0x50D40+4i} DEBUGSS_MSS_R5SS1_A_APB_PROCID_ISAR{i} (i=0..2)
  [31:0] MSS_R5SS1_APB_PROCID_ISAR{i+3} — ISA Feature Register {i+3}
0x50D4C DEBUGSS_MSS_R5SS1_A_APB_PROCID_ISAR3
  [31:0] MSS_R5SS1_APB_MR_ITCTRL — Integration Mode Control Registers
0x50D50 DEBUGSS_MSS_R5SS1_A_APB_PROCID_ISAR4
  [31:0] MSS_R5SS1_APB_MR_CLAIMSET — Claim Tag Set Register
0x50D54 DEBUGSS_MSS_R5SS1_A_APB_PROCID_ISAR5
  [31:0] MSS_R5SS1_APB_MR_CLAIMCLR — Claim Tag Clear Register
0x50F00 DEBUGSS_MSS_R5SS1_A_APB_MR_ITCTRL
  [31:0] MSS_R5SS1_APB_MR_LOCKACCESS — Lock Access Register
0x50FA0 DEBUGSS_MSS_R5SS1_A_APB_MR_CLAIMSET
  [31:0] MSS_R5SS1_APB_MR_LOCKSTATUS — Lock Status Register
0x50FA4 DEBUGSS_MSS_R5SS1_A_APB_MR_CLAIMCLR
  [31:0] MSS_R5SS1_APB_MR_AUTHSTATUS — Authentication Status Register
0x50FB0 DEBUGSS_MSS_R5SS1_A_APB_MR_LOCKACCESS
  [31:0] MSS_R5SS1_APB_MR_DEVID — Device Identifier
0x50FB4 DEBUGSS_MSS_R5SS1_A_APB_MR_LOCKSTATUS
  [31:0] MSS_R5SS1_APB_MR_DEVTYPE — Device Type Register
0x50FB8 DEBUGSS_MSS_R5SS1_A_APB_MR_AUTHSTATUS
  [31:0] MSS_R5SS1_APB_PERIP_ID4 — Not Defined
0x50FC8 DEBUGSS_MSS_R5SS1_A_APB_MR_DEVID
  [31:0] MSS_R5SS1_APB_PERIP_ID0 — Not Defined
0x50FCC DEBUGSS_MSS_R5SS1_A_APB_MR_DEVTYPE
  [31:0] MSS_R5SS1_APB_PERIP_ID1 — Not Defined
0x50FD0 DEBUGSS_MSS_R5SS1_A_APB_PERIP_ID4
  [31:0] MSS_R5SS1_APB_PERIP_ID2 — Not Defined
0x50FE0 DEBUGSS_MSS_R5SS1_A_APB_PERIP_ID0
  [31:0] MSS_R5SS1_APB_PERIP_ID3 — Not Defined
{0x50FE0+4i} DEBUGSS_MSS_R5SS1_A_APB_PERIP_ID{i} (i=1..3)
  [31:0] MSS_R5SS1_APB_COMP_ID{i-1} — Not Defined
0x50FF0 DEBUGSS_MSS_R5SS1_A_APB_COMP_ID0
  [31:0] MSS_R5SS1_APB_COMP_ID3 — Not Defined
0x50FF4 DEBUGSS_MSS_R5SS1_A_APB_COMP_ID1
  fields as DEBUGSS_MSS_R5SS0_B_ETM_CIDR2
0x50FF8 DEBUGSS_MSS_R5SS1_A_APB_COMP_ID2
  [31:0] MSS_R5SS1_APB_DBGWFAR — Watchpoint Fault Address Register
0x50FFC DEBUGSS_MSS_R5SS1_A_APB_COMP_ID3
  [31:0] MSS_R5SS1_APB_DBGVCR — Vector Catch Register
0x52000 DEBUGSS_MSS_R5SS1_B_APB_DBGDIDR
  [31:0] MSS_R5SS1_APB_DBGECR — Not Implemented
0x52018 DEBUGSS_MSS_R5SS1_B_APB_DBGWFAR
  [31:0] MSS_R5SS1_APB_DBGDSCCR — Debug State Cache Control Register
0x5201C DEBUGSS_MSS_R5SS1_B_APB_DBGVCR
  fields as DEBUGSS_MSS_R5SS1_A_APB_DBGVCR
0x52024 DEBUGSS_MSS_R5SS1_B_APB_DBGECR
  [31:0] MSS_R5SS1_APB_DBGITR — Instruction Transfer Register
0x52028 DEBUGSS_MSS_R5SS1_B_APB_DBGDSCCR
  [31:0] MSS_R5SS1_APB_DBGDSCR — Debug Status and Control Register
0x52080 DEBUGSS_MSS_R5SS1_B_APB_DBGDTRRX
  fields as DEBUGSS_MSS_R5SS1_A_APB_DBGDTRRX
0x52084 DEBUGSS_MSS_R5SS1_B_APB_DBGITR
  [31:0] MSS_R5SS1_APB_DBGDRCR — Debug Run Control Register
0x52088 DEBUGSS_MSS_R5SS1_B_APB_DBGDSCR
  [31:0] MSS_R5SS1_APB_DBGBVR0 — Break Point Value Register 0
0x5208C DEBUGSS_MSS_R5SS1_B_APB_DBGDTRTX
  [31:0] MSS_R5SS1_APB_DBGBVR1 — Break Point Value Register 1
0x52090 DEBUGSS_MSS_R5SS1_B_APB_DBGDRCR
  [31:0] MSS_R5SS1_APB_DBGBVR2 — Break Point Value Register 2
{0x52100+4i} DEBUGSS_MSS_R5SS1_B_APB_DBGBVR{i} (i=0..4)
  [31:0] MSS_R5SS1_APB_DBGBVR{i+3} — Break Point Value Register {i+3}
{0x52100+4i} DEBUGSS_MSS_R5SS1_B_APB_DBGBVR{i} (i=5..7)
  fields as DEBUGSS_MSS_R5SS1_A_APB_DBGBVR5
{0x52140+4i} DEBUGSS_MSS_R5SS1_B_APB_DBGBCR{i} (i=0..4)
  fields as DEBUGSS_MSS_R5SS1_A_APB_DBGBCR0
{0x52140+4i} DEBUGSS_MSS_R5SS1_B_APB_DBGBCR{i} (i=5..7)
  [31:0] MSS_R5SS1_APB_DBGWVR{i-5} — Watch Point Value Register {i-5}
{0x52180+4i} DEBUGSS_MSS_R5SS1_B_APB_DBGWVR{i} (i=0..4)
  [31:0] MSS_R5SS1_APB_DBGWVR{i+3} — Watch Point Value Register {i+3}
{0x52180+4i} DEBUGSS_MSS_R5SS1_B_APB_DBGWVR{i} (i=5..7)
  fields as DEBUGSS_MSS_R5SS1_A_APB_DBGWVR5
{0x521C0+4i} DEBUGSS_MSS_R5SS1_B_APB_DBGWCR{i} (i=0..4)
  fields as DEBUGSS_MSS_R5SS1_A_APB_DBGWCR0
0x521D4 DEBUGSS_MSS_R5SS1_B_APB_DBGWCR5
  [31:0] MSS_R5SS1_APB_DBGOSLAR — Not Implemented
0x521D8 DEBUGSS_MSS_R5SS1_B_APB_DBGWCR6
  fields as DEBUGSS_MSS_R5SS1_A_APB_DBGWCR6
0x521DC DEBUGSS_MSS_R5SS1_B_APB_DBGWCR7
  [31:0] MSS_R5SS1_APB_DBGOSSRR — Not Implemented
0x52300 DEBUGSS_MSS_R5SS1_B_APB_DBGOSLAR
  fields as DEBUGSS_MSS_R5SS1_A_APB_DBGOSLAR
0x52304 DEBUGSS_MSS_R5SS1_B_APB_DBGOSLSR
  fields as DEBUGSS_MSS_R5SS1_A_APB_DBGOSLSR
0x52308 DEBUGSS_MSS_R5SS1_B_APB_DBGOSSRR
  [31:0] MSS_R5SS1_APB_PROCID_MIDR — Main ID Register
0x52310 DEBUGSS_MSS_R5SS1_B_APB_DBGPRCR
  [31:0] MSS_R5SS1_APB_PROCID_CTR — Cache Type Register
0x52314 DEBUGSS_MSS_R5SS1_B_APB_DBGPRSR
  [31:0] MSS_R5SS1_APB_PROCID_TCMTR — TCM Type Register
0x52D00 DEBUGSS_MSS_R5SS1_B_APB_PROCID_MIDR
  [31:0] MSS_R5SS1_APB_PROCID_MPUIR — MPU Type Register
0x52D04 DEBUGSS_MSS_R5SS1_B_APB_PROCID_CTR
  [31:0] MSS_R5SS1_APB_PROCID_MPIDR — Multiprocessor Affinity Register
0x52D08 DEBUGSS_MSS_R5SS1_B_APB_PROCID_TCMTR
  [31:0] MSS_R5SS1_APB_PROCID_PFR0 — Processor Feature Register 0
0x52D10 DEBUGSS_MSS_R5SS1_B_APB_PROCID_MPUIR
  [31:0] MSS_R5SS1_APB_PROCID_PFR1 — Processor Feature Register 1
0x52D14 DEBUGSS_MSS_R5SS1_B_APB_PROCID_MPIDR
  [31:0] MSS_R5SS1_APB_PROCID_DFR0 — Debug Feature Register 0
0x52D20 DEBUGSS_MSS_R5SS1_B_APB_PROCID_PFR0
  [31:0] MSS_R5SS1_APB_PROCID_AFR0 — Auxiliary Feature Register 0
0x52D24 DEBUGSS_MSS_R5SS1_B_APB_PROCID_PFR1
  [31:0] MSS_R5SS1_APB_PROCID_MMFR0 — Processor Feature Register 0
0x52D28 DEBUGSS_MSS_R5SS1_B_APB_PROCID_DFR0
  [31:0] MSS_R5SS1_APB_PROCID_MMFR1 — Memory Model Feature Register 1
0x52D2C DEBUGSS_MSS_R5SS1_B_APB_PROCID_AFR0
  [31:0] MSS_R5SS1_APB_PROCID_MMFR2 — Memory Model Feature Register 2
0x52D30 DEBUGSS_MSS_R5SS1_B_APB_PROCID_MMFR0
  [31:0] MSS_R5SS1_APB_PROCID_MMFR3 — Memory Model Feature Register 3
{0x52D30+4i} DEBUGSS_MSS_R5SS1_B_APB_PROCID_MMFR{i} (i=1..3)
  [31:0] MSS_R5SS1_APB_PROCID_ISAR{i-1} — ISA Feature Register {i-1}
{0x52D40+4i} DEBUGSS_MSS_R5SS1_B_APB_PROCID_ISAR{i} (i=0..2)
  [31:0] MSS_R5SS1_APB_PROCID_ISAR{i+3} — ISA Feature Register {i+3}
0x52D4C DEBUGSS_MSS_R5SS1_B_APB_PROCID_ISAR3
  [31:0] MSS_R5SS1_APB_MR_ITCTRL — Integration Mode Control Registers
0x52D50 DEBUGSS_MSS_R5SS1_B_APB_PROCID_ISAR4
  [31:0] MSS_R5SS1_APB_MR_CLAIMSET — Claim Tag Set Register
0x52D54 DEBUGSS_MSS_R5SS1_B_APB_PROCID_ISAR5
  [31:0] MSS_R5SS1_APB_MR_CLAIMCLR — Claim Tag Clear Register
0x52F00 DEBUGSS_MSS_R5SS1_B_APB_MR_ITCTRL
  [31:0] MSS_R5SS1_APB_MR_LOCKACCESS — Lock Access Register
0x52FA0 DEBUGSS_MSS_R5SS1_B_APB_MR_CLAIMSET
  [31:0] MSS_R5SS1_APB_MR_LOCKSTATUS — Lock Status Register
0x52FA4 DEBUGSS_MSS_R5SS1_B_APB_MR_CLAIMCLR
  [31:0] MSS_R5SS1_APB_MR_AUTHSTATUS — Authentication Status Register
0x52FB0 DEBUGSS_MSS_R5SS1_B_APB_MR_LOCKACCESS
  [31:0] MSS_R5SS1_APB_MR_DEVID — Device Identifier
0x52FB4 DEBUGSS_MSS_R5SS1_B_APB_MR_LOCKSTATUS
  [31:0] MSS_R5SS1_APB_MR_DEVTYPE — Device Type Register
0x52FB8 DEBUGSS_MSS_R5SS1_B_APB_MR_AUTHSTATUS
  [31:0] MSS_R5SS1_APB_PERIP_ID4 — Not Defined
0x52FC8 DEBUGSS_MSS_R5SS1_B_APB_MR_DEVID
  [31:0] MSS_R5SS1_APB_PERIP_ID0 — Not Defined
0x52FCC DEBUGSS_MSS_R5SS1_B_APB_MR_DEVTYPE
  [31:0] MSS_R5SS1_APB_PERIP_ID1 — Not Defined
0x52FD0 DEBUGSS_MSS_R5SS1_B_APB_PERIP_ID4
  [31:0] MSS_R5SS1_APB_PERIP_ID2 — Not Defined
0x52FE0 DEBUGSS_MSS_R5SS1_B_APB_PERIP_ID0
  [31:0] MSS_R5SS1_APB_PERIP_ID3 — Not Defined
{0x52FE0+4i} DEBUGSS_MSS_R5SS1_B_APB_PERIP_ID{i} (i=1..3)
  [31:0] MSS_R5SS1_APB_COMP_ID{i-1} — Not Defined
0x52FF0 DEBUGSS_MSS_R5SS1_B_APB_COMP_ID0
  [31:0] MSS_R5SS1_APB_COMP_ID3 — Not Defined
0x52FF4 DEBUGSS_MSS_R5SS1_B_APB_COMP_ID1
  [31:0] MSS_R5SS1_CTI_CONTROL — http://infocenter.arm.com/help/topic/com.arm.doc.ddi0480e/CHDGDIHE.htmlhttp://infocenter.arm.com/help/topic/com.arm.doc.ddi0480e/CHDHBDIA.html
0x52FF8 DEBUGSS_MSS_R5SS1_B_APB_COMP_ID2 wo
  [31:0] MSS_R5SS1_CTI_INTACK — Not Defined
0x52FFC DEBUGSS_MSS_R5SS1_B_APB_COMP_ID3
  [31:0] MSS_R5SS1_CTI_APPSET — Not Defined
0x58000 DEBUGSS_MSS_R5SS1_A_CTI_CONTROL wo
  [31:0] MSS_R5SS1_CTI_APPCLEAR — Not Defined
0x58010 DEBUGSS_MSS_R5SS1_A_CTI_INTACK wo
  [31:0] MSS_R5SS1_CTI_APPPULSE — Not Defined
0x58014 DEBUGSS_MSS_R5SS1_A_CTI_APPSET
  [31:0] MSS_R5SS1_CTI_INEN0 — Not Defined
0x58018 DEBUGSS_MSS_R5SS1_A_CTI_APPCLEAR
  [31:0] MSS_R5SS1_CTI_INEN1 — Not Defined
0x5801C DEBUGSS_MSS_R5SS1_A_CTI_APPPULSE
  [31:0] MSS_R5SS1_CTI_INEN2 — Not Defined
{0x58020+4i} DEBUGSS_MSS_R5SS1_A_CTI_INEN{i} (i=0..4)
  [31:0] MSS_R5SS1_CTI_INEN{i+3} — Not Defined
{0x58020+4i} DEBUGSS_MSS_R5SS1_A_CTI_INEN{i} (i=5..7)
  [31:0] MSS_R5SS1_CTI_OUTEN{i-5} — Not Defined
{0x580A0+4i} DEBUGSS_MSS_R5SS1_A_CTI_OUTEN{i} (i=0..4)
  [31:0] MSS_R5SS1_CTI_OUTEN{i+3} — Not Defined
0x580B4 DEBUGSS_MSS_R5SS1_A_CTI_OUTEN5 ro
  [31:0] MSS_R5SS1_CTI_TRIGINSTATUS — Not Defined
0x580B8 DEBUGSS_MSS_R5SS1_A_CTI_OUTEN6 ro
  [31:0] MSS_R5SS1_CTI_TRIGOUTSTATUS — Not Defined
0x580BC DEBUGSS_MSS_R5SS1_A_CTI_OUTEN7 ro
  [31:0] MSS_R5SS1_CTI_CHINSTATUS — Not Defined
0x58130 DEBUGSS_MSS_R5SS1_A_CTI_TRIGINSTATUS ro
  [31:0] MSS_R5SS1_CTI_CHOUTSTATUS — Not Defined
0x58134 DEBUGSS_MSS_R5SS1_A_CTI_TRIGOUTSTATUS
  [31:0] MSS_R5SS1_CTI_GATE — Not Defined
0x58138 DEBUGSS_MSS_R5SS1_A_CTI_CHINSTATUS
  [31:0] MSS_R5SS1_CTI_ASICCTL — Not Defined
0x5813C DEBUGSS_MSS_R5SS1_A_CTI_CHOUTSTATUS wo
  [31:0] MSS_R5SS1_CTI_ITCHINACK — Not Defined
0x58140 DEBUGSS_MSS_R5SS1_A_CTI_GATE wo
  [31:0] MSS_R5SS1_CTI_ITTRIGINACK — Not Defined
0x58144 DEBUGSS_MSS_R5SS1_A_CTI_ASICCTL wo
  [31:0] MSS_R5SS1_CTI_ITCHOUT — Not Defined
0x58EDC DEBUGSS_MSS_R5SS1_A_CTI_ITCHINACK wo
  [31:0] MSS_R5SS1_CTI_ITTRIGOUT — Not Defined
0x58EE0 DEBUGSS_MSS_R5SS1_A_CTI_ITTRIGINACK ro
  [31:0] MSS_R5SS1_CTI_ITCHOUTACK — Not Defined
0x58EE4 DEBUGSS_MSS_R5SS1_A_CTI_ITCHOUT ro
  [31:0] MSS_R5SS1_CTI_ITTRIGOUTACK — Not Defined
0x58EE8 DEBUGSS_MSS_R5SS1_A_CTI_ITTRIGOUT ro
  [31:0] MSS_R5SS1_CTI_ITCHIN — Not Defined
0x58EEC DEBUGSS_MSS_R5SS1_A_CTI_ITCHOUTACK ro
  [31:0] MSS_R5SS1_CTI_ITTRIGIN — Not Defined
0x58EF0 DEBUGSS_MSS_R5SS1_A_CTI_ITTRIGOUTACK
  [31:0] MSS_R5SS1_CTI_ITCTRL — Not Defined
0x58EF4 DEBUGSS_MSS_R5SS1_A_CTI_ITCHIN
  [31:0] MSS_R5SS1_CTI_CLAIM_TAG_SET — Not Defined
0x58EF8 DEBUGSS_MSS_R5SS1_A_CTI_ITTRIGIN
  [31:0] MSS_R5SS1_CTI_CLAIM_TAG_CLEAR — Not Defined
0x58F00 DEBUGSS_MSS_R5SS1_A_CTI_ITCTRL wo
  [31:0] MSS_R5SS1_CTI_LOCK_ACCESS_REGISTER — Not Defined
0x58FA0 DEBUGSS_MSS_R5SS1_A_CTI_CLAIM_TAG_SET ro
  [31:0] MSS_R5SS1_CTI_LOCK_STATUS_REGISTER — Not Defined
0x58FA4 DEBUGSS_MSS_R5SS1_A_CTI_CLAIM_TAG_CLEAR ro
  [31:0] MSS_R5SS1_CTI_AUTHENTICATION_STATUS — Not Defined
0x58FB0 DEBUGSS_MSS_R5SS1_A_CTI_LOCK_ACCESS_REGISTER ro
  [31:0] MSS_R5SS1_CTI_DEVICE_ID — Not Defined
0x58FB4 DEBUGSS_MSS_R5SS1_A_CTI_LOCK_STATUS_REGISTER ro
  [31:0] MSS_R5SS1_CTI_DEVICE_TYPE_IDENTIFIER — Not Defined
0x58FB8 DEBUGSS_MSS_R5SS1_A_CTI_AUTHENTICATION_STATUS ro
  [31:0] MSS_R5SS1_CTI_PERIPHERALID4 — Not Defined
0x58FC8 DEBUGSS_MSS_R5SS1_A_CTI_DEVICE_ID ro
  [31:0] MSS_R5SS1_CTI_PERIPHERALID5 — Not Defined
0x58FCC DEBUGSS_MSS_R5SS1_A_CTI_DEVICE_TYPE_IDENTIFIER ro
  [31:0] MSS_R5SS1_CTI_PERIPHERALID6 — Not Defined
0x58FD0 DEBUGSS_MSS_R5SS1_A_CTI_PERIPHERALID4 ro
  [31:0] MSS_R5SS1_CTI_PERIPHERALID7 — Not Defined
{0x58FC0+4i} DEBUGSS_MSS_R5SS1_A_CTI_PERIPHERALID{i} ro (i=5..7)
  [31:0] MSS_R5SS1_CTI_PERIPHERALID{i-5} — Not Defined
0x58FE0 DEBUGSS_MSS_R5SS1_A_CTI_PERIPHERALID0 ro
  [31:0] MSS_R5SS1_CTI_PERIPHERALID3 — Not Defined
{0x58FE0+4i} DEBUGSS_MSS_R5SS1_A_CTI_PERIPHERALID{i} ro (i=1..3)
  [31:0] MSS_R5SS1_CTI_COMPONENT_ID{i-1} — Not Defined
0x58FF0 DEBUGSS_MSS_R5SS1_A_CTI_COMPONENT_ID0 ro
  [31:0] MSS_R5SS1_CTI_COMPONENT_ID3 — Not Defined
0x58FF4 DEBUGSS_MSS_R5SS1_A_CTI_COMPONENT_ID1
  fields as DEBUGSS_MSS_R5SS1_B_APB_COMP_ID1
0x58FF8 DEBUGSS_MSS_R5SS1_A_CTI_COMPONENT_ID2 wo
  [31:0] MSS_R5SS1_CTI_INTACK — Not Defined
0x58FFC DEBUGSS_MSS_R5SS1_A_CTI_COMPONENT_ID3
  [31:0] MSS_R5SS1_CTI_APPSET — Not Defined
0x59000 DEBUGSS_MSS_R5SS1_B_CTI_CONTROL wo
  [31:0] MSS_R5SS1_CTI_APPCLEAR — Not Defined
0x59010 DEBUGSS_MSS_R5SS1_B_CTI_INTACK wo
  [31:0] MSS_R5SS1_CTI_APPPULSE — Not Defined
0x59014 DEBUGSS_MSS_R5SS1_B_CTI_APPSET
  [31:0] MSS_R5SS1_CTI_INEN0 — Not Defined
0x59018 DEBUGSS_MSS_R5SS1_B_CTI_APPCLEAR
  [31:0] MSS_R5SS1_CTI_INEN1 — Not Defined
0x5901C DEBUGSS_MSS_R5SS1_B_CTI_APPPULSE
  [31:0] MSS_R5SS1_CTI_INEN2 — Not Defined
{0x59020+4i} DEBUGSS_MSS_R5SS1_B_CTI_INEN{i} (i=0..4)
  [31:0] MSS_R5SS1_CTI_INEN{i+3} — Not Defined
{0x59020+4i} DEBUGSS_MSS_R5SS1_B_CTI_INEN{i} (i=5..7)
  [31:0] MSS_R5SS1_CTI_OUTEN{i-5} — Not Defined
{0x590A0+4i} DEBUGSS_MSS_R5SS1_B_CTI_OUTEN{i} (i=0..4)
  [31:0] MSS_R5SS1_CTI_OUTEN{i+3} — Not Defined
0x590B4 DEBUGSS_MSS_R5SS1_B_CTI_OUTEN5 ro
  [31:0] MSS_R5SS1_CTI_TRIGINSTATUS — Not Defined
0x590B8 DEBUGSS_MSS_R5SS1_B_CTI_OUTEN6 ro
  [31:0] MSS_R5SS1_CTI_TRIGOUTSTATUS — Not Defined
0x590BC DEBUGSS_MSS_R5SS1_B_CTI_OUTEN7 ro
  [31:0] MSS_R5SS1_CTI_CHINSTATUS — Not Defined
0x59130 DEBUGSS_MSS_R5SS1_B_CTI_TRIGINSTATUS ro
  [31:0] MSS_R5SS1_CTI_CHOUTSTATUS — Not Defined
0x59134 DEBUGSS_MSS_R5SS1_B_CTI_TRIGOUTSTATUS
  [31:0] MSS_R5SS1_CTI_GATE — Not Defined
0x59138 DEBUGSS_MSS_R5SS1_B_CTI_CHINSTATUS
  [31:0] MSS_R5SS1_CTI_ASICCTL — Not Defined
0x5913C DEBUGSS_MSS_R5SS1_B_CTI_CHOUTSTATUS wo
  [31:0] MSS_R5SS1_CTI_ITCHINACK — Not Defined
0x59140 DEBUGSS_MSS_R5SS1_B_CTI_GATE wo
  [31:0] MSS_R5SS1_CTI_ITTRIGINACK — Not Defined
0x59144 DEBUGSS_MSS_R5SS1_B_CTI_ASICCTL wo
  [31:0] MSS_R5SS1_CTI_ITCHOUT — Not Defined
0x59EDC DEBUGSS_MSS_R5SS1_B_CTI_ITCHINACK wo
  [31:0] MSS_R5SS1_CTI_ITTRIGOUT — Not Defined
0x59EE0 DEBUGSS_MSS_R5SS1_B_CTI_ITTRIGINACK ro
  [31:0] MSS_R5SS1_CTI_ITCHOUTACK — Not Defined
0x59EE4 DEBUGSS_MSS_R5SS1_B_CTI_ITCHOUT ro
  [31:0] MSS_R5SS1_CTI_ITTRIGOUTACK — Not Defined
0x59EE8 DEBUGSS_MSS_R5SS1_B_CTI_ITTRIGOUT ro
  [31:0] MSS_R5SS1_CTI_ITCHIN — Not Defined
0x59EEC DEBUGSS_MSS_R5SS1_B_CTI_ITCHOUTACK ro
  [31:0] MSS_R5SS1_CTI_ITTRIGIN — Not Defined
0x59EF0 DEBUGSS_MSS_R5SS1_B_CTI_ITTRIGOUTACK
  [31:0] MSS_R5SS1_CTI_ITCTRL — Not Defined
0x59EF4 DEBUGSS_MSS_R5SS1_B_CTI_ITCHIN
  [31:0] MSS_R5SS1_CTI_CLAIM_TAG_SET — Not Defined
0x59EF8 DEBUGSS_MSS_R5SS1_B_CTI_ITTRIGIN
  [31:0] MSS_R5SS1_CTI_CLAIM_TAG_CLEAR — Not Defined
0x59F00 DEBUGSS_MSS_R5SS1_B_CTI_ITCTRL wo
  [31:0] MSS_R5SS1_CTI_LOCK_ACCESS_REGISTER — Not Defined
0x59FA0 DEBUGSS_MSS_R5SS1_B_CTI_CLAIM_TAG_SET ro
  [31:0] MSS_R5SS1_CTI_LOCK_STATUS_REGISTER — Not Defined
0x59FA4 DEBUGSS_MSS_R5SS1_B_CTI_CLAIM_TAG_CLEAR ro
  [31:0] MSS_R5SS1_CTI_AUTHENTICATION_STATUS — Not Defined
0x59FB0 DEBUGSS_MSS_R5SS1_B_CTI_LOCK_ACCESS_REGISTER ro
  [31:0] MSS_R5SS1_CTI_DEVICE_ID — Not Defined
0x59FB4 DEBUGSS_MSS_R5SS1_B_CTI_LOCK_STATUS_REGISTER ro
  [31:0] MSS_R5SS1_CTI_DEVICE_TYPE_IDENTIFIER — Not Defined
0x59FB8 DEBUGSS_MSS_R5SS1_B_CTI_AUTHENTICATION_STATUS ro
  [31:0] MSS_R5SS1_CTI_PERIPHERALID4 — Not Defined
0x59FC8 DEBUGSS_MSS_R5SS1_B_CTI_DEVICE_ID ro
  [31:0] MSS_R5SS1_CTI_PERIPHERALID5 — Not Defined
0x59FCC DEBUGSS_MSS_R5SS1_B_CTI_DEVICE_TYPE_IDENTIFIER ro
  [31:0] MSS_R5SS1_CTI_PERIPHERALID6 — Not Defined
0x59FD0 DEBUGSS_MSS_R5SS1_B_CTI_PERIPHERALID4 ro
  [31:0] MSS_R5SS1_CTI_PERIPHERALID7 — Not Defined
{0x59FC0+4i} DEBUGSS_MSS_R5SS1_B_CTI_PERIPHERALID{i} ro (i=5..7)
  [31:0] MSS_R5SS1_CTI_PERIPHERALID{i-5} — Not Defined
0x59FE0 DEBUGSS_MSS_R5SS1_B_CTI_PERIPHERALID0 ro
  [31:0] MSS_R5SS1_CTI_PERIPHERALID3 — Not Defined
{0x59FE0+4i} DEBUGSS_MSS_R5SS1_B_CTI_PERIPHERALID{i} ro (i=1..3)
  [31:0] MSS_R5SS1_CTI_COMPONENT_ID{i-1} — Not Defined
0x59FF0 DEBUGSS_MSS_R5SS1_B_CTI_COMPONENT_ID0 ro
  [31:0] MSS_R5SS1_CTI_COMPONENT_ID3 — Not Defined
0x59FF4 DEBUGSS_MSS_R5SS1_B_CTI_COMPONENT_ID1
  [31:0] MSS_R5SS1_ETM_CR — http://infocenter.arm.com/help/index.jsp?topic=/com.arm.doc.ihi0014q/Chdfiagc.htmlhttp://infocenter.arm.com/help/topic/com.arm.doc.ihi0014q/I84249.html
0x59FF8 DEBUGSS_MSS_R5SS1_B_CTI_COMPONENT_ID2 ro
  [31:0] MSS_R5SS1_ETM_CCR — Not Defined
0x59FFC DEBUGSS_MSS_R5SS1_B_CTI_COMPONENT_ID3
  [31:0] MSS_R5SS1_ETM_TRIGGER — Not Defined
0x5C000 DEBUGSS_MSS_R5SS1_A_ETM_CR
  [31:0] MSS_R5SS1_ETM_ASICCTLR — Not Defined
0x5C004 DEBUGSS_MSS_R5SS1_A_ETM_CCR
  [31:0] MSS_R5SS1_ETM_SR — Not Defined
0x5C008 DEBUGSS_MSS_R5SS1_A_ETM_TRIGGER ro
  [31:0] MSS_R5SS1_ETM_SCR — Not Defined
0x5C00C DEBUGSS_MSS_R5SS1_A_ETM_ASICCTLR
  [31:0] MSS_R5SS1_ETM_TSSCR — Not Defined
0x5C010 DEBUGSS_MSS_R5SS1_A_ETM_SR
  [31:0] MSS_R5SS1_ETM_TECR2 — Not Defined
0x5C014 DEBUGSS_MSS_R5SS1_A_ETM_SCR
  [31:0] MSS_R5SS1_ETM_TEEVR — Not Defined
0x5C018 DEBUGSS_MSS_R5SS1_A_ETM_TSSCR
  [31:0] MSS_R5SS1_ETM_TECR1 — Not Defined
0x5C01C DEBUGSS_MSS_R5SS1_A_ETM_TECR2
  [31:0] MSS_R5SS1_ETM_FFRR — Not Defined
0x5C020 DEBUGSS_MSS_R5SS1_A_ETM_TEEVR
  [31:0] MSS_R5SS1_ETM_FFLR — Not Defined
0x5C024 DEBUGSS_MSS_R5SS1_A_ETM_TECR1
  [31:0] MSS_R5SS1_ETM_VDEVR — Not Defined
0x5C028 DEBUGSS_MSS_R5SS1_A_ETM_FFRR
  [31:0] MSS_R5SS1_ETM_VDCR1 — Not Defined
0x5C02C DEBUGSS_MSS_R5SS1_A_ETM_FFLR
  [31:0] MSS_R5SS1_ETM_VDCR2 — Not Defined
0x5C030 DEBUGSS_MSS_R5SS1_A_ETM_VDEVR
  [31:0] MSS_R5SS1_ETM_VDCR3 — Not Defined
{0x5C030+4i} DEBUGSS_MSS_R5SS1_A_ETM_VDCR{i} (i=1..3)
  [31:0] MSS_R5SS1_ETM_ACVR{i} — Not Defined
{0x5C03C+4i} DEBUGSS_MSS_R5SS1_A_ETM_ACVR{i} (i=1..13)
  [31:0] MSS_R5SS1_ETM_ACVR{i+3} — Not Defined
{0x5C03C+4i} DEBUGSS_MSS_R5SS1_A_ETM_ACVR{i} (i=14..16)
  [31:0] MSS_R5SS1_ETM_ACTR{i-13} — Not Defined
{0x5C07C+4i} DEBUGSS_MSS_R5SS1_A_ETM_ACTR{i} (i=1..13)
  [31:0] MSS_R5SS1_ETM_ACTR{i+3} — Not Defined
{0x5C07C+4i} DEBUGSS_MSS_R5SS1_A_ETM_ACTR{i} (i=14..16)
  [31:0] MSS_R5SS1_ETM_DCVR{i-13} — Not Defined
{0x5C0B8+8i} DEBUGSS_MSS_R5SS1_A_ETM_DCVR{i} (i=1..5)
  [31:0] MSS_R5SS1_ETM_DCVR{i+3} — Not Defined
{0x5C0B8+8i} DEBUGSS_MSS_R5SS1_A_ETM_DCVR{i} (i=6..8)
  [31:0] MSS_R5SS1_ETM_DCMR{i-5} — Not Defined
{0x5C0F8+8i} DEBUGSS_MSS_R5SS1_A_ETM_DCMR{i} (i=1..5)
  [31:0] MSS_R5SS1_ETM_DCMR{i+3} — Not Defined
{0x5C0F8+8i} DEBUGSS_MSS_R5SS1_A_ETM_DCMR{i} (i=6..8)
  [31:0] MSS_R5SS1_ETM_CNTRLDVR{i-5} — Not Defined
0x5C140 DEBUGSS_MSS_R5SS1_A_ETM_CNTRLDVR1
  [31:0] MSS_R5SS1_ETM_CNTRLDVR4 — Not Defined
{0x5C13C+4i} DEBUGSS_MSS_R5SS1_A_ETM_CNTRLDVR{i} (i=2..4)
  [31:0] MSS_R5SS1_ETM_CNTENR{i-1} — Not Defined
0x5C150 DEBUGSS_MSS_R5SS1_A_ETM_CNTENR1
  [31:0] MSS_R5SS1_ETM_CNTENR4 — Not Defined
{0x5C14C+4i} DEBUGSS_MSS_R5SS1_A_ETM_CNTENR{i} (i=2..4)
  [31:0] MSS_R5SS1_ETM_CNTRLDEVR{i-1} — Not Defined
0x5C160 DEBUGSS_MSS_R5SS1_A_ETM_CNTRLDEVR1
  [31:0] MSS_R5SS1_ETM_CNTRLDEVR4 — Not Defined
{0x5C15C+4i} DEBUGSS_MSS_R5SS1_A_ETM_CNTRLDEVR{i} (i=2..4)
  [31:0] MSS_R5SS1_ETM_CNTVR{i-1} — Not Defined
0x5C170 DEBUGSS_MSS_R5SS1_A_ETM_CNTVR1
  [31:0] MSS_R5SS1_ETM_CNTVR4 — Not Defined
0x5C174 DEBUGSS_MSS_R5SS1_A_ETM_CNTVR2
  [31:0] MSS_R5SS1_ETM_SQ12EVR — Not Defined
0x5C178 DEBUGSS_MSS_R5SS1_A_ETM_CNTVR3
  [31:0] MSS_R5SS1_ETM_SQ21EVR — Not Defined
0x5C17C DEBUGSS_MSS_R5SS1_A_ETM_CNTVR4
  [31:0] MSS_R5SS1_ETM_SQ23EVR — Not Defined
0x5C180 DEBUGSS_MSS_R5SS1_A_ETM_SQ12EVR
  [31:0] MSS_R5SS1_ETM_SQ31EVR — Not Defined
0x5C184 DEBUGSS_MSS_R5SS1_A_ETM_SQ21EVR
  [31:0] MSS_R5SS1_ETM_SQ32EVR — Not Defined
0x5C188 DEBUGSS_MSS_R5SS1_A_ETM_SQ23EVR
  [31:0] MSS_R5SS1_ETM_SQ13EVR — Not Defined
0x5C18C DEBUGSS_MSS_R5SS1_A_ETM_SQ31EVR
  [31:0] MSS_R5SS1_ETM_SQR — Not Defined
0x5C190 DEBUGSS_MSS_R5SS1_A_ETM_SQ32EVR
  [31:0] MSS_R5SS1_ETM_EXTOUTEVR1 — Not Defined
0x5C194 DEBUGSS_MSS_R5SS1_A_ETM_SQ13EVR
  [31:0] MSS_R5SS1_ETM_EXTOUTEVR2 — Not Defined
0x5C19C DEBUGSS_MSS_R5SS1_A_ETM_SQR
  [31:0] MSS_R5SS1_ETM_EXTOUTEVR3 — Not Defined
0x5C1A0 DEBUGSS_MSS_R5SS1_A_ETM_EXTOUTEVR1
  [31:0] MSS_R5SS1_ETM_EXTOUTEVR4 — Not Defined
{0x5C19C+4i} DEBUGSS_MSS_R5SS1_A_ETM_EXTOUTEVR{i} (i=2..4)
  [31:0] MSS_R5SS1_ETM_CIDCVR{i-1} — Not Defined
0x5C1B0 DEBUGSS_MSS_R5SS1_A_ETM_CIDCVR1
  [31:0] MSS_R5SS1_ETM_CIDCMR — Not Defined
0x5C1B4 DEBUGSS_MSS_R5SS1_A_ETM_CIDCVR2
  [31:0] MSS_R5SS1_ETM_SYNCFR — Not Defined
0x5C1B8 DEBUGSS_MSS_R5SS1_A_ETM_CIDCVR3 ro
  [31:0] MSS_R5SS1_ETM_IDR — Not Defined
0x5C1BC DEBUGSS_MSS_R5SS1_A_ETM_CIDCMR ro
  [31:0] MSS_R5SS1_ETM_CCER — Not Defined
0x5C1E0 DEBUGSS_MSS_R5SS1_A_ETM_SYNCFR
  [31:0] MSS_R5SS1_ETM_EXTINSELR — Not Defined
0x5C1E4 DEBUGSS_MSS_R5SS1_A_ETM_IDR
  [31:0] MSS_R5SS1_ETM_TRACEIDR — Not Defined
0x5C1E8 DEBUGSS_MSS_R5SS1_A_ETM_CCER ro
  [31:0] MSS_R5SS1_ETM_PDSR — Not Defined
0x5C1EC DEBUGSS_MSS_R5SS1_A_ETM_EXTINSELR ro
  [31:0] MSS_R5SS1_ETM_ITETMIF — Not Defined
0x5C200 DEBUGSS_MSS_R5SS1_A_ETM_TRACEIDR wo
  [31:0] MSS_R5SS1_ETM_ITMISCOUT — Not Defined
0x5C314 DEBUGSS_MSS_R5SS1_A_ETM_PDSR ro
  [31:0] MSS_R5SS1_ETM_ITMISCIN — Not Defined
0x5CED8 DEBUGSS_MSS_R5SS1_A_ETM_ITETMIF ro
  [31:0] MSS_R5SS1_ETM_ITTRIGGERACK — Not Defined
0x5CEDC DEBUGSS_MSS_R5SS1_A_ETM_ITMISCOUT wo
  [31:0] MSS_R5SS1_ETM_ITTRIGGERREQ — Not Defined
0x5CEE0 DEBUGSS_MSS_R5SS1_A_ETM_ITMISCIN wo
  [31:0] MSS_R5SS1_ETM_ITATBDATA0 — Not Defined
0x5CEE4 DEBUGSS_MSS_R5SS1_A_ETM_ITTRIGGERACK ro
  [31:0] MSS_R5SS1_ETM_ITATBCTR2 — Not Defined
0x5CEE8 DEBUGSS_MSS_R5SS1_A_ETM_ITTRIGGERREQ wo
  [31:0] MSS_R5SS1_ETM_ITATBCTR1 — Not Defined
0x5CEEC DEBUGSS_MSS_R5SS1_A_ETM_ITATBDATA0 wo
  [31:0] MSS_R5SS1_ETM_ITATBCTR0 — Not Defined
0x5CEF0 DEBUGSS_MSS_R5SS1_A_ETM_ITATBCTR2
  [31:0] MSS_R5SS1_ETM_ITCTRL — Not Defined
0x5CEF4 DEBUGSS_MSS_R5SS1_A_ETM_ITATBCTR1
  [31:0] MSS_R5SS1_ETM_CLAIMSET — Not Defined
0x5CEF8 DEBUGSS_MSS_R5SS1_A_ETM_ITATBCTR0
  [31:0] MSS_R5SS1_ETM_CLAIMCLR — Not Defined
0x5CF00 DEBUGSS_MSS_R5SS1_A_ETM_ITCTRL wo
  [31:0] MSS_R5SS1_ETM_LAR — Not Defined
0x5CFA0 DEBUGSS_MSS_R5SS1_A_ETM_CLAIMSET ro
  [31:0] MSS_R5SS1_ETM_LSR — Not Defined
0x5CFA4 DEBUGSS_MSS_R5SS1_A_ETM_CLAIMCLR ro
  [31:0] MSS_R5SS1_ETM_AUTHSTATUS — Not Defined
0x5CFB0 DEBUGSS_MSS_R5SS1_A_ETM_LAR ro
  [31:0] MSS_R5SS1_ETM_DEVID — Not Defined
0x5CFB4 DEBUGSS_MSS_R5SS1_A_ETM_LSR ro
  [31:0] MSS_R5SS1_ETM_DEVTYPE — Not Defined
0x5CFB8 DEBUGSS_MSS_R5SS1_A_ETM_AUTHSTATUS ro
  [31:0] MSS_R5SS1_ETM_PIDR4 — Not Defined
0x5CFC8 DEBUGSS_MSS_R5SS1_A_ETM_DEVID ro
  [31:0] MSS_R5SS1_ETM_PIDR5 — Not Defined
0x5CFCC DEBUGSS_MSS_R5SS1_A_ETM_DEVTYPE ro
  [31:0] MSS_R5SS1_ETM_PIDR6 — Not Defined
0x5CFD0 DEBUGSS_MSS_R5SS1_A_ETM_PIDR4 ro
  [31:0] MSS_R5SS1_ETM_PIDR7 — Not Defined
{0x5CFC0+4i} DEBUGSS_MSS_R5SS1_A_ETM_PIDR{i} ro (i=5..7)
  [31:0] MSS_R5SS1_ETM_PIDR{i-5} — Not Defined
0x5CFE0 DEBUGSS_MSS_R5SS1_A_ETM_PIDR0 ro
  [31:0] MSS_R5SS1_ETM_PIDR3 — Not Defined
{0x5CFE0+4i} DEBUGSS_MSS_R5SS1_A_ETM_PIDR{i} ro (i=1..3)
  [31:0] MSS_R5SS1_ETM_CIDR{i-1} — Not Defined
0x5CFF0 DEBUGSS_MSS_R5SS1_A_ETM_CIDR0 ro
  [31:0] MSS_R5SS1_ETM_CIDR3 — Not Defined
0x5CFF4 DEBUGSS_MSS_R5SS1_A_ETM_CIDR1
  fields as DEBUGSS_MSS_R5SS1_B_CTI_COMPONENT_ID1
0x5CFF8 DEBUGSS_MSS_R5SS1_A_ETM_CIDR2 ro
  [31:0] MSS_R5SS1_ETM_CCR — Not Defined
0x5CFFC DEBUGSS_MSS_R5SS1_A_ETM_CIDR3
  [31:0] MSS_R5SS1_ETM_TRIGGER — Not Defined
0x5D000 DEBUGSS_MSS_R5SS1_B_ETM_CR
  [31:0] MSS_R5SS1_ETM_ASICCTLR — Not Defined
0x5D004 DEBUGSS_MSS_R5SS1_B_ETM_CCR
  [31:0] MSS_R5SS1_ETM_SR — Not Defined
0x5D008 DEBUGSS_MSS_R5SS1_B_ETM_TRIGGER ro
  [31:0] MSS_R5SS1_ETM_SCR — Not Defined
0x5D00C DEBUGSS_MSS_R5SS1_B_ETM_ASICCTLR
  [31:0] MSS_R5SS1_ETM_TSSCR — Not Defined
0x5D010 DEBUGSS_MSS_R5SS1_B_ETM_SR
  [31:0] MSS_R5SS1_ETM_TECR2 — Not Defined
0x5D014 DEBUGSS_MSS_R5SS1_B_ETM_SCR
  [31:0] MSS_R5SS1_ETM_TEEVR — Not Defined
0x5D018 DEBUGSS_MSS_R5SS1_B_ETM_TSSCR
  [31:0] MSS_R5SS1_ETM_TECR1 — Not Defined
0x5D01C DEBUGSS_MSS_R5SS1_B_ETM_TECR2
  [31:0] MSS_R5SS1_ETM_FFRR — Not Defined
0x5D020 DEBUGSS_MSS_R5SS1_B_ETM_TEEVR
  [31:0] MSS_R5SS1_ETM_FFLR — Not Defined
0x5D024 DEBUGSS_MSS_R5SS1_B_ETM_TECR1
  [31:0] MSS_R5SS1_ETM_VDEVR — Not Defined
0x5D028 DEBUGSS_MSS_R5SS1_B_ETM_FFRR
  [31:0] MSS_R5SS1_ETM_VDCR1 — Not Defined
0x5D02C DEBUGSS_MSS_R5SS1_B_ETM_FFLR
  [31:0] MSS_R5SS1_ETM_VDCR2 — Not Defined
0x5D030 DEBUGSS_MSS_R5SS1_B_ETM_VDEVR
  [31:0] MSS_R5SS1_ETM_VDCR3 — Not Defined
{0x5D030+4i} DEBUGSS_MSS_R5SS1_B_ETM_VDCR{i} (i=1..3)
  [31:0] MSS_R5SS1_ETM_ACVR{i} — Not Defined
{0x5D03C+4i} DEBUGSS_MSS_R5SS1_B_ETM_ACVR{i} (i=1..13)
  [31:0] MSS_R5SS1_ETM_ACVR{i+3} — Not Defined
{0x5D03C+4i} DEBUGSS_MSS_R5SS1_B_ETM_ACVR{i} (i=14..16)
  [31:0] MSS_R5SS1_ETM_ACTR{i-13} — Not Defined
{0x5D07C+4i} DEBUGSS_MSS_R5SS1_B_ETM_ACTR{i} (i=1..13)
  [31:0] MSS_R5SS1_ETM_ACTR{i+3} — Not Defined
{0x5D07C+4i} DEBUGSS_MSS_R5SS1_B_ETM_ACTR{i} (i=14..16)
  [31:0] MSS_R5SS1_ETM_DCVR{i-13} — Not Defined
{0x5D0B8+8i} DEBUGSS_MSS_R5SS1_B_ETM_DCVR{i} (i=1..5)
  [31:0] MSS_R5SS1_ETM_DCVR{i+3} — Not Defined
{0x5D0B8+8i} DEBUGSS_MSS_R5SS1_B_ETM_DCVR{i} (i=6..8)
  [31:0] MSS_R5SS1_ETM_DCMR{i-5} — Not Defined
{0x5D0F8+8i} DEBUGSS_MSS_R5SS1_B_ETM_DCMR{i} (i=1..5)
  [31:0] MSS_R5SS1_ETM_DCMR{i+3} — Not Defined
{0x5D0F8+8i} DEBUGSS_MSS_R5SS1_B_ETM_DCMR{i} (i=6..8)
  [31:0] MSS_R5SS1_ETM_CNTRLDVR{i-5} — Not Defined
0x5D140 DEBUGSS_MSS_R5SS1_B_ETM_CNTRLDVR1
  [31:0] MSS_R5SS1_ETM_CNTRLDVR4 — Not Defined
{0x5D13C+4i} DEBUGSS_MSS_R5SS1_B_ETM_CNTRLDVR{i} (i=2..4)
  [31:0] MSS_R5SS1_ETM_CNTENR{i-1} — Not Defined
0x5D150 DEBUGSS_MSS_R5SS1_B_ETM_CNTENR1
  [31:0] MSS_R5SS1_ETM_CNTENR4 — Not Defined
{0x5D14C+4i} DEBUGSS_MSS_R5SS1_B_ETM_CNTENR{i} (i=2..4)
  [31:0] MSS_R5SS1_ETM_CNTRLDEVR{i-1} — Not Defined
0x5D160 DEBUGSS_MSS_R5SS1_B_ETM_CNTRLDEVR1
  [31:0] MSS_R5SS1_ETM_CNTRLDEVR4 — Not Defined
{0x5D15C+4i} DEBUGSS_MSS_R5SS1_B_ETM_CNTRLDEVR{i} (i=2..4)
  [31:0] MSS_R5SS1_ETM_CNTVR{i-1} — Not Defined
0x5D170 DEBUGSS_MSS_R5SS1_B_ETM_CNTVR1
  [31:0] MSS_R5SS1_ETM_CNTVR4 — Not Defined
0x5D174 DEBUGSS_MSS_R5SS1_B_ETM_CNTVR2
  [31:0] MSS_R5SS1_ETM_SQ12EVR — Not Defined
0x5D178 DEBUGSS_MSS_R5SS1_B_ETM_CNTVR3
  [31:0] MSS_R5SS1_ETM_SQ21EVR — Not Defined
0x5D17C DEBUGSS_MSS_R5SS1_B_ETM_CNTVR4
  [31:0] MSS_R5SS1_ETM_SQ23EVR — Not Defined
0x5D180 DEBUGSS_MSS_R5SS1_B_ETM_SQ12EVR
  [31:0] MSS_R5SS1_ETM_SQ31EVR — Not Defined
0x5D184 DEBUGSS_MSS_R5SS1_B_ETM_SQ21EVR
  [31:0] MSS_R5SS1_ETM_SQ32EVR — Not Defined
0x5D188 DEBUGSS_MSS_R5SS1_B_ETM_SQ23EVR
  [31:0] MSS_R5SS1_ETM_SQ13EVR — Not Defined
0x5D18C DEBUGSS_MSS_R5SS1_B_ETM_SQ31EVR
  [31:0] MSS_R5SS1_ETM_SQR — Not Defined
0x5D190 DEBUGSS_MSS_R5SS1_B_ETM_SQ32EVR
  [31:0] MSS_R5SS1_ETM_EXTOUTEVR1 — Not Defined
0x5D194 DEBUGSS_MSS_R5SS1_B_ETM_SQ13EVR
  [31:0] MSS_R5SS1_ETM_EXTOUTEVR2 — Not Defined
0x5D19C DEBUGSS_MSS_R5SS1_B_ETM_SQR
  [31:0] MSS_R5SS1_ETM_EXTOUTEVR3 — Not Defined
0x5D1A0 DEBUGSS_MSS_R5SS1_B_ETM_EXTOUTEVR1
  [31:0] MSS_R5SS1_ETM_EXTOUTEVR4 — Not Defined
{0x5D19C+4i} DEBUGSS_MSS_R5SS1_B_ETM_EXTOUTEVR{i} (i=2..4)
  [31:0] MSS_R5SS1_ETM_CIDCVR{i-1} — Not Defined
0x5D1B0 DEBUGSS_MSS_R5SS1_B_ETM_CIDCVR1
  [31:0] MSS_R5SS1_ETM_CIDCMR — Not Defined
0x5D1B4 DEBUGSS_MSS_R5SS1_B_ETM_CIDCVR2
  [31:0] MSS_R5SS1_ETM_SYNCFR — Not Defined
0x5D1B8 DEBUGSS_MSS_R5SS1_B_ETM_CIDCVR3 ro
  [31:0] MSS_R5SS1_ETM_IDR — Not Defined
0x5D1BC DEBUGSS_MSS_R5SS1_B_ETM_CIDCMR ro
  [31:0] MSS_R5SS1_ETM_CCER — Not Defined
0x5D1E0 DEBUGSS_MSS_R5SS1_B_ETM_SYNCFR
  [31:0] MSS_R5SS1_ETM_EXTINSELR — Not Defined
0x5D1E4 DEBUGSS_MSS_R5SS1_B_ETM_IDR
  [31:0] MSS_R5SS1_ETM_TRACEIDR — Not Defined
0x5D1E8 DEBUGSS_MSS_R5SS1_B_ETM_CCER ro
  [31:0] MSS_R5SS1_ETM_PDSR — Not Defined
0x5D1EC DEBUGSS_MSS_R5SS1_B_ETM_EXTINSELR ro
  [31:0] MSS_R5SS1_ETM_ITETMIF — Not Defined
0x5D200 DEBUGSS_MSS_R5SS1_B_ETM_TRACEIDR wo
  [31:0] MSS_R5SS1_ETM_ITMISCOUT — Not Defined
0x5D314 DEBUGSS_MSS_R5SS1_B_ETM_PDSR ro
  [31:0] MSS_R5SS1_ETM_ITMISCIN — Not Defined
0x5DED8 DEBUGSS_MSS_R5SS1_B_ETM_ITETMIF ro
  [31:0] MSS_R5SS1_ETM_ITTRIGGERACK — Not Defined
0x5DEDC DEBUGSS_MSS_R5SS1_B_ETM_ITMISCOUT wo
  [31:0] MSS_R5SS1_ETM_ITTRIGGERREQ — Not Defined
0x5DEE0 DEBUGSS_MSS_R5SS1_B_ETM_ITMISCIN wo
  [31:0] MSS_R5SS1_ETM_ITATBDATA0 — Not Defined
0x5DEE4 DEBUGSS_MSS_R5SS1_B_ETM_ITTRIGGERACK ro
  [31:0] MSS_R5SS1_ETM_ITATBCTR2 — Not Defined
0x5DEE8 DEBUGSS_MSS_R5SS1_B_ETM_ITTRIGGERREQ wo
  [31:0] MSS_R5SS1_ETM_ITATBCTR1 — Not Defined
0x5DEEC DEBUGSS_MSS_R5SS1_B_ETM_ITATBDATA0 wo
  [31:0] MSS_R5SS1_ETM_ITATBCTR0 — Not Defined
0x5DEF0 DEBUGSS_MSS_R5SS1_B_ETM_ITATBCTR2
  [31:0] MSS_R5SS1_ETM_ITCTRL — Not Defined
0x5DEF4 DEBUGSS_MSS_R5SS1_B_ETM_ITATBCTR1
  [31:0] MSS_R5SS1_ETM_CLAIMSET — Not Defined
0x5DEF8 DEBUGSS_MSS_R5SS1_B_ETM_ITATBCTR0
  [31:0] MSS_R5SS1_ETM_CLAIMCLR — Not Defined
0x5DF00 DEBUGSS_MSS_R5SS1_B_ETM_ITCTRL wo
  [31:0] MSS_R5SS1_ETM_LAR — Not Defined
0x5DFA0 DEBUGSS_MSS_R5SS1_B_ETM_CLAIMSET ro
  [31:0] MSS_R5SS1_ETM_LSR — Not Defined
0x5DFA4 DEBUGSS_MSS_R5SS1_B_ETM_CLAIMCLR ro
  [31:0] MSS_R5SS1_ETM_AUTHSTATUS — Not Defined
0x5DFB0 DEBUGSS_MSS_R5SS1_B_ETM_LAR ro
  [31:0] MSS_R5SS1_ETM_DEVID — Not Defined
0x5DFB4 DEBUGSS_MSS_R5SS1_B_ETM_LSR ro
  [31:0] MSS_R5SS1_ETM_DEVTYPE — Not Defined
0x5DFB8 DEBUGSS_MSS_R5SS1_B_ETM_AUTHSTATUS ro
  [31:0] MSS_R5SS1_ETM_PIDR4 — Not Defined
0x5DFC8 DEBUGSS_MSS_R5SS1_B_ETM_DEVID ro
  [31:0] MSS_R5SS1_ETM_PIDR5 — Not Defined
0x5DFCC DEBUGSS_MSS_R5SS1_B_ETM_DEVTYPE ro
  [31:0] MSS_R5SS1_ETM_PIDR6 — Not Defined
0x5DFD0 DEBUGSS_MSS_R5SS1_B_ETM_PIDR4 ro
  [31:0] MSS_R5SS1_ETM_PIDR7 — Not Defined
{0x5DFC0+4i} DEBUGSS_MSS_R5SS1_B_ETM_PIDR{i} ro (i=5..7)
  [31:0] MSS_R5SS1_ETM_PIDR{i-5} — Not Defined
0x5DFE0 DEBUGSS_MSS_R5SS1_B_ETM_PIDR0 ro
  [31:0] MSS_R5SS1_ETM_PIDR3 — Not Defined
{0x5DFE0+4i} DEBUGSS_MSS_R5SS1_B_ETM_PIDR{i} ro (i=1..3)
  [31:0] MSS_R5SS1_ETM_CIDR{i-1} — Not Defined
0x5DFF0 DEBUGSS_MSS_R5SS1_B_ETM_CIDR0 ro
  [31:0] MSS_R5SS1_ETM_CIDR3 — Not Defined
