# AASRC0_DATA_R0 register map
Vendor: Texas Instruments
Peripheral module from a debugger description file (folder J7ES).
Registers are 32-bit, read-write, reset 0x0 unless marked. A register's access mark holds for its fields unless they carry their own. Offsets are as the file gives them; lines under a group give offsets from that group; [hi:lo] are bit positions; {n}, {i} and the like mark numbered series; 'fields as' and 'values as' point back to an identical list; <NAME> marks a mode.

## AASRC0_DATA_R0
0x00 AASRC_GIFDATAL_0
  [31:0] IN_DATA0 — This is where the input samples are written for stream0 left channel
0x04 AASRC_GIFDATAR_0
  [31:0] IN_DATA1 — This is where the input samples are written for stream0 right channel
0x80 AASRC_GOFDATAL_0 ro
  [31:0] OUT_DATA0 — This is from where the output samples are read for stream0 left channel
0x84 AASRC_GOFDATAR_0 ro
  [31:0] OUT_DATA1 — This is from where the output samples are read for stream0 right channel
