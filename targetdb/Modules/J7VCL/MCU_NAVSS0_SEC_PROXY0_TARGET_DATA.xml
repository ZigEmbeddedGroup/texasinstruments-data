# MCU_NAVSS0_SEC_PROXY0_TARGET_DATA register map
Vendor: Texas Instruments
Peripheral module from a debugger description file (folder J7VCL).
Registers are 32-bit, read-only, reset 0x0 unless marked. A register's access mark holds for its fields unless they carry their own. Offsets are as the file gives them; lines under a group give offsets from that group; [hi:lo] are bit positions; {n}, {i} and the like mark numbered series; 'fields as' and 'values as' point back to an identical list; <NAME> marks a mode.

## MCU_NAVSS0_SEC_PROXY0_TARGET_DATA
0x00 SEC_PROXY_DATA_j — The Proxy Private register contains private information for the proxy thread a and should not be written, writes are ignored. Reads are allowed to know the source thread of the message. Offset = 0h + (j * 1000h); where j = 0h to 9Fh for NAVSS0_SEC_PROXY0_SRC_TARGET_DATA j = 0h to 59h for MCU_NAVSS0_SEC_PROXY0_TARGET_DATA
  [9:0] SRC_THR — Proxy source thread of message.
0x04 SEC_PROXY_MESSAGE_j_y rw — The Message Data for proxy thread a. The word with index b = 14 contains the completion final byte. Offset = 4h + (j * 1000h) + (y * 4h); where j = 0h to 9Fh, y = 0h to Eh for NAVSS0_SEC_PROXY0_SRC_TARGET_DATA j = 0h to 59h, y = 0h to Eh for MCU_NAVSS0_SEC_PROXY0_TARGET_DATA
  [31:0] DATA — Proxy Message Data
