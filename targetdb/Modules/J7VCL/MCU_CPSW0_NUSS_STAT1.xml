# MCU_CPSW0_NUSS_STAT1 register map
Vendor: Texas Instruments
Peripheral module from a debugger description file (folder J7VCL).
Registers are 32-bit, read-write, reset 0x0 unless marked. A register's access mark holds for its fields unless they carry their own. Offsets are as the file gives them; lines under a group give offsets from that group; [hi:lo] are bit positions; {n}, {i} and the like mark numbered series; 'fields as' and 'values as' point back to an identical list; <NAME> marks a mode.

## MCU_CPSW0_NUSS_STAT1
0x3A200 CPSW_STAT1_RXGOODFRAMES — The total number of good frames received on the port. A good frame is defined to be:- Any data or MAC control frame which matched a unicast, broadcast or multicast address, or matched due to promiscuous mode- Had a length of 64 to [13-0] RX_MAXLEN bytes inclusive- Had no CRC error, alignment error or code error.See the and statistic descriptions for definitions of alignment, code and CRC errors. Overruns have no effect upon this statistic.
  [31:0] COUNT — Total number of good frames received
0x3A204 CPSW_STAT1_RXBROADCASTFRAMES — The total number of good broadcast frames received on the port. A good broadcast frame is defined to be:- Any data or MAC control frame which was destined for only address 0xFFFFFFFFFFFF- Had a length of [13-0] RX_MAXLEN bytes inclusive- Had no CRC error, alignment error or code error.See the and statistic descriptions for definitions of alignment, code and CRC errors. Overruns have no effect upon this statistic.
  [31:0] COUNT — Total number of good broadcast frames received
0x3A208 CPSW_STAT1_RXMULTICASTFRAMES — The total number of good multicast frames received on the port. A good multicast frame is defined to be:- Any data or MAC control frame which was destined for any multicast address other than 0xFFFFFFFFFFFF- Had a length of [13-0] RX_MAXLEN bytes inclusive- Had no CRC error, alignment error or code error.See the and statistic descriptions for definitions of alignment, code and CRC errors. Overruns have no effect upon this statistic.
  [31:0] COUNT — Total number of good multicast frames received
0x3A20C CPSW_STAT1_RXPAUSEFRAMES — The total number of IEEE 802.3X pause frames received by the port (whether acted upon or not). Such a frame:- Contained any unicast, broadcast, or multicast address- Contained the length/type field value 88.08 (hex) and the opcode 0x0001- Was of length 64 to [13-0] RX_MAXLEN bytes inclusive- Had no CRC error, alignment error or code error- Pause-frames had been enabled on the port ([4] TX_FLOW_EN = 1h). The port could have been in either half or full-duplex mode.See the and statistic descriptions for definitions of alignment, code and CRC errors. Overruns have no effect upon this statistic.
  [31:0] COUNT — Total number of pause frames received
0x3A210 CPSW_STAT1_RXCRCERRORS — The total number of frames received on the port that experienced a CRC error. Such a frame:- Was any data or MAC control frame which matched a unicast, broadcast or multicast address, or matched due to promiscuous mode- Was of length 64 to [13-0] RX_MAXLEN bytes inclusive- Had no code/align error,- Had a CRC error Overruns have no effect upon this statistic.A CRC error is defined to be:- A frame containing an even number of nibbles- Failing the Frame Check Sequence test
  [31:0] COUNT — Total number of CRC errors frames received.
0x3A214 CPSW_STAT1_RXALIGNCODEERRORS — The total number of frames received on the port that experienced an alignment error or code error. Such a frame:- Was any data or MAC control frame which matched a unicast, broadcast or multicast address, or matched due to promiscuous mode- Was of length 64 to [13-0] RX_MAXLEN bytes inclusive- Had either an alignment error or a code error Overruns have no effect upon this statistic. An alignment error is defined to be:- A frame containing an odd number of nibbles- Failing the Frame Check Sequence test if the final nibble is ignoredA code error is defined to be a frame which has been discarded because the port's MRXER pin driven with a one for at least one bit-time's duration at any point during the frame's reception.Note: RFC 1757 etherStatsCRCAlignErrors Ref. 1.5 can be calculated by summing and .
  [31:0] COUNT — Total number of alignment/code errors received
0x3A218 CPSW_STAT1_RXOVERSIZEDFRAMES — The total number of oversized frames received on the port. An oversized frame is defined to be:- Was any data or MAC control frame which matched a unicast, broadcast or multicast address, or matched due to promiscuous mode- Was greater than [13-0] RX_MAXLEN in bytes- Had no CRC error, alignment error or code errorSee the and statistic descriptions for definitions of alignment, code and CRC errors. Overruns have no effect upon this statistic.
  [31:0] COUNT — Total number of oversized frames received
0x3A21C CPSW_STAT1_RXJABBERFRAMES — The total number of jabber frames received on the port. A jabber frame:- Was any data or MAC control frame which matched a unicast, broadcast or multicast address, or matched due to promiscuous mode- Was greater than [13-0] RX_MAXLEN in bytes- Had no CRC error, alignment error or code errorSee the and statistic descriptions for definitions of alignment, code and CRC errors. Overruns have no effect upon this statistic.
  [31:0] COUNT — Total number of jabber frames received.
0x3A220 CPSW_STAT1_RXUNDERSIZEDFRAMES — The total number of undersized frames received on the port. An undersized frame is defined to be:- Was any data frame which matched a unicast, broadcast or multicast address, or matched due to promiscuous mode- Was less than 64 octets long- Had no CRC error, alignment error or code errorSee the and statistic descriptions for definitions of alignment, code and CRC errors. Overruns have no effect upon this statistic.
  [31:0] COUNT — Total number of undersized frames received
0x3A224 CPSW_STAT1_RXFRAGMENTS — The total number of frame fragments received on the port. A frame fragment is defined to be:- Any data frame (address matching does not matter)- Less than 64 bytes long- Having a CRC error, an alignment error, or a code error- Not the result of a collision caused by half duplex, collision based flow controlSee the and statistic descriptions for definitions of alignment, code and CRC errors. Overruns have no effect upon this statistic.
  [31:0] COUNT — Total number of fragmented frames received.
0x3A228 CPSW_STAT1_ALE_DROP — Total number of frames dropped by the ALE.
  [31:0] COUNT
0x3A22C CPSW_STAT1_ALE_OVERRUN_DROP — Total number of overrun frames dropped by the ALE.
  [31:0] COUNT — Total number of overrun frames dropped by the ALE
0x3A230 CPSW_STAT1_RXOCTETS — The total number of bytes in all good frames received on the port. A good frame is defined to be:- Any data or MAC control frame which matched a unicast, broadcast or multicast address, or matched due to promiscuous mode- Of length 64 to [13-0] RX_MAXLEN bytes inclusive- Had no CRC error, alignment error or code errorSee the and statistic descriptions for definitions of alignment, code and CRC errors. Overruns have no effect upon this statistic.
  [31:0] COUNT — Total number of received bytes in good frames
0x3A234 CPSW_STAT1_TXGOODFRAMES — The total number of good frames received on the port. A good frame is defined to be:- Any data or MAC control frame which matched a unicast, broadcast or multicast address, or matched due to promiscuous mode- Any length- Had no late or excessive collisions, no carrier loss and no underrun.
  [31:0] COUNT — Total number of good frames transmitted
0x3A238 CPSW_STAT1_TXBROADCASTFRAMES — The total number of good broadcast frames received on the port. A good broadcast frame is defined to be:- Any data or MAC control frame which was destined for only address 0xFFFFFFFFFFFF- Any length- Had no late or excessive collisions, no carrier loss and no underrun
  [31:0] COUNT — Total number of good broadcast frames transmitted
0x3A23C CPSW_STAT1_TXMULTICASTFRAMES — The total number of good multicast frames received on the port. A good multicast frame is defined to be:- Any data or MAC control frame which was destined for any multicast address other than 0xFFFFFFFFFFFF- Any length- Had no late or excessive collisions, no carrier loss and no underrun.
  [31:0] COUNT — Total number of good multicast frames transmitted
0x3A240 CPSW_STAT1_TXPAUSEFRAMES — This statistic indicates the number of IEEE 802.3X pause frames transmitted by the port. Pause frames cannot underrun or contain a CRC error because they are created in the transmitting MAC, so these error conditions have no effect upon the statistic. Pause frames sent by software will not be included in this count. Since pause frames are only transmitted in full duplex carrier loss and collisions have no effect upon this statistic. Transmitted pause frames are always 64 byte multicast frames so will appear in the and statistics.
  [31:0] COUNT — Total number of pause frames transmitted
0x3A244 CPSW_STAT1_TXDEFERREDFRAMES — The total number of frames transmitted on the port that first experienced deferment. Such a frame:- Was any data or MAC control frame destined for any unicast, broadcast or multicast address- Was any size- Had no carrier loss and no underrun- Experienced no collisions before being successfully transmitted- Found the medium busy when transmission was first attempted, so had to wait. CRC errors have no effect upon this statistic.
  [31:0] COUNT — Total number of deferred frames transmitted
0x3A248 CPSW_STAT1_TXCOLLISIONFRAMES — This statistic records the total number of times that the port experienced a collision. Collisions occur under two circumstances.1. When a transmit data or MAC control frame:- Was destined for any unicast, broadcast or multicast address- Was any size- Had no carrier loss and no underrun- Experienced a collision. A jam sequence is sent for every non-late collision, so this statistic will increment on each occasion if a frame experiences multiple collisions (and increments on late collisions) CRC errors have no effect upon this statistic.2. When the port is in half-duplex mode, flow control is active, and a frame reception begins.
  [31:0] COUNT — Total number of transmitted frames experiencing a collision
0x3A24C CPSW_STAT1_TXSINGLECOLLFRAMES — The total number of frames transmitted on the port that experienced exactly one collision. Such a frame:- Was any data or MAC control frame destined for any unicast, broadcast or multicast address- Was any size- Had no carrier loss and no underrun- Experienced one collision before successful transmission. The collision was not late.CRC errors have no effect upon this statistic.
  [31:0] COUNT — Total number of transmitted frames experiencing a single collision
0x3A250 CPSW_STAT1_TXMULTCOLLFRAMES — The total number of frames transmitted on the port that experienced multiple collisions. Such a frame:- Was any data or MAC control frame destined for any unicast, broadcast or multicast address- Was any size- Had no carrier loss and no underrun- Experienced 2 to 15 collisions before being successfully transmitted. None of the collisions were late.CRC errors have no effect upon this statistic.
  [31:0] COUNT — Total number of transmitted frames experiencing multiple collisions
0x3A254 CPSW_STAT1_TXEXCESSIVECOLLISIONS — The total number of frames for which transmission was abandoned due to excessive collisions. Such a frame:- Was any data or MAC control frame destined for any unicast, broadcast or multicast address- Was any size- Had no carrier loss and no underrun- Experienced 16 collisions before abandoning all attempts at transmitting the frame. None of the collisions were late.CRC errors have no effect upon this statistic.
  [31:0] COUNT — Total number of transmitted frames abandoned due to excessive collisions
0x3A258 CPSW_STAT1_TXLATECOLLISIONS — The total number of frames on the port for which transmission was abandoned because they experienced a late collision. Such a frame:- Was any data or MAC control frame destined for any unicast, broadcast or multicast address- Was any size- Experienced a collision later than 512 bit-times into the transmission. There may have been up to 15 previous (non-late) collisions which had previously required the transmission to be re-attempted. The Late Collisions statistic dominates over the single, multiple and excessive Collisions statistics - if a late collision occurs the frame will not be counted in any of these other three statistics.CRC errors have no effect upon this statistic.
  [31:0] COUNT — Total number of transmitted frames abandoned due to a late collision
0x3A25C CPSW_STAT1_RXIPGERROR — Total number of receive inter-packet gap errors (10G only).
  [31:0] COUNT — Total number of receive inter-packet gap errors (10G only)
0x3A260 CPSW_STAT1_TXCARRIERSENSEERRORS — The total number of frames received on the port that had a middle of frame (MOF) overrun. MOF overrun frame is defined to be:- Was any data or MAC control frame destined for any unicast, broadcast or multicast address- Was any size- The carrier sense condition was lost or never asserted when transmitting the frame (the frame is not retransmitted). This is a transmit only statistic. Carrier Sense is a don't care for received frames. Transmit frames with carrier sense errors are sent until completion and are not aborted.CRC errors have no effect upon this statistic.
  [31:0] COUNT — Total number of transmitted frames that experienced a carrier loss
0x3A264 CPSW_STAT1_TXOCTETS — The total number of bytes in all good frames transmitted on the port. A good frame is defined to be:- Any data or MAC control frame which was destined for any unicast, broadcast or multicast address- Was any size- Had no late or excessive collisions, no carrier loss and no underrun.
  [31:0] COUNT — Total number of bytes in all good frames transmitted
0x3A268 CPSW_STAT1_OCTETFRAMES64 — The total number of 64-byte frames received and transmitted on the port. Such a frame is defined to be:- Any data or MAC control frame which was destined for any unicast, broadcast or multicast address- Did not experience late collisions, excessive collisions, or carrier sense error- Was exactly 64 bytes long. (If the frame was being transmitted and experienced carrier loss that resulted in a frame of this size being transmitted, then the frame will be recorded in this statistic).CRC errors, code/align errors and overruns do not affect the recording of frames in this statistic.
  [31:0] COUNT — Total number of 64-byte frames received and transmitted
0x3A26C CPSW_STAT1_OCTETFRAMES65T127 — The total number of frames of size 65 to 127 bytes received and transmitted on the port. Such a frame is defined to be:- Any data or MAC control frame which was destined for any unicast, broadcast or multicast address- Did not experience late collisions, excessive collisions, or carrier sense error- Was 65 to 127 bytes longCRC errors, code/align errors, underruns and overruns do not affect the recording of frames in this statistic.
  [31:0] COUNT — Total number of frames of size 65 to 127 bytes received and transmitted
0x3A270 CPSW_STAT1_OCTETFRAMES128T255 — The total number of frames of size 128 to 255 bytes received and transmitted on the port. Such a frame is defined to be:- Any data or MAC control frame which was destined for any unicast, broadcast or multicast address- Did not experience late collisions, excessive collisions, or carrier sense error- Was 128 to 255 bytes longCRC errors, code/align errors, underruns and overruns do not affect the recording of frames in this statistic.
  [31:0] COUNT — Total number of frames of size 128 to 255 bytes received and transmitted
0x3A274 CPSW_STAT1_OCTETFRAMES256T511 — The total number of frames of size 256 to 511 bytes received and transmitted on the port. Such a frame is defined to be:- Any data or MAC control frame which was destined for any unicast, broadcast or multicast address- Did not experience late collisions, excessive collisions, or carrier sense error- Was 256 to 511 bytes longCRC errors, code/align errors, underruns and overruns do not affect the recording of frames in this statistic.
  [31:0] COUNT — Total number of frames of size 256 to 511 bytes received and transmitted
0x3A278 CPSW_STAT1_OCTETFRAMES512T1023 — The total number of frames of size 512 to 1023 bytes received and transmitted on the port. Such a frame is defined to be:- Any data or MAC control frame which was destined for any unicast, broadcast or multicast address- Did not experience late collisions, excessive collisions, or carrier sense error- Was 512 to 1023 bytes longCRC errors, code/align errors, underruns and overruns do not affect the recording of frames in this statistic.
  [31:0] COUNT — Total number of frames of size 512 to 1023 bytes received and transmitted
0x3A27C CPSW_STAT1_OCTETFRAMES1024TUP — The total number of frames of size 1024 to [13-0] RX_MAXLEN bytes for receive or 1024 up for transmit on the port. Such a frame is defined to be:- Any data or MAC control frame which was destined for any unicast, broadcast or multicast address- Did not experience late collisions, excessive collisions, or carrier sense error- Was 1024 to [13-0] RX_MAXLEN bytes long on receive, or any size on transmitCRC errors, code/align errors, underruns and overruns do not affect the recording of frames in this statistic.
  [31:0] COUNT — Total number of frames of size 1024 to rx_maxlen bytes received and 1024 bytes or greater transmitted
0x3A280 CPSW_STAT1_NETOCTETS — The total number of bytes of frame data received and transmitted on the port. Each frame counted:- was any data or MAC control frame destined for any unicast, broadcast or multicast address (address match does not matter)- Any length (including less than 64 bytes and greater than CPSW0_P0_RX_MAXLEN_REG[13-0] RX_MAXLEN bytes)Also counted in this statistic is:- Every byte transmitted before a carrier- loss was experienced- Every byte transmitted before each collision was experienced, (i.e. multiple retries are counted each time)- Every byte received if the port is in half-duplex mode until a jam sequence was transmitted to initiate flow control. (The jam sequence was not counted to prevent double-counting)Error conditions such as alignment errors, CRC errors, code errors, overruns and underruns do not affect the recording of bytes by this statistic. The objective of this statistic is to give a reasonable indication of ethernet utilization
  [31:0] COUNT — Total number of bytes received and transmitted
0x3A284 CPSW_STAT1_RX_BOTTOM_OF_FIFO_DROP — Receive Bottom of FIFO Drop.
  [31:0] COUNT
0x3A288 CPSW_STAT1_PORTMASK_DROP — Total number of dropped frames received due to portmask.
  [31:0] COUNT
0x3A28C CPSW_STAT1_RX_TOP_OF_FIFO_DROP — Receive Top of FIFO Drop.
  [31:0] COUNT
0x3A290 CPSW_STAT1_ALE_RATE_LIMIT_DROP — Total number of dropped frames due to ALE Rate Limiting.
  [31:0] COUNT
0x3A294 CPSW_STAT1_ALE_VID_INGRESS_DROP — Total number of dropped frames due to ALE VID Ingress.
  [31:0] COUNT
0x3A298 CPSW_STAT1_ALE_DA_EQ_SA_DROP — Total number of dropped frames due to DA=SA.
  [31:0] COUNT
0x3A29C CPSW_STAT1_ALE_BLOCK_DROP — Total number of dropped frames due to ALE Block Mode.
  [31:0] COUNT
0x3A2A0 CPSW_STAT1_ALE_SECURE_DROP — Total number of dropped frames due to ALE Secure Mode.
  [31:0] COUNT
0x3A2A4 CPSW_STAT1_ALE_AUTH_DROP — Total number of dropped frames due to ALE Authentication.
  [31:0] COUNT
0x3A2A8 CPSW_STAT1_ALE_UNKN_UNI — ALE Receive Unknown Unicast.
  [31:0] COUNT
0x3A2AC CPSW_STAT1_ALE_UNKN_UNI_BCNT — ALE Receive Unknown Unicast Bytecount.
  [31:0] COUNT
0x3A2B0 CPSW_STAT1_ALE_UNKN_MLT — ALE Receive Unknown Multicast.
  [31:0] COUNT
0x3A2B4 CPSW_STAT1_ALE_UNKN_MLT_BCNT — ALE Receive Unknown Multicast Bytecount.
  [31:0] COUNT
0x3A2B8 CPSW_STAT1_ALE_UNKN_BRD — ALE Receive Unknown Broadcast.
  [31:0] COUNT
0x3A2BC CPSW_STAT1_ALE_UNKN_BRD_BCNT — ALE Receive Unknown Broadcast Bytecount.
  [31:0] COUNT
0x3A2C0 CPSW_STAT1_ALE_POL_MATCH — ALE Policer Matched.
  [31:0] COUNT
0x3A2C4 CPSW_STAT1_ALE_POL_MATCH_RED — ALE Policer Matched and Condition Red.
  [31:0] COUNT
0x3A2C8 CPSW_STAT1_ALE_POL_MATCH_YELLOW — ALE Policer Matched and Condition Yellow.
  [31:0] COUNT
0x3A2CC CPSW_STAT1_ALE_MULT_SA_DROP — ALE Multicast Source Address Drop
  [31:0] COUNT — ALE Multicast Source Address drop
0x3A2D0 CPSW_STAT1_ALE_DUAL_VLAN_DROP — ALE Dual VLAN Drop
  [31:0] COUNT — ALE Dual VLAN drop
0x3A2D4 CPSW_STAT1_ALE_LEN_ERROR_DROP — ALE Length Error Drop
  [31:0] COUNT — ALE Length Error drop
0x3A2D8 CPSW_STAT1_ALE_IP_NEXT_HDR_DROP — ALE IP Next Header Drop
  [31:0] COUNT — ALE Next Header drop
0x3A2DC CPSW_STAT1_ALE_IPV4_FRAG_DROP — ALE IPV4 Frag Drop
  [31:0] COUNT — ALE IPV4 Fragment drop
0x3A340 CPSW_STAT1_IET_RX_ASSEMBLY_ERROR_REG — IET Receive Assembly Error
  [31:0] IET_RX_ASSEMBLY_ERROR
0x3A344 CPSW_STAT1_IET_RX_ASSEMBLY_OK_REG — IET Receive Assembly Ok
  [31:0] IET_RX_ASSEMBLY_OK
0x3A348 CPSW_STAT1_IET_RX_SMD_ERROR_REG — IET Receive Smd Error
  [31:0] IET_RX_SMD_ERROR
0x3A34C CPSW_STAT1_IET_RX_FRAG_REG — IET Receive Frag
  [31:0] IET_RX_FRAG
0x3A350 CPSW_STAT1_IET_TX_HOLD_REG — IET Transmit Hold
  [31:0] IET_TX_HOLD
0x3A354 CPSW_STAT1_IET_TX_FRAG_REG — IET Transmit Frag
  [31:0] IET_TX_FRAG
0x3A37C CPSW_STAT1_TX_MEMORY_PROTECT_ERROR — Transmit Memory Protect CRC Error.
  [7:0] COUNT
0x3A380 CPSW_STAT1_ENET_PN_TX_PRI_REG_y — ENET Port n PRIORITY N Packet Count. Offset = 0003A380h + (y * 4h); where y = 0h to 7h.
  [31:0] PN_TX_PRIN — Enet Port n Priority N Packet Count.
0x3A3A0 CPSW_STAT1_ENET_PN_TX_PRI_BCNT_REG_y — ENET Port n PRIORITY N Packet Byte Count. Offset = 0003A3A0h + (y * 4h); where y = 0h to 7h.
  [31:0] PN_TX_PRIN_BCNT — ENET Port n PRIORITY N Packet Byte Count.
0x3A3C0 CPSW_STAT1_ENET_PN_TX_PRI_DROP_REG_y — ENET Port n PRIORITY N Packet Drop Count. Offset = 0003A3C0h + (y * 4h); where y = 0h to 7h.
  [31:0] PN_TX_PRIN_DROP — ENET Port n PRIORITY N Packet Drop Count.
0x3A3E0 CPSW_STAT1_ENET_PN_TX_PRI_DROP_BCNT_REG_y — ENET Port n PRIORITY N Packet Drop Byte Count. Offset = 0003A3E0h + (y * 4h); where y = 0h to 7h.
  [31:0] PN_TX_PRIN_DROP_BCNT — ENET Port n PRIORITY N Packet Drop Byte Count.
