# MCU_NAVSS0_UDMASS_INTA0_CFG_INTR register map
Vendor: Texas Instruments
Peripheral module from a debugger description file (folder J7VCL).
Registers are 64-bit, access not given, no defined reset value unless marked. A register's access mark holds for its fields unless they carry their own. Offsets are as the file gives them; lines under a group give offsets from that group; [hi:lo] are bit positions; {n}, {i} and the like mark numbered series; 'fields as' and 'values as' point back to an identical list; <NAME> marks a mode.

## MCU_NAVSS0_UDMASS_INTA0_CFG_INTR
0x00 UDMA_INTA_ENABLE_SET_j — The Interrupt Enable Set register is written by software to enable (i.e. unmask) specified bits to allow their current status to be considered in the generation of the corresponding level sensitive virtual interrupt output. Offset = 0h + (j * 1000h); where j = 0h to FFh
  [63:0] ENABLE — Interrupt enable set value. On writes, set bits will cause corresponding bits in the internal interrupt enable register to be set. Reads will reflect back the current status of the internal interrupt enable register. (access RW1S)
0x08 UDMA_INTA_ENABLE_CLEAR_j — The Interrupt Enable Clear register is written by software to disable (i.e. mask) specified bits to disallow their current status from be considered in the generation of the corresponding level sensitive virtual interrupt output. Offset = 8h + (j * 1000h); where j = 0h to FFh
  [63:0] ENABLE — Interrupt enable clear value. On writes, set bits will cause corresponding bits in the internal interrupt enable register to be cleared. Reads will reflect back the current status of the internal interrupt enable register. (access RW1C)
0x10 UDMA_INTA_STATUS_SET_j — The Interrupt Status register is read by software to determine the cause of an interrupt. Offset = 10h + (j * 1000h); where j = 0h to FFh
  [63:0] STATUS — Raw state (not enabled/masked) of bits in internal interrupt status register. Writing a 1 to any bit of this register will cause the corresponding raw status bit to be set (access RW1S)
0x18 UDMA_INTA_STATUS_CLEAR_j — The Interrupt Status register is read by software to determine the cause of an interrupt. Offset = 18h + (j * 1000h); where j = 0h to FFh
  [63:0] STATUS — Raw state (not enabled/masked) of bits in internal interrupt status register. Writing a 1 to any bit of this register will cause the corresponding raw status bit to be cleared (access RW1C)
0x20 UDMA_INTA_STATUSM_j ro — The Interrupt Masked Status register can be read by software to determine the cause of an interrupt. Offset = 20h + (j * 1000h); where j = 0h to FFh
  [63:0] STATUS — Masked state of bits in internal interrupt status register. This value is the result of bitwise ANDing the interrupt enable and status registers
