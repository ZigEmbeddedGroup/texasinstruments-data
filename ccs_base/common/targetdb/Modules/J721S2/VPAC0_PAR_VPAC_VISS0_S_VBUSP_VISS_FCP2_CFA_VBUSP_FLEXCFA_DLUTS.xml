# VPAC0_PAR_VPAC_VISS0_S_VBUSP_VISS_FCP2_CFA_VBUSP_FLEXCFA_DLUTS register map
Vendor: Texas Instruments
Peripheral module from a debugger description file (folder J721S2).
Registers are 32-bit, read-write, reset 0x0 unless marked. A register's access mark holds for its fields unless they carry their own. Offsets are as the file gives them; lines under a group give offsets from that group; [hi:lo] are bit positions; {n}, {i} and the like mark numbered series; 'fields as' and 'values as' point back to an identical list; <NAME> marks a mode.

## VPAC0_PAR_VPAC_VISS0_S_VBUSP_VISS_FCP2_CFA_VBUSP_FLEXCFA_DLUTS
{0x0+0x1000*i} PAR_VPAC_VISS0__S_VBUSP__VISS_FCP2__CFA_VBUSP__FLEXCFA_DLUTS_DLUT{i} (i=0..3) — The LUT table contains the information used to expand the pixel width from 16 to 24
  [23:0] LUT_ENTRY — The lower LUT entry
