# NAVSS0_UDMASS_INTA_0_ALIAS64K_UDMASS_INTA0_CFG_INTR register map
Vendor: Texas Instruments
Peripheral module from a debugger description file (folder J721S2).
Registers are 64-bit, access not given, reset 0x0 unless marked. A register's access mark holds for its fields unless they carry their own. Offsets are as the file gives them; lines under a group give offsets from that group; [hi:lo] are bit positions; {n}, {i} and the like mark numbered series; 'fields as' and 'values as' point back to an identical list; <NAME> marks a mode.

## NAVSS0_UDMASS_INTA_0_ALIAS64K_UDMASS_INTA0_CFG_INTR
0x00 ALIAS64K_UDMASS_INTA0__CFG__INTR_ENABLE_SET — The Interrupt Enable Set register is written by software to enable (i.e. unmask) specified bits to allow their current status to be considered in the generation of the corresponding level sensitive virtual interrupt output.
  [63:0] INTR_ENABLE — Interrupt enable set value. On writes, set bits will cause corresponding bits in the internal interrupt enable register to be set. Reads will reflect back the current status of the internal interrupt enable register. (access R/W1TS)
0x08 ALIAS64K_UDMASS_INTA0__CFG__INTR_ENABLE_CLR — The Interrupt Enable Clear register is written by software to disable (i.e. mask) specified bits to disallow their current status from be considered in the generation of the corresponding level sensitive virtual interrupt output.
  [63:0] INTR_ENABLE — Interrupt enable clear value. On writes, set bits will cause corresponding bits in the internal interrupt enable register to be cleared. Reads will reflect back the current status of the internal interrupt enable register. (access R/W1TC)
0x10 ALIAS64K_UDMASS_INTA0__CFG__INTR_STATUS_SET — The Interrupt Status register is read by software to determine the cause of an interrupt.
  [63:0] INTR_STATUS — Raw state (not enabled/masked) of bits in internal interrupt status register. Writing a 1 to any bit of this register will cause the corresponding raw status bit to be set (access R/W1TS)
0x18 ALIAS64K_UDMASS_INTA0__CFG__INTR_STATUS — The Interrupt Status register is read by software to determine the cause of an interrupt.
  [63:0] INTR_STATUS — Raw state (not enabled/masked) of bits in internal interrupt status register. Writing a 1 to any bit of this register will cause the corresponding raw status bit to be cleared (access R/W1TC)
0x20 ALIAS64K_UDMASS_INTA0__CFG__INTR_STATUS_MSKD — The Interrupt Masked Status register can be read by software to determine the cause of an interrupt.
  [63:0] INTR_STATUSM — Masked state of bits in internal interrupt status register. This value is the result of bitwise ANDing the interrupt enable and status registers (access R/NA)
