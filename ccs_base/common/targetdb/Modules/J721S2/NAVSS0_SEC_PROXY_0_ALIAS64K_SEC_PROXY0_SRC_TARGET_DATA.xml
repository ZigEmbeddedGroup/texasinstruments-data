# NAVSS0_SEC_PROXY_0_ALIAS64K_SEC_PROXY0_SRC_TARGET_DATA register map
Vendor: Texas Instruments
Peripheral module from a debugger description file (folder J721S2).
Registers are 32-bit, read-only, reset 0x0 unless marked. A register's access mark holds for its fields unless they carry their own. Offsets are as the file gives them; lines under a group give offsets from that group; [hi:lo] are bit positions; {n}, {i} and the like mark numbered series; 'fields as' and 'values as' point back to an identical list; <NAME> marks a mode.

## NAVSS0_SEC_PROXY_0_ALIAS64K_SEC_PROXY0_SRC_TARGET_DATA
0x00 ALIAS64K_SEC_PROXY0__SRC__TARGET_DATA_private — The Proxy Private register contains private information for the proxy thread a and should not be written, writes are ignored. Reads are allowed to know the source thread of the message.
  [9:0] SRC_THR — Proxy source thread of message.
0x04 ALIAS64K_SEC_PROXY0__SRC__TARGET_DATA_message rw — The Message Data for proxy thread a. The word with index b = 14 contains the completion final byte.
  [31:0] DATA — Proxy Message Data
