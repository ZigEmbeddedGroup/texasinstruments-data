# CONTROLSS_PWMSYNCOUTXBAR_CONTROLSS_502D2000h register map
Vendor: Texas Instruments
Peripheral module from a debugger description file (folder AM263P).
Registers are 32-bit, read-write, reset 0x0 unless marked. A register's access mark holds for its fields unless they carry their own. Offsets are as the file gives them; lines under a group give offsets from that group; [hi:lo] are bit positions; {n}, {i} and the like mark numbered series; 'fields as' and 'values as' point back to an identical list; <NAME> marks a mode.

## CONTROLSS
{0x100+0x40*i} CONTROLSS_PWMSYNCOUTXBAR{i}_G0 (i=0..2) — EPWM pwmsyncout XBAR{i} select.
  [31:0] PWMSYNCOUTXBAR{i}_G0_SEL — EPWM pwmsyncout XBAR{i} select1:PWM[x] SYNCOUT selected0:PWM[x] SYNCOUT is de-selected
0x1C0 CONTROLSS_PWMSYNCOUTXBAR3_G0 — EPWM pwmsyncout XBAR2 select.
  [31:0] PWMSYNCOUTXBAR3_G0_SEL — EPWM pwmsyncout XBAR3 select1:PWM[x] SYNCOUT selected0:PWM[x] SYNCOUT is de-selected
0x200 CONTROLSS_PWMSYNCOUTXBAR0_G1 — EPWM pwmsyncout XBAR3 select.
  [15:0] PWMSYNCOUTXBAR0_G1_SEL — EPWM pwmsyncout XBAR0 select1:ECAP[x] SYNCOUT selected0:ECAP[x] SYNCOUT is de-selected
0x240 CONTROLSS_PWMSYNCOUTXBAR1_G1 — EPWM pwmsyncout XBAR3 select.
  [15:0] PWMSYNCOUTXBAR1_G1_SEL — EPWM pwmsyncout XBAR1 select1:ECAP[x] SYNCOUT selected0:ECAP[x] SYNCOUT is de-selected
0x280 CONTROLSS_PWMSYNCOUTXBAR2_G1 — EPWM pwmsyncout XBAR0 select.
  [15:0] PWMSYNCOUTXBAR2_G1_SEL — EPWM pwmsyncout XBAR2 select1:ECAP[x] SYNCOUT selected0:ECAP[x] SYNCOUT is de-selected
0x2C0 CONTROLSS_PWMSYNCOUTXBAR3_G1 — EPWM pwmsyncout XBAR1 select.
  [15:0] PWMSYNCOUTXBAR3_G1_SEL — EPWM pwmsyncout XBAR3 select1:ECAP[x] SYNCOUT selected0:ECAP[x] SYNCOUT is de-selected
