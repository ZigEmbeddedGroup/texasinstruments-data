# CONTROLSS_INPUTXBAR_CONTROLSS_502D0000h register map
Vendor: Texas Instruments
Peripheral module from a debugger description file (folder AM263P).
Registers are 32-bit, read-write, reset 0x0 unless marked. A register's access mark holds for its fields unless they carry their own. Offsets are as the file gives them; lines under a group give offsets from that group; [hi:lo] are bit positions; {n}, {i} and the like mark numbered series; 'fields as' and 'values as' point back to an identical list; <NAME> marks a mode.

## CONTROLSS
{0x100+0x40*i} CONTROLSS_INPUTXBAR{i}_GSEL (i=0..31) — INPUT XBAR{i} Input Select0 : GPI1: ICSS GPO port.
  [1:0] INPUTXBAR{i}_GSEL_GSEL — Select input source Group:0 G0 selected1 G1 selected2 G2 selected
{0x104+0x40*i} CONTROLSS_INPUTXBAR{i}_G0 (i=0..31) — Input GPI XBAR selection - valid inputs are GPI[143:0].
  [7:0] INPUTXBAR{i}_G0_SEL — Select input source:0 G0.0 selected..x G0.x selected
{0x108+0x40*i} CONTROLSS_INPUTXBAR{i}_G1 (i=0..31) — ICSS GPO port selection - ICSS GPO[31:0].
  [4:0] INPUTXBAR{i}_G1_SEL — Select input source:0 G1.0 selected..31 G1.31 selected
{0x10C+0x40*i} CONTROLSS_INPUTXBAR{i}_G2 (i=0..31) — OUTPUTXBAR port selection - OUTPUTXBAR[15:0].
  [3:0] INPUTXBAR{i}_G2_SEL — Select input source:0 G2.0 selected..15 G2.15 selected
