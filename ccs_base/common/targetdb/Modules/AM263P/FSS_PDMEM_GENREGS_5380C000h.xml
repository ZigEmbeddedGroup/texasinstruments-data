# FSS_PDMEM_GENREGS_5380C000h register map
Vendor: Texas Instruments
Peripheral module from a debugger description file (folder AM263P).
Registers are 32-bit, read-write, reset 0x0 unless marked. A register's access mark holds for its fields unless they carry their own. Offsets are as the file gives them; lines under a group give offsets from that group; [hi:lo] are bit positions; {n}, {i} and the like mark numbered series; 'fields as' and 'values as' point back to an identical list; <NAME> marks a mode.

## PDMEM_GENREGS
0x00 PDMEM_GENREGS_LOC_j — M8051EW program and external data memory array.
  [31:0] VAL — Value of element in program and external data memory
