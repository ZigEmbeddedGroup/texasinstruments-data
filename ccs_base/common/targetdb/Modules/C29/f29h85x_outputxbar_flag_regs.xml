# f29h85x_outputxbar_flag_regs register map
Vendor: Texas Instruments
Peripheral module from a debugger description file (folder C29).
Registers are 32-bit, read-only, no defined reset value unless marked. A register's access mark holds for its fields unless they carry their own. Offsets are as the file gives them; lines under a group give offsets from that group; [hi:lo] are bit positions; {n}, {i} and the like mark numbered series; 'fields as' and 'values as' point back to an identical list; <NAME> marks a mode.

## OUTPUTXBAR_FLAG_REGS — OUTPUTXBAR FLAG Registers
0x10 OUTPUTXBARStatus — Output Signal Status register
  [0] STS — Output Signal Status
0x18 OUTPUTXBARFlag — Output latched flag register
  [0] FLG — Output Signal Latched Flag Status
0x1C OUTPUTXBARFlagClear rw — Output latched flag clear register
  [0] FLG — Output Signal Latched Flag Clear
0x20 OUTPUTXBARFlagForce rw — Output latched flag Force register
  [0] FLG — Output Signal Latched Flag Force
