# CONTROLSS_MDLXBAR_CONTROLSS_502D3000h register map
Vendor: Texas Instruments
Peripheral module from a debugger description file (folder AM263X).
Registers are 32-bit, read-write, reset 0x0 unless marked. A register's access mark holds for its fields unless they carry their own. Offsets are as the file gives them; lines under a group give offsets from that group; [hi:lo] are bit positions; {n}, {i} and the like mark numbered series; 'fields as' and 'values as' point back to an identical list; <NAME> marks a mode.

## CONTROLSS
{0x100+0x40*i} CONTROLSS_MDLXBAR{i}_G0 (i=0..14) — MDL XBAR {i} Input Select.
  [31:0] MDLXBAR{i}_G0_SEL — MDL XBAR{i} G0 input bit select. Input source is PWMA sclk select1:PWMA sclk bit[x] selected0:PWMA sclk bit[x] is de-selected
{0x104+0x40*i} CONTROLSS_MDLXBAR{i}_G1 (i=0..14) — MDL XBAR {i} Input Select.
  [31:0] MDLXBAR{i}_G1_SEL — MDL XBAR{i} G1 input bit select. Input source is PWMB sclk select1:PWMB sclk bit[x] selected0:PWMB sclk bit[x] is de-selected
{0x108+0x40*i} CONTROLSS_MDLXBAR{i}_G2 (i=0..14) — MDL XBAR {i} Input Select.
  [31:0] MDLXBAR{i}_G2_SEL — MDL XBAR{i} G2 input bit select. Input source is ICSS GPO selecty=0 when x =0 to 15, y=1 when x=16 to 311:ICSS_PORT[y].GPO[x] selected.0:ICSS_PORT[y].GPO[x] is de-selected
0x4C0 CONTROLSS_MDLXBAR15_G0 — MDL XBAR 15 Input Select .
  [31:0] MDLXBAR15_G0_SEL — MDL XBAR15 G0 input bit select. Input source is PWMA sclk select1:PWMA sclk bit[x] selected0:PWMA sclk bit[x] is de-selected
0x4C4 CONTROLSS_MDLXBAR15_G1 — MDL XBAR 15 Input Select .
  [31:0] MDLXBAR15_G1_SEL — MDL XBAR15 G1 input bit select. Input source is PWMB sclk select1:PWMB sclk bit[x] selected0:PWMB sclk bit[x] is de-selected
0x4C8 CONTROLSS_MDLXBAR15_G2 — MDL XBAR 15 Input Select .
  [31:0] MDLXBAR15_G2_SEL — MDL XBAR15 G2 input bit select. Input source is ICSS GPO selecty=0 when x =0 to 15, y=1 when x=16 to 311:ICSS_PORT[y].GPO[x] selected.0:ICSS_PORT[y].GPO[x] is de-selected
