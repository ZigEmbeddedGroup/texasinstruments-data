# CONTROLSS_PWMSYNCOUTXBAR_CONTROLSS_502D2000h register map
Vendor: Texas Instruments
Peripheral module from a debugger description file (folder AM263X).
Registers are 32-bit, read-write, reset 0x0 unless marked. A register's access mark holds for its fields unless they carry their own. Offsets are as the file gives them; lines under a group give offsets from that group; [hi:lo] are bit positions; {n}, {i} and the like mark numbered series; 'fields as' and 'values as' point back to an identical list; <NAME> marks a mode.

## CONTROLSS
{0x100+0x40*i} CONTROLSS_PWMSYNCOUTXBAR{i}_G0 (i=0..3) — EPWM pwmsyncout XBAR{i} select.
  [31:0] PWMSYNCOUTXBAR{i}_G0_SEL — EPWM pwmsyncout XBAR{i} select1:PWM[x] SYNCOUT selected0:PWM[x] SYNCOUT is de-selected
