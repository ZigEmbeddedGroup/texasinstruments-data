# VPAC0_COMMON_0_IVPAC_TOP_0_CFG_SLV_PAR_VPAC_VISS0_S_VBUSP_VISS_NSF4V_CFG_MEM_MMRRAM_VBUSP_MMR_RAM register map
Vendor: Texas Instruments
Peripheral module from a debugger description file (folder am62A).
Registers are 32-bit, read-write, reset 0x0 unless marked. A register's access mark holds for its fields unless they carry their own. Offsets are as the file gives them; lines under a group give offsets from that group; [hi:lo] are bit positions; {n}, {i} and the like mark numbered series; 'fields as' and 'values as' point back to an identical list; <NAME> marks a mode.

## VPAC0_COMMON_0_IVPAC_TOP_0_CFG_SLV_PAR_VPAC_VISS0_S_VBUSP_VISS_NSF4V_CFG_MEM_MMRRAM_VBUSP_MMR_RAM
0x00 IVPAC_TOP_0__CFG_SLV__PAR_VPAC_VISS0__S_VBUSP__VISS_NSF4V__CFG__MEM_MMR__MMRRAM_VBUSP__MMR_RAM_DBG_MEM — Warning: reading or writing this MMR during operation will corrupt processing resulting in bad output data and will result in error interrupt firing. diagnostic rd/wr access to embedded RAM, for possible purpose of debugging failures
  [31:0] DATA — Adr range selects which RAM address to index. (Wr or rd beyond populated RAM adr result in non productive cycles and rd returns zero)
