# R5SS_TCMA_CORE0_RAM_00020000h register map
Vendor: Texas Instruments
Peripheral module from a debugger description file (folder AM261x).
Registers are 32-bit, read-write, reset 0x0 unless marked. A register's access mark holds for its fields unless they carry their own. Offsets are as the file gives them; lines under a group give offsets from that group; [hi:lo] are bit positions; {n}, {i} and the like mark numbered series; 'fields as' and 'values as' point back to an identical list; <NAME> marks a mode.

## TCMA_CORE0_RAM
0x00 TCMA_CORE0_RAM_START
  [31:0] RAM_START — RAM start address of master sub system tcma
0x1FFFC TCMA_CORE0_RAM_END
  [31:0] RAM_END — RAM end address of master sub system tcma
