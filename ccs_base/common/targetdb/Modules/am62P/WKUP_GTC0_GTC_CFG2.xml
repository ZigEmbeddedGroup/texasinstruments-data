# WKUP_GTC0_GTC_CFG2 register map
Vendor: Texas Instruments
Peripheral module from a debugger description file (folder am62P).
Registers are 32-bit, read-only, reset 0x0 unless marked. A register's access mark holds for its fields unless they carry their own. Offsets are as the file gives them; lines under a group give offsets from that group; [hi:lo] are bit positions; {n}, {i} and the like mark numbered series; 'fields as' and 'values as' point back to an identical list; <NAME> marks a mode.

## WKUP_GTC0_GTC_CFG2
0x00 GTC_CFG2_CNTCVS_LO
  [31:0] CNTCVS_LO_COUNTVALUE — Indicates bits [31:0] of the System Counter value.
0x04 GTC_CFG2_CNTCVS_HI
  [31:0] CNTCVS_HI_COUNTVALUE — Indicates bits [63:32] of the System Counter value.
