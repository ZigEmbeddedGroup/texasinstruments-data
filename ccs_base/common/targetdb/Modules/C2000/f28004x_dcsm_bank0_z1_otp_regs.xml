# f28004x_dcsm_bank0_z1_otp_regs register map
Vendor: Texas Instruments
Peripheral module from a debugger description file (folder C2000).
Address unit: 16 bits
Registers are 32-bit, read-only, no defined reset value unless marked. A register's access mark holds for its fields unless they carry their own. Offsets are as the file gives them; lines under a group give offsets from that group; [hi:lo] are bit positions; {n}, {i} and the like mark numbered series; 'fields as' and 'values as' point back to an identical list; <NAME> marks a mode.

## DCSM_BANK0_Z1_OTP — DCSM BANK0 Z1 OTP Registers
0x00 B0_Z1OTP_LINKPOINTER1 — Zone 1 Link Pointer1 in Z1 OTP for flash BANK0
  [31:0] B0_Z1OTP_LINKPOINTER1 — Zone1 Link Pointer 1 location in USER OTP of Flash BANK0.
0x04 B0_Z1OTP_LINKPOINTER2 — Zone 1 Link Pointer2 in Z1 OTP for flash BANK0
  [31:0] B0_Z1OTP_LINKPOINTER2 — Zone1 Link Pointer 2 location in USER OTP of Flash BANK0.
0x08 B0_Z1OTP_LINKPOINTER3 — Zone 1 Link Pointer3 in Z1 OTP for flash BANK0
  [31:0] B0_Z1OTP_LINKPOINTER3 — Zone1 Link Pointer 3 location in USER OTP of Flash BANK0.
0x0C Z1OTP_BOOTPIN_CONFIG — Boot Pin Configuration
  [31:0] Z1OTP_BOOTPIN_CONFIG — Zone1 Boot pin config register location in USER OTP.
0x0E Z1OTP_GPREG2 — Zone-1 General Purpose Register-2 content
  [31:0] Z1OTP_GPREG2 — Zone1 General Purpose register location in USER OTP.
0x10 Z1OTP_PSWDLOCK — Secure Password Lock in Z1 OTP
  [31:0] Z1OTP_PSWDLOCK — Zone1 Password lock location in USER OTP.
0x14 Z1OTP_CRCLOCK — Secure CRC Lock in Z1 OTP
  [31:0] Z1OTP_CRCLOCK — Zone1 CRC lock location in USER OTP.
0x18 Z1OTP_JTAGLOCK access not given — Secure JTAG Lock in Z1 OTP
0x1C Z1OTP_BOOTDEF_LOW — Boot definition (low 32bit)
  [31:0] Z1OTP_BOOTDEF_LOW — Zone1 Boot definition register location in USER OTP.
0x1E Z1OTP_BOOTDEF_HIGH — Boot definition (high 32bit)
  [31:0] Z1OTP_BOOTDEF_HIGH — Zone1 Boot definition location in USER OTP.
