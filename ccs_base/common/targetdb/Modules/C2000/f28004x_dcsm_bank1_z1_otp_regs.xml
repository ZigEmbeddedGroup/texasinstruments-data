# f28004x_dcsm_bank1_z1_otp_regs register map
Vendor: Texas Instruments
Peripheral module from a debugger description file (folder C2000).
Address unit: 16 bits
Registers are 32-bit, read-only, no defined reset value unless marked. A register's access mark holds for its fields unless they carry their own. Offsets are as the file gives them; lines under a group give offsets from that group; [hi:lo] are bit positions; {n}, {i} and the like mark numbered series; 'fields as' and 'values as' point back to an identical list; <NAME> marks a mode.

## DCSM_BANK1_Z1_OTP — DCSM BANK1 Z1 OTP Registers
0x00 B1_Z1OTP_LINKPOINTER1 — Zone 1 Link Pointer1 in Z1 OTP for flash BANK1
  [31:0] B1_Z1OTP_LINKPOINTER1 — Zone1 Link Pointer 1 location in USER OTP of Flash BANK1.
0x04 B1_Z1OTP_LINKPOINTER2 — Zone 1 Link Pointer2 in Z1 OTP for flash BANK1
  [31:0] B1_Z1OTP_LINKPOINTER2 — Zone1 Link Pointer 2 location in USER OTP of Flash BANK1.
0x08 B1_Z1OTP_LINKPOINTER3 — Zone 1 Link Pointer3 in Z1 OTP for flash BANK1
  [31:0] B1_Z1OTP_LINKPOINTER3 — Zone1 Link Pointer 3 location in USER OTP of Flash BANK1.
