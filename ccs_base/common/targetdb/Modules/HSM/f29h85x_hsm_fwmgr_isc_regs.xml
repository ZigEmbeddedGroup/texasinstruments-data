# f29h85x_hsm_fwmgr_isc_regs register map
Vendor: Texas Instruments
Peripheral module from a debugger description file (folder HSM).
Registers are 32-bit, access not given, no defined reset value unless marked. A register's access mark holds for its fields unless they carry their own. Offsets are as the file gives them; lines under a group give offsets from that group; [hi:lo] are bit positions; {n}, {i} and the like mark numbered series; 'fields as' and 'values as' point back to an identical list; <NAME> marks a mode.

## HSM_FWMGR_ISC — HSM FWMGR ISC Registers
0x00 I_ISC_REGION_0_CONTROL — ISC Region 0 Control Register
0x10 I_ISC_REGION_0_START_ADDRESS_L — ISC Region 0 Start Address Low Register
0x14 I_ISC_REGION_0_START_ADDRESS_H — ISC Region 0 Start Address High Register
0x18 I_ISC_REGION_0_END_ADDRESS_L — ISC Region 0 End Address Low Register
0x1C I_ISC_REGION_0_END_ADDRESS_H — ISC Region 0 End Address High Register
0x20 I_ISC_REGION_DEF_CONTROL — ISC Default Region Control Register
0x400 D_ISC_REGION_0_CONTROL — ISC Region 0 Control Register
0x410 D_ISC_REGION_0_START_ADDRESS_L — ISC Region 0 Start Address Low Register
0x414 D_ISC_REGION_0_START_ADDRESS_H — ISC Region 0 Start Address High Register
0x418 D_ISC_REGION_0_END_ADDRESS_L — ISC Region 0 End Address Low Register
0x41C D_ISC_REGION_0_END_ADDRESS_H — ISC Region 0 End Address High Register
0x420 D_ISC_REGION_DEF_CONTROL — ISC Default Region Control Register
0x800 S_ISC_REGION_0_CONTROL — ISC Region 0 Control Register
0x810 S_ISC_REGION_0_START_ADDRESS_L — ISC Region 0 Start Address Low Register
0x814 S_ISC_REGION_0_START_ADDRESS_H — ISC Region 0 Start Address High Register
0x818 S_ISC_REGION_0_END_ADDRESS_L — ISC Region 0 End Address Low Register
0x81C S_ISC_REGION_0_END_ADDRESS_H — ISC Region 0 End Address High Register
0x820 S_ISC_REGION_DEF_CONTROL — ISC Default Region Control Register
