# soc_aaon_secure register map
Vendor: Texas Instruments
Peripheral module from a debugger description file (folder CC35X1).
Registers are 32-bit, access per field, reset 0x0 unless marked. A register's access mark holds for its fields unless they carry their own. Offsets are as the file gives them; lines under a group give offsets from that group; [hi:lo] are bit positions; {n}, {i} and the like mark numbered series; 'fields as' and 'values as' point back to an identical list; <NAME> marks a mode.

## soc_aaon_secure
0x00 dma_m33_sec_imask reset 0xFFFFFF — DMA M33 Secure Event IMASK. Mask Event. '0' - CLR - Clear Interrupt Mask '1' - SET - Set Interrupt Mask
  [11:0] IMASK rw — '0' - CLR - Clear Interrupt Mask '1' - SET - Set Interrupt Mask
0x04 dma_m33_sec_iset_evt_mng — DMA M33 Secure Event ISET. Sets event in RIS Write 0 - NO_EFFECT - Writing 0 has no effect Write 1 - SET - Sets interrupt
  [11:0] ISET wo — Write 0 - NO_EFFECT - Writing 0 has no effect Write 1 - SET - Sets interrupt Type: Write-Clear.
0x08 dma_m33_sec_iclr_evt_mng — DMA M33 Secure Event ICLR. Clears event in RIS Write 0 - NO_EFFECT - Writing 0 has no effect Write 1 - CLR - Clears the Event
  [11:0] ICLR wo — Write 0 - NO_EFFECT - Writing 0 has no effect Write 1 - CLR - Clears the Event Type: Write-Clear.
0x0C dma_m33_sec_imset_evt_mng — DMA M33 Secure Event IMSET. Sets Event Write 0 - NO_EFFECT - Writing 0 has no effect Write 1 - SET - Set interrupt mask
  [11:0] IMSET wo — Write 0 - NO_EFFECT - Writing 0 has no effect Write 1 - SET - Set interrupt mask Type: Write-Clear
0x10 dma_m33_sec_imclr_evt_mng — DMA M33 Secure Event IMCLR. Clears Event Write 0 - NO_EFFECT - Writing 0 has no effect Write 1 - CLR - Clear interrupt mask
  [11:0] IMSET wo — Write 0 - NO_EFFECT - Writing 0 has no effect Write 1 - CLR - Clear interrupt mask Type: Write-Clear.
0x14 dma_m33_sec_ris_evt_mng ro — DMA M33 Secure Event RIS. Raw interrupt status for event. This bit is set to 1 when an event is received. when the corresponding bit in ICLR is set to 1, this bit will be cleared. Read 0 - CLR - Interrupt did not occur Read 1 - SET - Interrupt occurred
  [11:0] RIS — Read 0 - CLR - Interrupt did not occur Read 1 - SET - Interrupt occurred
0x18 dma_m33_sec_mis_evt_mng ro — DMA M33 Secure Event MIS. Mask interrupt status for event Read 0 - CLR - Interrupt did not occur Read 1 - SET - Interrupt occurred
  [11:0] MIS — Read 0 - CLR - Interrupt did not occur Read 1 - SET - Interrupt occurred
0x1000 dma_m33_non_sec_imask reset 0xFFFFFF — DMA M33 Non-Secured IMASK. Mask Event. '0' - CLR - Clear Interrupt Mask '1' - SET - Set Interrupt Mask
  fields as dma_m33_sec_imask
0x1004 dma_m33_non_sec_iset_evt_mng — DMA M33 Non-Secured ISET. Sets event in RIS Write 0 - NO_EFFECT - Writing 0 has no effect Write 1 - SET - Sets interrupt
  fields as dma_m33_sec_iset_evt_mng
0x1008 dma_m33_non_sec_iclr_evt_mng — DMA M33 Non-Secured ICLR. Clears event in RIS Write 0 - NO_EFFECT - Writing 0 has no effect Write 1 - CLR - Clears the Event
  fields as dma_m33_sec_iclr_evt_mng
0x100C dma_m33_non_sec_imset_evt_mng — DMA M33 Non-Secured IMSET. Sets Event Write 0 - NO_EFFECT - Writing 0 has no effect Write 1 - SET - Set interrupt mask
  fields as dma_m33_sec_imset_evt_mng
0x1010 dma_m33_non_sec_imclr_evt_mng — DMA M33 Non-Secured IMCLR. Clears Event Write 0 - NO_EFFECT - Writing 0 has no effect Write 1 - CLR - Clear interrupt mask
  [11:0] IMCLR wo — Write 0 - NO_EFFECT - Writing 0 has no effect Write 1 - CLR - Clear interrupt mask Type: Write-Clear.
0x1014 dma_m33_non_sec_ris_evt_mng ro — DMA M33 Non-Secured RIS. Raw interrupt status for event. This bit is set to 1 when an event is received. when the corresponding bit in ICLR is set to 1, this bit will be cleared. Read 0 - CLR - Interrupt did not occur Read 1 - SET - Interrupt occurred
  fields as dma_m33_sec_ris_evt_mng
0x1018 dma_m33_non_sec_mis_evt_mng ro — DMA M33 Non-Secured MIS. Mask interrupt status for event Read 0 - CLR - Interrupt did not occur Read 1 - SET - Interrupt occurred
  fields as dma_m33_sec_mis_evt_mng
0x2000 dma_m3_imask reset 0xFFFFFF — DMA M3 Event IMASK. Mask Event. '0' - CLR - Clear Interrupt Mask '1' - SET - Set Interrupt Mask
  fields as dma_m33_sec_imask
0x2004 dma_m3_iset_evt_mng — DMA M3 Event ISET. Sets event in RIS Write 0 - NO_EFFECT - Writing 0 has no effect Write 1 - SET - Sets interrupt
  fields as dma_m33_sec_iset_evt_mng
0x2008 dma_m3_iclr_evt_mng — DMA M3 Event ICLR. Clears event in RIS Write 0 - NO_EFFECT - Writing 0 has no effect Write 1 - CLR - Clears the Event
  fields as dma_m33_sec_iclr_evt_mng
0x200C dma_m3_imset_evt_mng — DMA M3 Event IMSET. Sets Event Write 0 - NO_EFFECT - Writing 0 has no effect Write 1 - SET - Set interrupt mask
  fields as dma_m33_sec_imset_evt_mng
0x2010 dma_m3_imclr_evt_mng — DMA M3 Event IMCLR. Clears Event Write 0 - NO_EFFECT - Writing 0 has no effect Write 1 - CLR - Clear interrupt mask
  fields as dma_m33_non_sec_imclr_evt_mng
0x2014 dma_m3_ris_evt_mng ro — DMA M3 Event RIS. This bit is set to 1 when an event is received. when the corresponding bit in ICLR is set to 1, this bit will be cleared. Read 0 - CLR - Interrupt did not occur Read 1 - SET - Interrupt occurred
  fields as dma_m33_sec_ris_evt_mng
0x2018 dma_m3_mis_evt_mng ro — DMA M3 Event MIS. Mask interrupt status for event Read 0 - CLR - Interrupt did not occur Read 1 - SET - Interrupt occurred
  [11:0] MIS — Read 0 - CLR - Interrupt did not occur Read 1 - SET - Interrupt occured
