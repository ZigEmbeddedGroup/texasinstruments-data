# wl_phy_mcu_scr_ram_secure register map
Vendor: Texas Instruments
Peripheral module from a debugger description file (folder CC35X1E).
Registers are 32-bit, access not given, no defined reset value unless marked. A register's access mark holds for its fields unless they carry their own. Offsets are as the file gives them; lines under a group give offsets from that group; [hi:lo] are bit positions; {n}, {i} and the like mark numbered series; 'fields as' and 'values as' point back to an identical list; <NAME> marks a mode.

## wl_phy_mcu_scr_ram_secure
0x00 phy_scr_ram — PHY Scripter Ram, 8KB ULL. Address Map: 0090_6000:0090_7FFF
