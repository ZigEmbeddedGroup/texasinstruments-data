# host_mcu_sec_secure register map
Vendor: Texas Instruments
Peripheral module from a debugger description file (folder CC35X1E).
Registers are 32-bit, access per field, reset 0x0 unless marked. A register's access mark holds for its fields unless they carry their own. Offsets are as the file gives them; lines under a group give offsets from that group; [hi:lo] are bit positions; {n}, {i} and the like mark numbered series; 'fields as' and 'values as' point back to an identical list; <NAME> marks a mode.

## host_mcu_sec_secure
0x00 s_sw_interrupt_to_ns — Secure Software Interrupt
  [7:0] EN rw — Secure context of CM33 can use this register to interrupt non secure context of CM33.
0x04 sw_interrupt_to_cm3 — Software Interrupt to CM3
  [0] EN rw — Secure context of CM33 can use this register to interrupt CM3.
0x08 hostmcu_lockup ro — Software Interrupt to CM3
  [0] VAL — The processor enters a lockup state if a fault occurs when it cannot be serviced or escalated. When the processor is in lockup state, it does not execute any instructions. The processor remains in lockup state until either: * It is reset. * Preemption by a higher priority exception occurs. * It is halted by a debugger.
