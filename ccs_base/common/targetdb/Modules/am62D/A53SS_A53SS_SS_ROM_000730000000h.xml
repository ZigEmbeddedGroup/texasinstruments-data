# A53SS_A53SS_SS_ROM_000730000000h register map
Vendor: Texas Instruments
Peripheral module from a debugger description file (folder am62D).
Registers are 32-bit, access not given, no defined reset value unless marked. A register's access mark holds for its fields unless they carry their own. Offsets are as the file gives them; lines under a group give offsets from that group; [hi:lo] are bit positions; {n}, {i} and the like mark numbered series; 'fields as' and 'values as' point back to an identical list; <NAME> marks a mode.

## A53SS_SS_ROM
0x00 A53SS_SS_ROM_ROMENTRY0 — ROM Table Entry Register 0 (CPU 0 Debug Component)
0x04 A53SS_SS_ROM_ROMENTRY1 — ROM Table Entry Register 1 (CPU 0 CTI Component)
0x08 A53SS_SS_ROM_ROMENTRY2 — ROM Table Entry Register 2 (CPU 0 PMU Component)
0x0C A53SS_SS_ROM_ROMENTRY3 — ROM Table Entry Register 3 (CPU 0 ETM Component)
0x10 A53SS_SS_ROM_ROMENTRY4 — ROM Table Entry Register 4 (CPU 1 Debug Component)
0x14 A53SS_SS_ROM_ROMENTRY5 — ROM Table Entry Register 5 (CPU 1 CTI Component)
0x18 A53SS_SS_ROM_ROMENTRY6 — ROM Table Entry Register 6 (CPU 1 PMU Component)
0x1C A53SS_SS_ROM_ROMENTRY7 — ROM Table Entry Register 7 (CPU 1 ETM Component)
0x20 A53SS_SS_ROM_ROMENTRY8 — ROM Table Entry Register 8 (CPU 2 Debug Component)
0x24 A53SS_SS_ROM_ROMENTRY9 — ROM Table Entry Register 9 (CPU 2 CTI Component)
0x28 A53SS_SS_ROM_ROMENTRY10 — ROM Table Entry Register 10 (CPU 2 PMU Component)
0x2C A53SS_SS_ROM_ROMENTRY11 — ROM Table Entry Register 11 (CPU 2 ETM Component)
0x30 A53SS_SS_ROM_ROMENTRY12 — ROM Table Entry Register 12 (CPU 3 Debug Component)
0x34 A53SS_SS_ROM_ROMENTRY13 — ROM Table Entry Register 13 (CPU 3 CTI Component)
0x38 A53SS_SS_ROM_ROMENTRY14 — ROM Table Entry Register 14 (CPU 3 PMU Component)
0x3C A53SS_SS_ROM_ROMENTRY15 — ROM Table Entry Register 15 (CPU 3 ETM Component)
{0xFC0+4i} A53SS_SS_ROM_ROM_PERIPHID{i}_VAL (i=4..7) — ROM Peripheral ID {i}
{0xFE0+4i} A53SS_SS_ROM_ROM_PERIPHID{i}_VAL (i=0..3) — ROM Peripheral ID {i}
{0xFF0+4i} A53SS_SS_ROM_ROM_COMPONID{i}_VAL (i=0..3) — ROM Component ID {i}
