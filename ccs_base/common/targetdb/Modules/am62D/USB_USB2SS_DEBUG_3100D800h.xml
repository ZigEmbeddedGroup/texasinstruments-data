# USB_USB2SS_DEBUG_3100D800h register map
Vendor: Texas Instruments
Peripheral module from a debugger description file (folder am62D).
Registers are 32-bit, access not given, no defined reset value unless marked. A register's access mark holds for its fields unless they carry their own. Offsets are as the file gives them; lines under a group give offsets from that group; [hi:lo] are bit positions; {n}, {i} and the like mark numbered series; 'fields as' and 'values as' point back to an identical list; <NAME> marks a mode.

## USB2SS_DEBUG
0x00 USB2SS_DEBUG_DEBUG
0x00 USB2SS_DEBUG_DEBUG_U3RHBDBG access per field reset 0x0 — U3 Root Hub Debug Register
  [3] TPCFG_TOUT_CTRL rw — tpcfg_tout_ctrl This bit controls the USB 3.0 port configuration timeout duration. - 1: The port configuration timeout counter resets when the link is not in U0. - 0: The port configuration timeout counter does not reset if the link enters recovery or exits U0. Reset Source: rst_mod_g_rst_n
