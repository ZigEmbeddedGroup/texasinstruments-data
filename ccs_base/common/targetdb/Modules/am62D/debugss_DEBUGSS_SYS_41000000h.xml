# debugss_DEBUGSS_SYS_41000000h register map
Vendor: Texas Instruments
Peripheral module from a debugger description file (folder am62D).
Registers are 32-bit, read-only, reset 0x0 unless marked. A register's access mark holds for its fields unless they carry their own. Offsets are as the file gives them; lines under a group give offsets from that group; [hi:lo] are bit positions; {n}, {i} and the like mark numbered series; 'fields as' and 'values as' point back to an identical list; <NAME> marks a mode.

## debugss_SYS
0x00 debugss_SYS_TRACE — This register contains TBR trace read data
  [31:0] DATA — TBR TRACE data
