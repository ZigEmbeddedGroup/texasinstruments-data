# aasrc_AASRC_DATA_R0_02D10000h register map
Vendor: Texas Instruments
Peripheral module from a debugger description file (folder AM275x).
Registers are 32-bit, read-write, reset 0x0 unless marked. A register's access mark holds for its fields unless they carry their own. Offsets are as the file gives them; lines under a group give offsets from that group; [hi:lo] are bit positions; {n}, {i} and the like mark numbered series; 'fields as' and 'values as' point back to an identical list; <NAME> marks a mode.

## aasrc_data_r0
{0x0+8i} AASRC_DATA_R0_GROUP_INPUT_FIFO_DATA_L{i} (i=0..7) — This is where the input samples are written for stream{i} left channel
  [31:0] IN_DATA{2i}
{0x4+8i} AASRC_DATA_R0_GROUP_INPUT_FIFO_DATA_R{i} (i=0..7) — This is where the input samples are written for stream{i} right channel
  [31:0] IN_DATA{2i+1}
{0x80+8i} AASRC_DATA_R0_GROUP_OUTPUT_FIFO_DATA_L{i} ro (i=0..7) — This is where the outpuput samples are written for stream{i} left channel
  [31:0] OUT_DATA{2i} — This is from where the output samples are read for stream{i} left channel
{0x84+8i} AASRC_DATA_R0_GROUP_OUTPUT_FIFO_DATA_R{i} ro (i=0..7) — This is where the outpuput samples are written for stream{i} right channel
  [31:0] OUT_DATA{2i+1} — This is from where the output samples are read for stream{i} right channel
