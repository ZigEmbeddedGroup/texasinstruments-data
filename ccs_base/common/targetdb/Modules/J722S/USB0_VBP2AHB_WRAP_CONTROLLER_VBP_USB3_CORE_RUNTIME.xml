# USB0_VBP2AHB_WRAP_CONTROLLER_VBP_USB3_CORE_RUNTIME register map
Vendor: Texas Instruments
Peripheral module from a debugger description file (folder J722S).
Registers are 32-bit, read-only, reset 0x0 unless marked. A register's access mark holds for its fields unless they carry their own. Offsets are as the file gives them; lines under a group give offsets from that group; [hi:lo] are bit positions; {n}, {i} and the like mark numbered series; 'fields as' and 'values as' point back to an identical list; <NAME> marks a mode.

## USB0_VBP2AHB_WRAP_CONTROLLER_VBP_USB3_CORE_RUNTIME
0x00 VBP2AHB_WRAP__CONTROLLER_VBP__USB3_CORE_RUNTIME_MFINDEX — Microframe Index Register Bit Definitions For a description of this standard USB register field, see the eXtensible Host Controller Interface for Universal Serial Bus (USB) Specification 3.0.
  [13:0] MICROFRAME_INDEX — MICROFRAME_INDEX For a description of this standard USB register field, see the eXtensible Host Controller Interface for Universal Serial Bus [USB] Specification 3.0.
0x04 VBP2AHB_WRAP__CONTROLLER_VBP__USB3_CORE_RUNTIME_RsvdZ access not given reset not defined — RsvdZ For a description of this standard USB register field, see the eXtensible Host Controller Interface for Universal Serial Bus (USB) Specification 3.0.
